/*
 * HalowPassthrough — сквозной мост ПК <-> модуль TX-AH.
 *
 * ESP32 здесь ничего не решает: просто перекладывает байты между USB (терминал на
 * ПК) и UART модуля, в обе стороны, без единого своего символа в потоке. Нужен
 * для двух вещей:
 *
 *   1. Ручная работа с AT-командами из нормального терминала. Прошивки
 *      HalowVideo_* сами постоянно опрашивают модуль и печатают своё, поэтому в
 *      них не разобрать, где ответ на твою команду, а где их собственный обмен.
 *
 *   2. ОБНОВЛЕНИЕ ПРОШИВКИ МОДУЛЯ через AT+FWUPG (см. китайский мануал
 *      SDK/泰芯AH模组AT指令开发指南.pdf, п.3.4.1 — в английском docs/AT_cmd.md этой
 *      команды нет). Модуль отвечает потоком 'C' (вошёл в режим приёма) и ждёт
 *      файл по протоколу XMODEM. Внешний SPI-программатор для этого не нужен —
 *      всё идёт по этому же проводу.
 *
 * Как пользоваться:
 *   - прошить этим скетчем ту плату, чей модуль нужно обслужить;
 *   - открыть её COM-порт терминалом, который умеет XMODEM (Tera Term — бесплатный,
 *     SecureCRT/Xshell — платные). Скорость терминала не важна: у ESP32 нативный
 *     USB CDC, реальная скорость от неё не зависит;
 *   - в терминале включить перевод строки CR+LF, иначе модуль не увидит конца
 *     AT-команды и не ответит (мы на этом уже обжигались);
 *   - проверить связь: AT+ (модуль должен что-то напечатать), затем, например,
 *     AT+BAUDRATE=? или AT+VERSION=?;
 *   - для обновления: AT+FWUPG, дождаться "CCCCCC", затем в терминале
 *     Файл -> Передать -> XMODEM -> выбрать .bin прошивки.
 *
 * ВАЖНО: пока залит этот скетч, плата не снимает видео и не поднимает связь —
 * это чисто сервисный режим. Обратно шить HalowVideo_STA / HalowVideo_AP.
 */

#include <Arduino.h>
#include "utilities.h"

// Скорость UART к модулю. У прошивки TAIXIN-usb она зашита на 115200 и другой
// не бывает (проверено: AT+BAUDRATE её не меняет — команда для варианта
// UART-BUS). Если после успешной смены прошивки модуль заговорит быстрее —
// поменять здесь.
#define AT_BAUD 115200

// Байты гоняем пачками, а не по одному: XMODEM шлёт блоками по 128/1024 байт,
// и на побайтовой перекладке USB CDC заметно тормозит.
#define PUMP_BUF 512

/*
 * АВТОМАТИЧЕСКИЙ ПЕРЕХВАТ ОКНА AT+NOP2P.
 *
 * На прошивке с прозрачным режимом (шаг 3) модуль отдаёт UART под uart_p2p
 * через 8 секунд после загрузки, и AT замолкает — включая AT+FWUPG. Вернуть
 * AT можно только одним способом: успеть в эти 8 секунд послать AT+NOP2P.
 *
 * Успеть руками в терминале почти невозможно: пока обесточишь, подашь питание,
 * дождёшься порта и наберёшь команду — окно закрылось. Поэтому шлём её отсюда:
 * ESP32 включается одновременно с модулем и попадает в окно всегда.
 *
 * Шлём НЕСКОЛЬКО раз с интервалом: модулю нужно время подняться, и первая
 * попытка может уйти в ещё не готовый разборщик команд.
 *
 * На прошивках без прозрачного режима команды AT+NOP2P нет — модуль ответит
 * ERROR, и это ничему не мешает.
 *
 * 0 — выключить, если мешает (например, при отладке самого окна).
 */
#define AUTO_NOP2P 1
#define NOP2P_TRIES 12
#define NOP2P_GAP_MS 400

void setup()
{
    SerialMon.begin(115200);
    SerialAT.begin(AT_BAUD, SERIAL_8N1, SERIAL_AT_RXD, SERIAL_AT_TXD);

    pinMode(BOARD_LED, OUTPUT);
    digitalWrite(BOARD_LED, HIGH);   // горит = мост поднят, плата в сервисном режиме

#if AUTO_NOP2P
    /*
     * Делаем это ДО приветствия и до открытия терминала: окно тикает от
     * подачи питания на модуль, а не от того, когда оператор откроет порт.
     * Ответы модуля не читаем и не печатаем — они уйдут в общий поток моста,
     * как и всё остальное.
     */
    for (int i = 0; i < NOP2P_TRIES; i++) {
        SerialAT.print("AT+NOP2P\r\n");
        delay(NOP2P_GAP_MS);
    }
#endif

    /*
     * Глушим периодическую печать модуля — ту же, что глушат боевые скетчи.
     *
     * 25.08: в прошивке модуля включён netlog, он дублирует весь лог в сеть
     * пакетами UDP. Пока станций нет, отправить их некому, и каждый уносит
     * буфер безвозвратно. Дамп LMAC печатается каждые 6 секунд — это ровный
     * расход, из-за которого пул из ~75 буферов кончается за минуту.
     *
     * Мосту это нужно, чтобы измерять утечку в тех же условиях, в каких
     * работают боевые прошивки.
     */
    /* Не глушим LMAC совсем, а разрежаем его печать: дамп нужен нам как
     * источник данных о буферах, но каждые 6 секунд он слишком дорог. */
    SerialAT.print("AT+PRINT_PERIOD=30\r\n");
    delay(300);
    SerialAT.print("AT+SYSDBG=WNB,0\r\n");
    delay(300);


    // Единственная наша строка за всё время работы — и та до начала обмена,
    // чтобы не испортить бинарный поток XMODEM.
    delay(500);
    SerialMon.println();
    SerialMon.printf("=== T-Halow: сквозной мост ПК <-> модуль (%u бод) ===\r\n",
                     (unsigned)AT_BAUD);
    SerialMon.println("Дальше — только байты модуля. Включите CR+LF в терминале.");
    SerialMon.println("AT+FWUPG -> ждать 'CCCC' -> отправить .bin по XMODEM.");
#if AUTO_NOP2P
    SerialMon.println("AT+NOP2P отправлен автоматически: если прошивка с прозрачным");
    SerialMon.println("режимом, он отменён и AT доступен без ограничения по времени.");
#endif
    SerialMon.println();
    /*
     * 20.08: без этого приветствие терялось целиком. Serial здесь —
     * USB-Serial/JTAG: запись только кладёт байты в кольцо, а выгребает их
     * прерывание. Пока хост не начал читать, кольцо стоит, и плата выглядит
     * мёртвой. Ждём, пока опустеет.
     */
    SerialMon.flush();
}

void loop()
{
    static uint8_t buf[PUMP_BUF];

    int n = SerialMon.available();
    if (n > 0) {
        if (n > PUMP_BUF) {
            n = PUMP_BUF;
        }
        n = SerialMon.readBytes(buf, n);
        if (n > 0) {
            SerialAT.write(buf, n);
        }
    }

    n = SerialAT.available();
    if (n > 0) {
        if (n > PUMP_BUF) {
            n = PUMP_BUF;
        }
        n = SerialAT.readBytes(buf, n);
        if (n > 0) {
            SerialMon.write(buf, n);
            // Ответ модуля должен уйти на ПК сразу, а не ждать в кольце:
            // на той стороне его ждёт человек или скрипт с таймаутом.
            SerialMon.flush();
        }
    }
}
