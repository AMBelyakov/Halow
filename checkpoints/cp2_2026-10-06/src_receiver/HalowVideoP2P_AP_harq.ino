/*
 * HalowVideoP2P_AP — приёмная плата, прозрачный режим (uart_p2p).
 *
 * Цепочка доставки:
 *   камера --UART--> модуль STA --эфир--> модуль AP --UART--> этот ESP32
 *   --USB--> ПК (tools/halow_viewer.py)
 *
 * ЧЕМ ОТЛИЧАЕТСЯ ОТ HalowVideo_AP
 * Там из UART модуля вычитывались текстовые заголовки "+RXDATA:<len>" и следом
 * ровно len бинарных байт. Здесь никаких "+RXDATA" нет: прошивка 2.4.1.3 с
 * SYS_APP_UART_P2P=1 выдаёт в UART чистый поток байт, ровно то, что записала в
 * свой UART другая плата. Границы пакетов в потоке не сохраняются, поэтому их
 * несёт наше собственное кадрирование из halow_stream.h — маркер, длина, CRC16.
 *
 * Формат отдачи в USB НЕ ИЗМЕНИЛСЯ: те же записи [0xA5][0x5A][type][len][payload]
 * с телом halow_app_hdr_t + кусок JPEG. Это сделано намеренно —
 * tools/halow_viewer.py работает без единой правки.
 *
 * ЧТО ПОТЕРЯНО: AT-команд на прозрачной прошивке нет (uart_p2p_init забирает
 * UART1 и глушит печать), значит нет ни AT+CONN_STATE, ни AT+RSSI. Поле rssi в
 * метриках всегда 0, просмотрщик покажет прочерк. Живость линка теперь видна
 * не по RSSI, а по счётчикам: растёт pkts_ok — связь есть; растёт crc_err —
 * байты теряются.
 */

#include <Arduino.h>
#include "utilities.h"
#include "halow_stream.h"
#include <Wire.h>
#include <Adafruit_GFX.h>
#include <Adafruit_SSD1306.h>

// ---------------------------- настройки ----------------------------

// Должны совпадать со STA и с UART_P2P_BAUDRATE в прошивке модуля.
#define AT_BAUD   115200   // скорость стартового окна (жёстко 115200 в прошивке)
#define P2P_BAUD  3000000   // ДОЛЖНА совпадать с UART_P2P_BAUDRATE залитого bin
                           // 24.09: модули на 3000000 с патчем кольца 8 КБ (запас 27.3 мс).
                           // Чанк поднять НЕЛЬЗЯ: 1400 — предел эфирного
                           // кадра модуля (1500 Б), см. halow_stream.h:175.
                           // Поэтому пауза 6 мс платится с каждых 1400 Б.
                           // Прежде:
                           // (APP_..._2026-09-24_step3-1000000-RING8K_...bin).
                           // 96e6/1000000 = 96 ровно, ошибка частоты 0%.
                           // Откат на 384000 — и прошивку модуля откатывать тоже.

/*
 * ЗАДЕРЖКА ПРОЗРАЧНОГО РЕЖИМА В ЗАЛИТОЙ ПРОШИВКЕ МОДУЛЯ.
 *
 * Копия UART_P2P_START_DELAY_MS из project_config.h той сборки, что лежит в
 * модуле ЭТОЙ платы (сейчас 180 с, delay180s от 26.08).
 *
 * Зачем задержка вообще: точка доступа, уже ушедшая в прозрачный режим,
 * отказывает новым станциям — на запрос подключения отвечает деаутентификацией
 * с причиной 2. Значит камера обязана подключиться ДО захвата UART.
 *
 * Окно скетча обязано быть длиннее модульного, иначе ESP32 переключит порт на
 * 230400, пока модуль ещё разговаривает по AT на 115200.
 *
 * 27.08: прежнее предупреждение «у модуля камеры пока 8 секунд» устарело и
 * успело обойтись дорого. В обоих модулях с 26.08 залита delay180s, а в скетче
 * камеры оставалось окно 33 с — полторы минуты двоичного мусора в живой
 * разборщик AT-команд ровно во время ассоциации. Теперь обе платы объявляют
 * задержку модуля явно и считают окно от неё.
 */
/*
 * 01.09: 30000, а не 180000. В модуль залита сборка delay30s-nonetlog от
 * 25.08 — проверено опросом, AT+SYSCFG печатает build time Aug 25 2026
 * 17:48:12, что совпадает с датой файла в SDK/builds.
 *
 * Зачем сокращали. Задержку подняли до 180 с вслепую, когда причина отказов
 * связи была неизвестна: считалось, что точка доступа обязана принять станцию
 * ДО перехода в прозрачный режим. Измерения 01.09 показали, что окно из
 * страховки превратилось в главное препятствие: ассоциации происходили на
 * 30-й, 60-й и 95-й секундах и держались до полуминуты, но приёмник начинал
 * слать отчёты только на 178-й — камера об установившейся связи просто не
 * узнавала, гейт не открывался, и к моменту первого отчёта станция уже
 * отваливалась. Итог прогона: ok=0 при трёх состоявшихся ассоциациях.
 *
 * Теперь окно 33 с у обеих плат, отчёты идут почти сразу после старта, и
 * попытка стоит минуту вместо четырёх — при перемежающейся ассоциации это
 * единственный способ набрать статистику, а не гадать по одному прогону.
 */
#define MODULE_P2P_DELAY_MS 30000
#define P2P_WINDOW_MS (MODULE_P2P_DELAY_MS + 3000)

// Мастер-выключатель всего, что скетч делает с модулем в стартовом окне.
#define USE_AT_WINDOW 1

/*
 * 27.08: ОКНО РАЗДЕЛЕНО НА ЧТЕНИЕ И ЗАПИСЬ. Подробное обоснование — в скетче
 * камеры, здесь коротко: запись конфигурации при каждой загрузке приходится на
 * секунды 1-6 жизни модуля, то есть на время ассоциации, и AT+ENCRYPT в этот
 * момент пересобирает ключи и роняет интерфейс. Конфигурация ставится один раз
 * с терминала (tools/halow_at.py setup) и живёт во флеше.
 *
 * AT_WINDOW_LOGCFG оставлен включённым: AT+SYSDBG и AT+PRINT_PERIOD меняют
 * только многословность печати LMAC, полей в struct sys_config под них нет,
 * во флеш не пишутся. А печать здесь нужна — по ней и видно add_STA и WPA.
 */
#define AT_WINDOW_WRITE  0
#define AT_WINDOW_LOGCFG 1
#define AT_WINDOW_READ   1

/*
 * ЗАПАС ПО ПОРОГУ ЗАНЯТОСТИ КАНАЛА, дБ. 0 — не трогать.
 *
 * Это единственная запись, которую скетч приёмника делает намеренно, и она
 * стоит вне AT_WINDOW_WRITE. Разница с остальными в том, что те переписывали
 * то, что и так лежит во флеше, а эта настройка **живёт только в ОЗУ**:
 * проверено 27.08 перезагрузкой модуля — margin возвращается в 0. Не ставить
 * при каждом старте её нельзя.
 *
 * Что она лечит. Точка доступа измеряет фоновый уровень сама, и у неё он
 * выходит около −87 дБм, тогда как у платы с камерой около −60: камера
 * электрически шумнее (шина DVP, PSRAM, XCLK 20 МГц). При таком пороге
 * приёмник считает канал занятым почти всегда, откладывает передачу и копит
 * очередь — 27.08 замерено, как sq растёт до 154, пул падает с 76 до нуля, а
 * кадры ждут отправки до 134 секунд. Ответ на запрос подключения при таком
 * ожидании не успевает никогда: у станции таймаут около секунды.
 *
 * С margin=20 канал видится свободным (cca 0:0), очередь не растёт вовсе, и
 * станция впервые проходит ассоциацию: add_STA, aid=1.
 *
 * Величину подбирали грубо: 20 дБ поднимают порог примерно до уровня, на
 * котором работает камера. Уточнять — измерением, а не на глаз: слишком
 * большой запас делает передатчик невежливым к соседям по диапазону.
 */
#define CCA_MARGIN_DB 20

/*
 * 06.10: ЧЕРЕДОВАНИЕ ЗАПАСА CCA в одном включении — опыт ABAB «20 против 0».
 *
 * Гипотеза. 05.10 камера-точка теряла 7–37 % квитанций при SNR обратного пути
 * 38–40 дБ — не от слабого сигнала. Порог занятости модуля = фон + запас +
 * 10..21 дБ (lmac_adjust_cca_threshold): с запасом 20 при фоне около −87 это
 * −57..−46 дБм, а камера на 3 дБм в 5 м приходит около −64. Приёмник её не
 * слышит и шлёт квитанцию, когда камера передаёт, — та её не принимает.
 *
 * Как. Модуль сам меняет запас каждые CCA_SW_S секунд: CCA_MARGIN_DB,
 * CCA_SW_ALT, CCA_MARGIN_DB, … (AT+CCASW, прошивка модуля ..._ccasw от 06.10).
 * Отсчёт — от команды; ESP32 считает фазу по тому же отсчёту и отдаёт её в
 * просмотрщик полем margin (столбец ap_margin в CSV) и в строку DIAG (cca=).
 * Старая прошивка модуля команду не знает: ответ ERROR, чередования нет,
 * в CSV остаётся CCA_MARGIN_DB.
 *
 * 0 в CCA_SW_S — не чередовать.
 */
#define CCA_SW_S   0     /* 06.10 swap5: CCA 20 постоянно (swap4: 0 даёт 90 % квитанций вместо 74, но больше потерь кусков и обрыв) */
#define CCA_SW_ALT 0

/*
 * 05.10: квитанции и отчёты камере — адресно, если модуль приёмника клиент (опыт
 * «камера — точка доступа»). Прямой канал — всем, обратный — адресно. Если модуль
 * точка доступа (обычная раскладка), ничего не меняется. 0 — всегда «всем».
 */
#define PEER_UNICAST 1

/*
 * ДИАГНОСТИКА ЛИНКА: 1 — спросить модуль, кто он и в каком режиме.
 *
 * Нужна, потому что прозрачный режим невозможно проверить изнутри: мы пишем
 * байты и не получаем на них никакого подтверждения. Если модуль остался в
 * AT-режиме, запись просто исчезает, а скетч продолжает показывать бодрые fps.
 */
#define LINK_DIAG 1

// 1 — ГЛУШИТЬ. Вернул 25.08, и это не косметика.
//
// В прошивке модуля включён netlog (SYS_APP_NETLOG=1): он дублирует ВЕСЬ лог
// модуля в сеть пакетами UDP. Пока к точке доступа никто не подключён, каждую
// такую строку отправить некому — netdev_send_data возвращает -1, lwIP печатает
// "Send to netdev error", и буфер не возвращается в пул.
//
// Замерено 25.08: пул из ~75 буферов выедается за 60 секунд, из них половина
// уходит за первые 4 секунды (загрузочный лог), дальше ровно по 0.6 буфера в
// секунду — это периодический дамп LMAC STATUS, пятнадцать строк каждые шесть
// секунд. С нулём буферов модуль не может передать даже ответ на запрос
// подключения, и связь перестаёт устанавливаться навсегда.
//
// Поставив здесь 0 ради диагностики, я открыл этот кран и на сутки лишил стенд
// связи. Ставить 0 можно только на короткий разбор и помня о цене.
#define QUIET_MODULE 1

/*
 * СТАВИТЬ ЛИ ШИРОКОВЕЩАТЕЛЬНЫЕ ПАРАМЕТРЫ: 1 — как раньше, 0 — оставить заводские.
 *
 * 20.08: платы перестали сходиться. Единственная конфигурация, в которой
 * ассоциация проходит целиком (add_STA, DHCP, адрес 192.168.123.2), — это когда
 * на приёмнике висит сервисный мост. А мост, в отличие от этого скетча, НЕ
 * посылает MCAST_BW и MCAST_MCS. Прецедент уже был: 18.08 от MCAST_MCS=7 связь
 * переставала устанавливаться вовсе, потому что "multicast" здесь — это все
 * кадры на широковещательный адрес, включая маяки и обмен при подключении.
 *
 * Поэтому проверяем без них. Если связь встанет — параметр трогать нельзя, и
 * скорость широковещательного тракта придётся поднимать иначе.
 */
#define SET_MCAST 1   // 03.09: включён ради замера согласованной полосы

/*
 * ШИРОКОВЕЩАТЕЛЬНЫЙ ТРАКТ — им идёт всё наше видео.
 *
 * Измерено 18.08 на живой прошивке: AT+MCAST_BW отвечал "tx bw=2 MHz",
 * AT+MCAST_MCS — "muticast tx mcs= 0". То есть видео шло в полосе 2 МГц из
 * доступных 8 и на самой нижней модуляции.
 *
 * Физическая скорость 802.11ah, один поток:
 *      2 МГц MCS0 —   650 кбит/с      8 МГц MCS0 —  2925
 *      2 МГц MCS7 —  5850             8 МГц MCS7 — 26000
 *
 * Почему это вообще так: uart_p2p шлёт кадры на адрес ff:ff:ff:ff:ff:ff.
 * Широковещательные кадры никто не подтверждает, значит нет ни повторов, ни
 * обратной связи — а без обратной связи модуль не может подбирать модуляцию и
 * ставит заведомо живучую. Отсюда же наши потери при нулевой порче байтов:
 * у каждого пакета ровно одна попытка.
 *
 * Эти два параметра, похоже, НЕ сохраняются между перезагрузками (в отличие от
 * AT+BSS_BW, который пишет в параметры). Поэтому выставляем их здесь, при
 * каждом старте, в том же окне, где ещё жив AT.
 *
 * ОСТОРОЖНО С MCS. 18.08: поставили MCAST_MCS=7, разнесли платы — связь
 * перестала УСТАНАВЛИВАТЬСЯ вовсе. Причина в том, что "multicast" здесь это
 * все кадры на широковещательный адрес, включая МАЯКИ точки доступа и обмен
 * при подключении. По маякам станция находит AP; на MCS 7 они добивают только
 * вплотную. То есть параметр бьёт не по скорости видео, а по самой связи.
 *
 * Поэтому MCS поднимать по одной ступени и каждый раз проверять, что платы
 * вообще сходятся на рабочей дистанции. Полоса (MCAST_BW) в этом смысле
 * безопаснее: 8 МГц совпадает с полосой самого канала.
 */

/*
 * 03.09: MCAST_BW поднят до 8, чтобы полоса сигнала совпала с BSS_BW=8.
 *
 * Зачем. При BSS_BW=8 и MCAST_BW=2 приёмник слушает вчетверо более широкую
 * полосу, чем занимает сигнал, и набирает вчетверо больше шума — около 6 дБ
 * впустую. Проверяем, вернёт ли согласование эти децибелы.
 *
 * Риск известен и измерен 01.09: при MCAST_BW=8 связь не встала (ok=0) —
 * "multicast" здесь это все кадры на широковещательный адрес, включая маяки.
 * Откат бесплатный: MCAST_BW и MCAST_MCS живут только в ОЗУ, снятие питания
 * возвращает 2.
 *
 * Блок вынесен из-под AT_WINDOW_WRITE по той же причине, что и CCA_MARGIN_DB:
 * эти две команды не пишут флеш и не пересобирают ключи, а без них замер
 * попросту не состоится. Всё остальное в окне по-прежнему не пишется.
 */
#define MCAST_BW   4       // 1 / 2 / 4 / 8 МГц. ПОДНИМАТЬ ПО ОДНОЙ СТУПЕНИ
                           // ОБЯЗАНА быть <= BSS_BW: сигнал шире окна приёма
                           // приёмник срежет, это уже не потеря дБ, а потеря сигнала
#define MCAST_MCS  0       // 0..7. ВЫШЕ 0 ПОДНИМАТЬ ПО ОДНОЙ СТУПЕНИ, см. выше

/*
 * РЕГУЛЯТОР МОЩНОСТИ В МОДУЛЕ (28.09): -1 — не слать, 0 — только мерить,
 * 1 — регулировать. Смысл и коридор — как в скетче камеры (PWRCTL_MODE там).
 * Регулировать нужно обе стороны: неудачной передача камеры считается и тогда,
 * когда её приёмник перегружен сигналом ЭТОЙ платы и не слышит подтверждение.
 * Контуры развязаны: каждый модуль смотрит на tx_snr — как сосед слышит его.
 * Печати здесь нет и быть не должно: этим UART идёт видео (P2PLOG выключен).
 */
#define PWRCTL_MODE 1
/* ПРИЁМНИК ВСЕГДА НА ПОТОЛКЕ PWRCTL_MAX (30.09, рабочее решение). Коридор
 * 79–80 дБ недостижим: регулятор всё время хочет вверх и держит потолок, а
 * заводские 20 дБм при этом срезаны до 14 (в режиме 0 среза нет).
 * Почему не коридор 25–35, как у камеры: 30.09 ночью в 5 м, два прогона подряд
 * одной рабочей прошивкой камеры, первые 5 минут каждого:
 *   коридор 25–35  камера слышит приёмник на −66 дБм, 4,54 к/с, 208 кбит/с,
 *                  потери кадров 5,4 %, битых (радуга) 1,0 %;
 *   прибит 14 дБм  −54 дБм, 4,80 к/с, 231 кбит/с, потери 4,8 %, радуги 0,2 %.
 * Выигрыш небольшой (в пределах плавания канала), но везде в одну сторону:
 * камере нужнее всего подтверждения приёмника, им полезен запас. Наземной
 * станции экономить незачем; регулятор нужен на борту (батарея, радуга).
 * Коридор как у камеры: 25 и 35. */
#define PWRCTL_LO   79
#define PWRCTL_HI   80
/* Потолок мощности, дБм: 14 = 25 мВт, предел ГКРЧ для 866–868 МГц. Регулятор
 * сразу срезает до него и заводскую стартовую мощность модуля (20 дБм). */
#define PWRCTL_MAX  14

/*
 * ШТАТНАЯ АВТОМОЩНОСТЬ МОДУЛЯ: -1 — не трогать, 0 — выключить, 1 — включить.
 *
 * 28.09: при включённой AT+TX_PWR_AUTO регулятор PWRCTL ставил 1 дБм, а сосед
 * слышал нас по-прежнему (SNR 64): автомощность выбирает уровень на каждый кадр
 * сама и перекрывает заданный. На камере с выключенной — SNR 64 -> 38, сдвиг
 * захвата 88 % -> 0 из 3199. Здесь то же самое для сигнала приёмника.
 */
#define TX_PWR_AUTO 0


/*
 * ПОИСК СКОРОСТИ: 1 — если из модуля не идёт ни байта, перебирать бод.
 *
 * 20.08. Приёмник не отдаёт в UART НИЧЕГО — ни пакетов, ни мусора (junk=0),
 * хотя его радио в это время принимает кадры камеры (проверено через мост:
 * счётчик rx растёт, est_rate до 313 кбит/с). Ноль мусора при живом эфире —
 * это подпись несовпадения скорости: на неверном бод драйвер ESP32 ловит
 * ошибку кадрирования и выбрасывает байт молча, не считая его мусором.
 *
 * Повод подозревать именно это: в project_config.h прошивки модуля стоит
 * UART_P2P_BAUDRATE 460800, а здесь открывается 230400.
 *
 * Перебираем сами, чтобы не гадать и не перепрошивать под каждое значение.
 * Как только появятся байты — скетч напечатает, на какой скорости, и
 * останется на ней.
 */
// 0: вопрос закрыт. 25.08 перебор прошёл пять полных кругов по 230400/460800/
// 115200/921600 — тишина на каждой. Дело не в скорости, а в том, что модуль
// приёмника в прозрачном режиме не отдаёт в UART ничего. Оставлено на случай,
// если понадобится повторить.
#define BAUD_HUNT 0
#define HUNT_STEP_MS 5000

#define STAT_PERIOD_MS  1000  // как часто отчитываться камере по обратному каналу
#define META_PERIOD_MS  2000  // как часто слать метрики в USB и печатать диагностику

/*
 * ВЫВОД ВИДЕО В USB (28.09): 1 — плата у ноутбука (halow_viewer.py),
 * 0 — плата от powerbank, без хоста.
 *
 * Зачем. USB CDC этой платы (HWCDC, ядро 2.0.9) без читателя не выбрасывает
 * запись, а ждёт место в кольцевом буфере до tx_timeout на КАЖДЫЙ вызов
 * write(). С нашим setTxTimeoutMs(100) это 100 мс на заголовок и 100 мс на
 * тело каждого чанка: главный цикл встаёт, UART модуля переполняется,
 * подтверждения опаздывают. Видели это 28.09 после остановки логгера — RTT
 * в хвосте прогона. При 0 видео в USB не пишется вовсе, а ожидание записи
 * обнулено: строки DIAG без хоста просто теряются. Приём, подтверждения
 * камере и OLED работают как обычно.
 */
#define AP_USB_STREAM 1   /* 28.09: приёмник у ноутбука, камера от powerbank шлёт лог по воздуху */

/*
 * КАНАЛ (28.09): ширина BSS (МГц) и частота (десятые МГц). -1 — не трогать.
 * ДОЛЖНЫ СОВПАДАТЬ СО СКЕТЧЕМ КАМЕРЫ.
 *
 * Зачем. До 28.09 модули стояли на BSS 4 МГц с центром 866,0 (864–868 МГц),
 * а данные шли на 2 МГц. Предел ГКРЧ — канал не шире 2 МГц в 866–868, то есть
 * 2 МГц с центром 867,0. Плюс подозрение: камера не слышит часть
 * подтверждений (PER 21–59 % уже на пустом эфире, все неудачи — таймаут ACK).
 *
 * Оба параметра пишутся ВО ФЛЕШ модуля (syscfg) и действуют со следующего
 * включения питания. Поэтому окно сначала читает и пишет только при
 * расхождении — флеш не трётся на каждой загрузке. Откат: 4 и 8660.
 */
#define BSS_BW_SET  2
#define CHAN_SET    8670

// -------------------------------------------------------------------

static Adafruit_SSD1306 display(128, 64, &Wire);
static uint32_t sta_poll_tick = 0;   // когда последний раз спрашивали список станций

static bool oled_ok = false;
static bool streaming = false;
static bool p2p_probe_done = false;   // проба «какая прошивка в модуле» сделана

static halow_p2p_rx_t rx;
static uint8_t txpkt[HALOW_P2P_PKT_BUF_LEN];

static uint32_t frames_fwd = 0;      // видеопакетов отдано в USB
static uint32_t last_frame_id = 0;
static uint32_t last_video_ms = 0;   // когда последний раз пришёл целый видеопакет

#if BAUD_HUNT
static const uint32_t hunt_bauds[] = {384000, 230400, 460800, 115200, 921600};
static uint8_t  hunt_idx = 0;
static uint32_t hunt_tick = 0;
static uint32_t hunt_bytes = 0;   // байт получено на текущей скорости
static bool     hunt_done = false;
#endif

static uint32_t stat_tick = 0;
static uint32_t meta_tick = 0;
static bool     led_state = false;

/* Прочитано в стартовом окне и уезжает в метрики: запас по порогу занятости
 * канала и измеренный моделем фоновый уровень. После закрытия окна модуль нем,
 * спросить его больше нельзя — поэтому запоминаем. */
static int ap_margin = -32768;
static int ap_bgr    = -32768;
static uint32_t cca_sw_t0 = 0;       /* 06.10: начало чередования CCA (millis), 0 — нет */

/* Запас CCA, который стоит в модуле сейчас: при чередовании — по фазе, см. CCA_SW_S. */
static int ccaMarginNow(void)
{
#if CCA_SW_S > 0
    if (cca_sw_t0) {
        uint32_t ph = (millis() - cca_sw_t0) / ((uint32_t)CCA_SW_S * 1000u);
        return (ph & 1) ? CCA_SW_ALT : CCA_MARGIN_DB;
    }
#endif
    return ap_margin;
}

//****************************[ USB: кадрирование в ПК ]*********************************

/*
 * Одна запись потока: [0xA5][0x5A][type][len_lo][len_hi][crc_lo][crc_hi][payload].
 *
 * CRC добавлена 15.08. Раньше её тут не было, и это оказалось единственным
 * звеном цепочки без контроля целостности: радио прикрыто нашей CRC на пакет,
 * камера проверена сырыми кадрами, кодировщик — двойным сжатием, а вот USB от
 * приёмника до ПК шёл на честном слове.
 *
 * Повод не теоретический: выгрузка сырых кадров (DUMP_RAW в скетче камеры)
 * показала, что USB CDC на этой плате ТЕРЯЕТ байты под нагрузкой — на каждом
 * втором кадре CRC не сходилась, а картинка выглядела сдвинутой на нечётное
 * число байт. В RGB565 такой сдвиг даёт радужный шум при сохранной геометрии —
 * ровно то, что мы видели в просмотрщике.
 *
 * Теперь просмотрщик считает битые записи отдельно (столбец usb_crc_err) и
 * выбрасывает их, а не показывает мусор.
 */
static void usbSendRecord(char type, const uint8_t *data, uint16_t len)
{
#if !AP_USB_STREAM
    (void)type; (void)data; (void)len;
    return;                  /* хоста нет, см. AP_USB_STREAM */
#endif
    uint8_t hdr[7];
    uint16_t crc = halow_crc16(data, len);

    hdr[0] = HALOW_USB_SYNC0;
    hdr[1] = HALOW_USB_SYNC1;
    hdr[2] = (uint8_t)type;
    hdr[3] = (uint8_t)(len & 0xff);
    hdr[4] = (uint8_t)(len >> 8);
    hdr[5] = (uint8_t)(crc & 0xff);
    hdr[6] = (uint8_t)(crc >> 8);
    SerialMon.write(hdr, sizeof(hdr));
    if (len) {
        SerialMon.write(data, len);
    }
}

//****************************[ приём потока из модуля ]*********************************

/*
 * ОШИБКИ UART НА ПРИЁМЕ (24.09).
 *
 * Драйвер ESP32 сам классифицирует сбои приёма, и это ровно то, что нужно,
 * чтобы понять, где ломается 3 Мбод на плече «модуль приёмника -> ESP32»:
 *   FIFO_OVF    — аппаратный FIFO переполнился: прерывание опоздало (задержка);
 *   BUFFER_FULL — переполнилось наше кольцо на 16 КБ: цикл не успевает;
 *   FRAME       — неверный стоповый бит: сбой на уровне битов (линия, тайминг);
 *   BREAK       — линия надолго прижата к нулю.
 * Ноль по всем при мусоре на входе означает, что байты испорчены ещё ДО этого
 * плеча — на стороне камеры.
 *
 * Счётчики уходят в META-запись (ключи u_ovf, u_bfull, u_frame, u_brk) и
 * оттуда в CSV просмотрщика.
 */
static volatile uint32_t u_err_ovf = 0, u_err_bfull = 0, u_err_frame = 0,
                         u_err_par = 0, u_err_brk = 0;

static void onUartError(hardwareSerial_error_t e)
{
    switch (e) {
    case UART_FIFO_OVF_ERROR:    u_err_ovf++;   break;
    case UART_BUFFER_FULL_ERROR: u_err_bfull++; break;
    case UART_FRAME_ERROR:       u_err_frame++; break;
    case UART_PARITY_ERROR:      u_err_par++;   break;
    case UART_BREAK_ERROR:       u_err_brk++;   break;
    default: break;
    }
}

/*
 * ПРИЁМ ПОТОКА: блочное чтение и развязка с USB.
 *
 * 24.09. На 3 Мбод приём развалился: 0 собранных кадров, 73.5% потерь чанков,
 * 3.7 МБ мусора за 7 минут. На 1 Мбод та же сборка давала 0.197% потерь.
 * Разница втрое по скорости — и полный отказ.
 *
 * Прежний цикл делал на КАЖДЫЙ байт вызов SerialAT.read() плюс шаг автомата,
 * а на каждый собранный пакет — SerialMon.write() прямо внутри цикла. На
 * 3 Мбод это 300 тысяч итераций в секунду, и любая заминка стоит данных:
 * управления потоком у uart_p2p нет, а один потерянный байт рушит кадрирование
 * и делает мусором весь чанк до следующей синхронизации. Отсюда и 73% при
 * заметно меньшей доле реально потерянных байтов.
 *
 * Что изменено:
 *   1. Читаем блоками по PUMP_BLOCK вместо побайтных вызовов драйвера. Автомат
 *      по-прежнему идёт по байту, но уже по ОЗУ, без накладных расходов вызова.
 *   2. Готовые пакеты копим в очереди и отдаём в USB ПОСЛЕ разгребания, а не
 *      посреди него. Залипание USB (а оно бывает до 100 мс) больше не
 *      останавливает чтение UART.
 *   3. За один вызов забираем не больше PUMP_MAX_BYTES, чтобы loop() не
 *      завис в этой функции навсегда под нагрузкой.
 *
 * Очередь маленькая намеренно: переполнилась — отдаём накопленное сразу.
 * Это возвращает блокировку внутрь цикла, но вчетверо реже.
 */
#define PUMP_BLOCK     512      /* сколько байт забираем у драйвера за раз */
#define PUMP_MAX_BYTES 8192     /* потолок за один вызов pumpStream */
#define PUMP_OUT_MAX   4        /* сколько готовых пакетов копим до выдачи */

static uint8_t  out_buf[PUMP_OUT_MAX][HALOW_P2P_MAX_BODY];
static uint16_t out_len[PUMP_OUT_MAX];
static char     out_type[PUMP_OUT_MAX];   /* 'V' видео или 'L' лог камеры */
static uint32_t airlog_fwd = 0;           /* пакетов лога камеры отдано в USB */
static uint8_t  out_cnt = 0;

static void flushOut(void)
{
    for (uint8_t k = 0; k < out_cnt; k++) {
        usbSendRecord(out_type[k], out_buf[k], out_len[k]);
        if (out_type[k] == HALOW_USB_TYPE_LOG) {
            airlog_fwd++;
            continue;
        }
        frames_fwd++;
        last_video_ms = millis();
    }
    out_cnt = 0;
}

/*
 * ПОДТВЕРЖДЕНИЕ КАДРА (28.09), см. halow_p2p_ack_t. Шлём прямо из разбора, в
 * момент прихода последнего чанка, а не после выдачи в USB: запись в USB
 * может залипнуть до 100 мс, и эта задержка попала бы в замер.
 */
static uint32_t ack_frame_id = 0;   /* кадр, чанки которого сейчас считаем */
static uint16_t ack_got = 0;        /* сколько его чанков принято */
static uint16_t ack_cnt = 0;        /* 05.10: сколько их в кадре, из заголовка */
static uint64_t ack_mask = 0;       /* 05.10: какие пришли, бит i — чанк i; 07.10: 64 бита */
static bool     ack_open = false;   /* 05.10: по ack_frame_id квитанция ещё не ушла */
static uint32_t acks_sent = 0;
static uint32_t acks_late = 0;      /* 05.10: ушли по первому чанку следующего кадра */
static uint8_t  ackpkt[HALOW_P2P_HDR_LEN + sizeof(halow_p2p_ack_t)];
/*
 * 07.10, ГИБРИД FEC + ПОВТОР (см. HARQ в скетче камеры и HALOW_FLAG_PARITY).
 * Данные здесь не восстанавливаем — это делает просмотрщик. Приёмник по маскам
 * считает, какие пропавшие куски закроют пришедшие контрольные, и говорит камере
 * в квитанции: повторять надо только остальные.
 */
static uint8_t  ack_m = 0;          /* контрольных в кадре, из заголовка */
static uint16_t ack_pmask = 0;      /* какие контрольные пришли */
static uint32_t fec_frames = 0;     /* кадров с контрольными */
static uint32_t fec_rec = 0;        /* кусков восстановимо */
static uint32_t fec_saved = 0;      /* кадров стали целыми благодаря FEC */
static uint32_t par_rx = 0;         /* контрольных принято */
static uint32_t resend_rx = 0;      /* повторов принято */

/* Какие пропавшие куски закрывают пришедшие контрольные: в группе g (i % m) пропал ровно один. */
static uint64_t fecRecoverable(uint64_t raw, uint16_t k, uint8_t m, uint16_t pmask)
{
    uint64_t rec = 0;
    for (uint8_t g = 0; g < m && g < 16; g++) {
        if (!(pmask & (1u << g))) {
            continue;
        }
        int miss = -1, nmiss = 0;
        for (uint16_t i = g; i < k && i < 64; i += m) {
            if (!(raw & (1ULL << i))) {
                miss = i;
                nmiss++;
            }
        }
        if (nmiss == 1) {
            rec |= 1ULL << miss;
        }
    }
    return rec;
}

static void sendAck(uint32_t frame_id, uint16_t got, uint16_t cnt, uint64_t mask, bool late)
{
    halow_p2p_ack_t a;
    uint64_t all = cnt >= 64 ? ~0ULL : ((1ULL << cnt) - 1);
    uint64_t rec = ack_m ? fecRecoverable(mask, cnt, ack_m, ack_pmask) : 0;

    if (ack_m) {
        fec_frames++;
        fec_rec += (uint32_t)__builtin_popcountll(rec);
        if ((mask & all) != all && ((mask | rec) & all) == all) {
            fec_saved++;
        }
    }
    a.magic[0] = 'H';
    a.magic[1] = 'L';
    a.magic[2] = 'W';
    a.magic[3] = 'A';
    a.frame_id = frame_id;
    a.chunks_got = got;
    a.chunk_cnt = cnt;
    a.chunk_mask = (uint32_t)(mask | rec);
    a.chunk_mask_hi = (uint32_t)((mask | rec) >> 32);
    a.raw_mask = (uint32_t)mask;
    a.raw_mask_hi = (uint32_t)(mask >> 32);
    a.par_mask = ack_pmask;
    a.fec_m = ack_m;
    a.flags = late ? HALOW_ACK_F_LATE : 0;
    int n = halow_p2p_build(ackpkt, HALOW_P2P_TYPE_ACK,
                            (const uint8_t *)&a, (uint16_t)sizeof(a));
    if (n > 0) {
        SerialAT.write(ackpkt, n);
        acks_sent++;
    }
}

/* Учёт кусков кадра для квитанции; квитанция уходит по флагу «последний». */
static void ackTrack(const halow_app_hdr_t *h)
{
    if (h->frame_id != ack_frame_id || !ack_cnt) {
        /* 05.10: пошёл новый кадр, а по старому квитанции не было —
         * пропал его последний чанк. Шлём её сейчас, с тем, что успело
         * прийти: чанки идут по порядку, больше по старому кадру ничего
         * не придёт. Без этого камера ждёт 0,5–1,5 с и списывает кадр. */
        if (ack_open) {
            sendAck(ack_frame_id, ack_got, ack_cnt, ack_mask, true);
            acks_late++;
        }
        ack_frame_id = h->frame_id;
        ack_got = 0;
        ack_mask = 0;
        ack_cnt = h->chunk_cnt;
        ack_m = HALOW_FEC_M(h->flags);
        ack_pmask = 0;
        ack_open = true;
    }
    if (h->flags & HALOW_FLAG_PARITY) {
        if (h->chunk_idx >= h->chunk_cnt && h->chunk_idx - h->chunk_cnt < 16) {
            ack_pmask |= (uint16_t)(1u << (h->chunk_idx - h->chunk_cnt));
        }
        par_rx++;
    } else {
        uint64_t bit = h->chunk_idx < 64 ? (1ULL << h->chunk_idx) : 0;
        if (!(ack_mask & bit)) {        /* тот же чанк дважды не считаем */
            ack_got++;
            ack_mask |= bit;
        }
    }
    /* 07.10: по флагу «последний»: с FEC последний — контрольный. Старая камера
     * ставит его на последний кусок — то же, что раньше. */
    if ((h->flags & HALOW_FLAG_LAST) && ack_open) {
        sendAck(h->frame_id, ack_got, h->chunk_cnt, ack_mask, false);
        ack_open = false;
    }
}

static void pumpStream(void)
{
    uint8_t  blk[PUMP_BLOCK];
    uint32_t taken = 0;

    out_cnt = 0;
    while (taken < PUMP_MAX_BYTES) {
        int avail = SerialAT.available();
        if (avail <= 0) {
            break;
        }
        int want = (avail > (int)sizeof(blk)) ? (int)sizeof(blk) : avail;
        int n = SerialAT.readBytes(blk, want);
        if (n <= 0) {
            break;
        }
        taken += (uint32_t)n;

        for (int i = 0; i < n; i++) {
            if (!halow_p2p_rx_byte(&rx, blk[i])) {
                continue;
            }
            if (rx.type == HALOW_P2P_TYPE_LOG && rx.len >= 2) {
                /* Лог камеры по воздуху (AIR_LOG в скетче камеры): в USB как
                 * есть, той же очередью, что видео, — не из разбора. */
                if (out_cnt >= PUMP_OUT_MAX) {
                    flushOut();
                }
                memcpy(out_buf[out_cnt], rx.body, rx.len);
                out_len[out_cnt] = (uint16_t)rx.len;
                out_type[out_cnt] = HALOW_USB_TYPE_LOG;
                out_cnt++;
                continue;
            }
            if (rx.type != HALOW_P2P_TYPE_VIDEO || rx.len < HALOW_APP_HDR_LEN) {
                continue;
            }

            // Тело уже проверено по CRC и по формату совпадает с тем, что раньше
            // вычленялось из "+RXDATA": halow_app_hdr_t + кусок JPEG. Отдаём как есть.
            uint16_t payload_len = (uint16_t)rx.body[HALOW_APP_OFF_PAYLOAD_LEN] |
                                   ((uint16_t)rx.body[HALOW_APP_OFF_PAYLOAD_LEN + 1] << 8);
            if ((uint32_t)HALOW_APP_HDR_LEN + payload_len != rx.len) {
                continue;   // длина внутри заголовка не сходится с длиной пакета
            }

            memcpy(&last_frame_id, rx.body + 4, 4);   // frame_id идёт сразу за magic

            halow_app_hdr_t h;
            memcpy(&h, rx.body, HALOW_APP_HDR_LEN);
            if (h.flags & HALOW_FLAG_RESEND) {
                /* 07.10: повтор по квитанции (гибрид) — досылка старого кадра. В USB
                 * как есть, учёт текущего кадра для квитанции не трогает. */
                resend_rx++;
            } else {
                ackTrack(&h);
            }

            if (out_cnt >= PUMP_OUT_MAX) {
                flushOut();                            // очередь полна
            }
            memcpy(out_buf[out_cnt], rx.body, rx.len);
            out_len[out_cnt] = (uint16_t)rx.len;
            out_type[out_cnt] = HALOW_USB_TYPE_VIDEO;
            out_cnt++;
        }
    }
    flushOut();
}

// Обратный канал: рассказываем камере, что доехало. На прозрачной прошивке это
// единственная обратная связь — подтверждений на уровне UART нет.
static void sendStat(void)
{
    halow_p2p_stat_t s;

    s.magic[0] = 'H';
    s.magic[1] = 'L';
    s.magic[2] = 'W';
    s.magic[3] = 'S';
    s.pkts_ok = rx.n_ok;
    s.pkts_crc_err = rx.n_crc_err;
    s.frames_done = frames_fwd;
    s.last_frame_id = last_frame_id;

    int n = halow_p2p_build(txpkt, HALOW_P2P_TYPE_STAT,
                            (const uint8_t *)&s, (uint16_t)sizeof(s));
    if (n > 0) {
        SerialAT.write(txpkt, n);
    }
}

//************************************[ СТАРТОВОЕ ОКНО ]*********************************


// Одна команда в стартовом окне: послать и показать ответ модуля.
// wait_ms — сколько ждать ответа. 300 мс хватает почти всем, но AT+SYSCFG
// вываливает два десятка строк, и на 300 мс его ответ обрезается посередине.
static String atWindowCmdWait(const char *cmd, uint16_t wait_ms)
{
    while (SerialAT.available()) {
        SerialAT.read();
    }
    SerialAT.print(cmd);

    /* Вычёрпываем ВО ВРЕМЯ ожидания, а не после: длинный ответ иначе не
     * помещается в приёмный буфер драйвера и теряет хвост. */
    String resp;
    uint32_t t0 = millis();
    while (millis() - t0 < wait_ms) {
        while (SerialAT.available()) {
            resp += (char)SerialAT.read();
        }
        delay(2);
    }
    resp.trim();
    String echo(cmd);
    echo.trim();                 // без хвостового CRLF, иначе лог лесенкой
    if (!resp.length()) {
        SerialMon.printf("  %s -> (нет ответа)\n", echo.c_str());
    } else if (resp.indexOf('\n') < 0) {
        SerialMon.printf("  %s -> %s\n", echo.c_str(), resp.c_str());
    } else {
        SerialMon.printf("  %s ->\n", echo.c_str());
        SerialMon.println(resp);
    }
    return resp;
}

static String atWindowCmd(const char *cmd)
{
    return atWindowCmdWait(cmd, 300);
}

/*
 * Вытащить целое число после последнего '=' в ответе модуля.
 *
 * Ответы устроены единообразно: "+BGRSSI_MARGIN:bgrssi margin= 20",
 * "+SET_BGRSSI:background rssi= -85". Возвращает AT_VALUE_UNKNOWN, если ответа
 * не было или числа в нём нет, — и это тоже полезное значение: в CSV будет
 * видно, что команда осталась без ответа.
 */
#define AT_VALUE_UNKNOWN (-32768)

static int atValueAfterEq(const String &resp)
{
    int pos = resp.lastIndexOf('=');
    if (pos < 0) {
        return AT_VALUE_UNKNOWN;
    }
    String tail = resp.substring(pos + 1);
    tail.trim();
    if (!tail.length()) {
        return AT_VALUE_UNKNOWN;
    }
    /* Отрезаем всё после числа: дальше может идти перевод строки и "OK". */
    int end = 0;
    if (tail[0] == '-' || tail[0] == '+') {
        end = 1;
    }
    while (end < (int)tail.length() && isdigit((unsigned char)tail[end])) {
        end++;
    }
    if (end == 0 || (end == 1 && !isdigit((unsigned char)tail[0]))) {
        return AT_VALUE_UNKNOWN;
    }
    return tail.substring(0, end).toInt();
}

static void useAtWindow(void)
{
#if USE_AT_WINDOW
    /*
     * AT+AP_PSMODE=0 — выключаем энергосбережение точки доступа.
     *
     * 15.08: в потоке раз в 20-35 секунд появляется провал на 2-3 секунды, а
     * следом пачка на 45 КБ/с — это ровно потолок линии 460800. Выше провода
     * данные идти не могут, значит они копятся и вываливаются разом. Копятся в
     * самом модуле: у него skbpool 178 КБ, а по балансу накапливается около 80.
     * Ничего при этом не теряется (crc_err 0), но задержка скачет, а для видео
     * это хуже, чем ровная потеря.
     *
     * В загрузочном логе модуля трижды печатается "ap_psmode enable" — режим
     * энергосбережения AP включён по умолчанию. Он и паркует радио. Проверяем,
     * он ли: если провалы исчезнут — да.
     * Если нет, следующий подозреваемый — сторож RF (rf_reboot, в логах без
     * линка срабатывал ровно раз в 60 с).
     */
#if AT_WINDOW_LOGCFG && QUIET_MODULE
    const char *cmds[] = {
        /* Не глушим LMAC, а разрежаем: netlog в прошивке модуля выключен,
         * так что печать больше ничего не стоит, зато в логе видно buf/sq
         * и события подключения прямо во время окна. */
        "AT+PRINT_PERIOD=10\r\n",
        "AT+SYSDBG=WNB,0\r\n",
    };
#endif
#if SET_MCAST || CCA_MARGIN_DB
    char buf[48];
#endif

#if CCA_MARGIN_DB
    /* Первым делом: до этой команды точка доступа физически не может ответить
     * на запрос подключения. Подробности — у объявления CCA_MARGIN_DB. */
    snprintf(buf, sizeof(buf), "AT+BGRSSI_MARGIN=%d\r\n", CCA_MARGIN_DB);
    atWindowCmd(buf);
    /*
     * Читаем обратно и ЗАПОМИНАЕМ. Значение уезжает в метрики и попадает в CSV
     * каждой строки прогона.
     *
     * 01.09: прогон дал отказ связи, и выяснилось, что сказать, применился ли
     * margin, невозможно — строка о нём печатается в первые секунды, а её съел
     * просмотрщик, подключённый сразу. Отличить «правка не помогла» от «правка
     * не применилась» было нечем. Теперь это видно из любой строки CSV.
     */
    ap_margin = atValueAfterEq(atWindowCmd("AT+BGRSSI_MARGIN=?\r\n"));
    ap_bgr    = atValueAfterEq(atWindowCmd("AT+SET_BGRSSI=?\r\n"));
    SerialMon.printf("  ЗАПОМНЕНО: margin=%d, фон=%d дБм\n", ap_margin, ap_bgr);
#endif

    SerialMon.printf("Стартовое окно (%u с): запись %s, чтение %s\n",
                     (unsigned)(P2P_WINDOW_MS / 1000),
                     AT_WINDOW_WRITE ? "ВКЛ" : "выкл",
                     AT_WINDOW_READ ? "вкл" : "выкл");

#if AT_WINDOW_LOGCFG && QUIET_MODULE
    for (unsigned i = 0; i < sizeof(cmds) / sizeof(cmds[0]); i++) {
        atWindowCmd(cmds[i]);
    }
#endif

#if AT_WINDOW_WRITE
    /*
     * AT+AP_PSMODE=0 — выключение энергосбережения точки доступа.
     *
     * 27.08: убрано из штатного прогона. Команда зовёт syscfg_save()
     * (sdk/lib/common/atcmd.c:858), то есть ПИШЕТ ВО ФЛЕШ при каждой загрузке,
     * а значение и так сохраняется — ставить его каждый раз незачем.
     * Задать один раз: tools/halow_at.py setup --ap-psmode, проверить чтением
     * AT+AP_PSMODE=? в блоке ниже.
     */
    atWindowCmd("AT+AP_PSMODE=0\r\n");
#endif

    /* Широковещательный тракт — им идёт видео. Ставим каждый раз:
     * эти параметры, судя по всему, не переживают перезагрузку. */
#if SET_MCAST
    snprintf(buf, sizeof(buf), "AT+MCAST_BW=%d\r\n", MCAST_BW);
    atWindowCmd(buf);
    snprintf(buf, sizeof(buf), "AT+MCAST_MCS=%d\r\n", MCAST_MCS);
    atWindowCmd(buf);
#endif
#if TX_PWR_AUTO >= 0 && (SET_MCAST || CCA_MARGIN_DB)
    /* До PWRCTL: иначе заданная регулятором мощность перекрывается. */
    snprintf(buf, sizeof(buf), "AT+TX_PWR_AUTO=%d\r\n", (int)TX_PWR_AUTO);
    atWindowCmd(buf);
    atWindowCmd("AT+TX_PWR_AUTO=?\r\n");
#endif
#if PWRCTL_MODE >= 0 && (SET_MCAST || CCA_MARGIN_DB)
    /* Ответ «+PWRCTL:... pwr=N» — стартовая мощность модуля приёмника. */
    snprintf(buf, sizeof(buf), "AT+PWRCTL=%d,%d,%d,%d\r\n",
             (int)PWRCTL_MODE, (int)PWRCTL_LO, (int)PWRCTL_HI, (int)PWRCTL_MAX);
    atWindowCmd(buf);
    atWindowCmd("AT+TXPOWER=?\r\n");
#endif
#if CCA_SW_S > 0 && CCA_MARGIN_DB
    /* 06.10: чередование запаса CCA, см. CCA_SW_S. Отсчёт фазы — от ответа модуля. */
    snprintf(buf, sizeof(buf), "AT+CCASW=%d,%d,%d\r\n",
             (int)CCA_SW_S, (int)CCA_MARGIN_DB, (int)CCA_SW_ALT);
    if (atWindowCmd(buf).indexOf("+CCASW:period=") >= 0) {
        cca_sw_t0 = millis();
        if (!cca_sw_t0) cca_sw_t0 = 1;
        SerialMon.printf("  CCASW: запас %d / %d дБ, по %d с\n",
                         (int)CCA_MARGIN_DB, (int)CCA_SW_ALT, (int)CCA_SW_S);
    } else {
        SerialMon.println("  CCASW: модуль команду не знает — запас постоянный");
    }
#endif
#if BSS_BW_SET > 0 || CHAN_SET > 0
    {
        /* Ответы: "+BSS_BW:4", "+CHAN_LIST:8660". Пишем, только если прочли. */
        char cb[40];
        String r = atWindowCmd("AT+BSS_BW=?\r\n");
        int k = r.indexOf("+BSS_BW:");
        int bw = k >= 0 ? r.substring(k + 8).toInt() : -1;
        r = atWindowCmd("AT+CHAN_LIST=?\r\n");
        k = r.indexOf("+CHAN_LIST:");
        int ch = k >= 0 ? r.substring(k + 11).toInt() : -1;
        bool wrote = false;
        if (BSS_BW_SET > 0 && bw > 0 && bw != BSS_BW_SET) {
            snprintf(cb, sizeof(cb), "AT+BSS_BW=%d\r\n", (int)BSS_BW_SET);
            atWindowCmd(cb);
            wrote = true;
        }
        if (CHAN_SET > 0 && ch > 0 && ch != CHAN_SET) {
            snprintf(cb, sizeof(cb), "AT+CHAN_LIST=%d\r\n", (int)CHAN_SET);
            atWindowCmd(cb);
            wrote = true;
        }
        SerialMon.printf("КАНАЛ: в модуле %d МГц на %d.%d МГц%s\n", bw, ch / 10, ch % 10,
                         wrote ? " — ЗАПИСАН НОВЫЙ, действует со следующего включения питания"
                               : (bw > 0 ? " — как задано" : " — не прочитан"));
    }
#endif

#if AT_WINDOW_READ
    /* Паспорт прогона со стороны модуля: конфигурация целиком, одной командой.
     * Попадает в консольный лог и подшивается к прогону (tools/run_passport.py).
     * Ничего не меняет. */
    String syscfg = atWindowCmdWait("AT+SYSCFG\r\n", 2000);
#if PEER_UNICAST
    /*
     * 05.10: ОБРАТНЫЙ КАНАЛ АДРЕСНО, когда модуль приёмника — клиент (опыт
     * «камера — точка доступа»). Квитанции «всем» от клиента в эфире всё равно
     * идут точке адресно, с «принял» и повторами, но точка ещё и пересылает
     * каждую всем — лишний эфир и столкновения с видео. Адресуем камере.
     * Её MAC — bssid из AT+SYSCFG: модуль хранит его с прошлого подключения
     * (у камеры 05.10 так и было — bssid приёмника и в роли точки), поэтому он
     * известен и до того, как камера включилась. У точки доступа bssid нулевой —
     * тогда остаёмся «всем», как всегда.
     */
    {
        int m = syscfg.indexOf("mode:");
        bool sta = m >= 0 && syscfg.substring(m + 5, m + 8) == "sta";
        int at = syscfg.indexOf("bssid:");
        String bssid = at >= 0 ? syscfg.substring(at + 6, at + 6 + 17) : String();
        bssid.trim();
        /* 06.10: после перепрошивки модуля bssid в конфигурации нулевой, хотя модуль
         * тут же подключается к камере (опыт swap4 пошёл с квитанциями «всем»). MAC
         * камеры есть и в списке пары («Pair STAs: STA0 <mac>») — берём оттуда. */
        int ps = syscfg.indexOf("STA0 ");
        String pair = ps >= 0 ? syscfg.substring(ps + 5, ps + 5 + 17) : String();
        pair.trim();
        bool bssid_ok = bssid.length() == 17 && !bssid.startsWith("00:00:00:00:00:00");
        bool pair_ok = pair.length() == 17 && !pair.startsWith("00:00:00:00:00:00");
        if (!sta) {
            SerialMon.println("  P2PDEST: модуль — точка доступа, квитанции «всем»");
        } else if (!bssid_ok && !pair_ok) {
            SerialMon.printf("  P2PDEST: ни bssid (%s), ни пары — квитанции «всем»\n", bssid.c_str());
        } else {
            char pb[48];
            snprintf(pb, sizeof(pb), "AT+P2PDEST=%s\r\n", bssid_ok ? bssid.c_str() : pair.c_str());
            if (!bssid_ok) {
                SerialMon.printf("  P2PDEST: bssid нулевой, адрес из списка пары %s\n", pair.c_str());
            }
            atWindowCmd(pb);
        }
    }
#endif
    atWindowCmd("AT+ENCRYPT=?\r\n");
    atWindowCmd("AT+SSID=?\r\n");
    atWindowCmd("AT+AP_PSMODE=?\r\n");
#endif

#if AT_WINDOW_WRITE && LINK_DIAG
    /*
     * ШИФРОВАНИЕ ВЫКЛЮЧАЕМ.
     *
     * 20.08: платы перестали сходиться. Приёмник станцию видит и номер ей
     * выдаёт (add_STA, aid=1), а дальше рукопожатие WPA умирает на первом же
     * сообщении: "WPA: sending 1/4 msg of 4-Way Handshake" -> "EAPOL-Key
     * timeout". В логе модуля при этом мелькает "lmac error!!! ccmp_err ...
     * keylen= 0(0)" — ключи ставятся криво.
     *
     * Без шифрования рукопожатия нет вовсе, а значит нет и места, где мы
     * спотыкаемся. Документация проекта и так описывает стенд без шифрования;
     * это приводит железо в соответствие с ней. Ключ в модуле остаётся, вернуть
     * можно командой AT+ENCRYPT=1.
     *
     * ВАЖНО: ставить на ОБЕИХ платах, иначе не сойдутся тем более.
     */
    /*
     * ШИФРОВАНИЕ УЖЕ ВЫКЛЮЧЕНО И СОХРАНЕНО ВО ФЛЕШ (24.08), поэтому команду
     * AT+ENCRYPT=0 здесь больше не шлём — только читаем.
     *
     * 25.08: выяснилось, что она не безобидна. На точке доступа она пересобирает
     * ключи и дёргает интерфейс (в логе: AP set KEYMGMT=4, del gtk,
     * WPA_COMPLETED -> WPA_INTERFACE_DISABLED -> WPA_COMPLETED), да ещё и пишет
     * во флеш при каждой загрузке. Всё это происходит на второй секунде жизни
     * модуля — ровно тогда, когда камера пытается ассоциироваться.
     */
    /*
     * 26.08: ВРЕМЕННО возвращена запись ENCRYPT=0.
     *
     * Днём включил шифрование командой AT+ENCRYPT=1, проверяя версию про ключи,
     * и не вернул обратно. Итог виден в логе точки доступа: камера
     * ассоциируется на третьей секунде (add_STA, aid=1, sta_cnt=1), дальше идёт
     * "WPA: start authentication" — и к десятой секунде станции уже нет.
     * Рукопожатие не проходит, ровно как ловили раньше по EAPOL-Key timeout.
     *
     * Пишется во флеш, хватит одной загрузки. После подтверждения строку убрать:
     * на живой точке доступа команда дёргает интерфейс и пересобирает ключи.
     */
    /*
     * 27.08: убрана из штатного прогона (AT_WINDOW_WRITE=0) — именно она и была
     * тем, что роняет интерфейс на второй секунде. После AT+LOADDEF обе платы
     * получают одинаковые заводские ключи, и выключать шифрование не нужно
     * вовсе. Текущее состояние читается выше через AT+ENCRYPT=?.
     */
    atWindowCmd("AT+ENCRYPT=0\r\n");
#endif
#endif
}

//************************************[ OLED ]*******************************************

static bool oled_init(void)
{
    Wire.beginTransmission(0x3C);
    if (Wire.endTransmission() != 0) {
        return false;
    }
    return display.begin(SSD1306_SWITCHCAPVCC, 0x3C);
}

static void oled_show(void)
{
    if (!oled_ok) {
        return;
    }
    bool alive = (millis() - last_video_ms) < 3000;

    display.clearDisplay();
    display.setTextSize(1);
    display.setTextColor(SSD1306_WHITE);
    display.setCursor(0, 0);
    display.println("T-Halow RX (p2p)");
    display.println("---------------------");

    if (!streaming) {
        display.println("стартовое окно...");
    } else if (alive) {
        display.printf("пакетов: %lu\n", (unsigned long)rx.n_ok);
        display.printf("CRC-брак: %lu\n", (unsigned long)rx.n_crc_err);
        display.printf("в USB   : %lu\n", (unsigned long)frames_fwd);
    } else {
        display.println("нет потока");
        display.printf("CRC-брак: %lu\n", (unsigned long)rx.n_crc_err);
    }
    display.display();
}

//************************************[ ARDUINO ]****************************************

void setup()
{
    SerialMon.begin(115200);   // USB CDC: скорость номинальна, поток идёт на полной
    /* Ограничиваем ожидание при записи в USB. По умолчанию оно становится
     * 100 мс после первого подключения хоста, а до него равно нулю; задаём явно,
     * чтобы поведение не зависело от того, подключался ли кто-нибудь. Нет
     * читателя — запись отбрасывается, но НЕ блокирует главный цикл.
     * Ждать опустошения (flush) нельзя вовсе, см. halow_mon_settle(). */
    SerialMon.setTxTimeoutMs(AP_USB_STREAM ? 100 : 0);   /* 0: без хоста не ждать, см. AP_USB_STREAM */
    delay(2000);

    SerialMon.println();
    SerialMon.println("=== T-Halow: приёмник (AP), прозрачный режим ===");

    Wire.begin(BOARD_I2C_SDA, BOARD_I2C_SCL);

    /*
     * Буфер приёма от модуля. Считать его надо не в байтах, а во времени:
     * сколько миллисекунд loop() может не выгребать его, не теряя байт.
     *
     *      230400 бод -> 23 КБ/с, 4096 байт = 178 мс
     *      384000 бод -> 38 КБ/с, 4096 байт = 107 мс   <- было бы вдвое меньше
     *      384000 бод -> 38 КБ/с, 16384 байт = 426 мс
     *
     * Почему это важно именно сейчас. Судить об успехе перехода на 384000
     * мы собираемся по ap_crc_err и ap_junk. Но переполнение ЭТОГО буфера
     * даёт ровно ту же подпись, что и переполнение кольца модуля: пропавшие
     * посреди кадра байты, потеря синхронизации, мусор. Различить их по
     * счётчикам нельзя, поэтому свой буфер надо заведомо вывести из-под
     * подозрения заранее — иначе замер не ответит на свой вопрос.
     *
     * Плата приёмника без камеры и кодировщика, внутренней памяти вдоволь,
     * так что 16 КБ здесь ничего не стоят.
     */
    SerialAT.setRxBufferSize(16384);
    SerialAT.begin(AT_BAUD, SERIAL_8N1, SERIAL_AT_RXD, SERIAL_AT_TXD);
    SerialAT.onReceiveError(onUartError);   // счётчики сбоев приёма, см. выше
    SerialMon.printf("UART к модулю: %u бод (окно), %u бод (поток)\n",
                     (unsigned)AT_BAUD, (unsigned)P2P_BAUD);

    pinMode(BOARD_LED, OUTPUT);
    halow_p2p_rx_init(&rx);

    oled_ok = oled_init();
    SerialMon.printf("OLED: %s\n", oled_ok ? "OK" : "нет");

    useAtWindow();
    oled_show();

    /*
     * Выталкиваем весь загрузочный лог.
     *
     * 25.08: без этого он пропадал целиком. Serial здесь — USB-Serial/JTAG:
     * запись только кладёт байты в кольцо, а выгребает их прерывание. Из-за
     * этого не было видно ни ответов модуля в стартовом окне, ни того,
     * стартовал ли он с новой задержкой, — и судить об исходе проверки
     * оказалось не по чему.
     */
    halow_mon_settle();
}

void loop()
{
    /*
     * Вычитываем и выбрасываем всё, что пришло из USB.
     *
     * Скетч оттуда ничего не ждёт, но НЕ читать нельзя: входной буфер USB
     * переполняется, и плата перестаёт принимать байты вообще. Тогда до неё не
     * достучаться даже загрузчиком — esptool упирается в "Write timeout" и
     * заливка не идёт, пока плату не обесточишь. 20.08 это случилось трижды за
     * день, каждый раз на приёмнике, и каждый раз лечилось выдёргиванием USB.
     */
    /* Пока окно открыто — строки "AT+..." с USB уходят модулю (смена полосы
     * без перепрошивки, см. halow_usb_at_console). После — выбрасываем, но
     * читать обязаны: иначе входной буфер USB переполнится и плата перестанет
     * прошиваться. */
    if (halow_usb_at_console(SerialMon, SerialAT, !streaming)) {
        delay(400);
        while (SerialAT.available()) {
            SerialMon.write((uint8_t)SerialAT.read());
        }
        SerialMon.println();
    }

    // Главное дело — непрерывно вычёрпывать UART. Всё остальное вторично.
    pumpStream();

    /*
     * ПРОВЕРКА, КАКАЯ ПРОШИВКА МОДУЛЯ РЕАЛЬНО РАБОТАЕТ.
     *
     * 24.08 модулю залита сборка с задержкой прозрачного режима 30 с вместо 8.
     * Но заливка идёт во ВТОРОЙ слот, а какой из двух активен при конкретной
     * загрузке — мы ни разу не проверяли. Если модуль поднимет старую сборку,
     * поведение будет ровно тем, что мы видим: то связь встаёт, то нет.
     *
     * Различить просто. На пятнадцатой секунде жизни модуля:
     *   AT отвечает  -> работает НОВАЯ сборка (окно ещё открыто, 30 с)
     *   AT молчит    -> работает СТАРАЯ (её окно закрылось на восьмой)
     */
    if (!p2p_probe_done && millis() > 15000) {
        p2p_probe_done = true;
        SerialMon.println("ПРОБА 15с: AT должен отвечать, если модуль с новой прошивкой");
        atWindowCmd("AT+VERSION\r\n");
        halow_mon_settle();
    }

    if (!streaming) {
        if (millis() < P2P_WINDOW_MS) {
    /*
     * ОПРОС СТАНЦИЙ, пока идёт стартовое окно.
     *
     * Модуль в это время ещё понимает AT, но МОЛЧИТ: мы сами глушим его печать
     * командой AT+SYSDBG=LMAC,0, иначе его лог утекал бы в сеть и выедал буферы.
     * Значит слушать его бесполезно — надо спрашивать.
     *
     * AT+STA_INFO показывает, кто ассоциирован с точкой доступа. Раз в пять
     * секунд этого достаточно, чтобы поймать момент подключения камеры и
     * отделить «она не подключилась» от «подключилась, но данные не идут» —
     * различить это иначе мы третий день не можем.
     */
    if (millis() - sta_poll_tick > 5000) {
        sta_poll_tick = millis();
        SerialMon.printf("[%lu с] ", (unsigned long)(millis() / 1000));
        /* Читать надо через "=?": без аргумента модуль отвечает ERROR.
         * AT+RSSI=? нагляднее всего: 0 — связи нет, число — есть. */
        atWindowCmd("AT+STA_INFO=?\r\n");
        atWindowCmd("AT+RSSI=?\r\n");
        halow_mon_settle();
    }

    /*
     * ЭХО МОДУЛЯ на время стартового окна.
     *
     * 25.08: пока окно открыто, модуль ещё разговаривает по AT и печатает свои
     * события — в том числе add_STA, состояния WPA и выдачу адреса. Раньше эти
     * строки молча съедал pumpStream (для него это мусор), и мы были слепы
     * ровно там, где ломается связь.
     *
     * Печатать их стало безопасно только теперь: в прошивке модуля выключен
     * netlog, и лог больше не уходит в сеть недоставляемыми пакетами. До этого
     * включение печати забивало очередь отправки и само же ломало подключение.
     *
     * После закрытия окна модуль немеет — эхо прекращается само.
     */
    while (SerialAT.available()) {
        int c = SerialAT.read();
        if (c >= 0) {
            SerialMon.write((uint8_t)c);
        }
    }
    halow_mon_settle();

            delay(5);
            return;
        }
        streaming = true;
        /*
         * РЕШАЮЩАЯ ПРОБА. Окно закрылось — значит в прошивке шага 3 модуль уже
         * забрал UART себе, и AT-команда обязана остаться БЕЗ ОТВЕТА.
         * Спрашиваем на 115200, до переключения скорости.
         *
         * Ответил -> модуль в AT-режиме, прозрачный режим не стартовал. Тогда
         * всё, что мы пишем дальше, уходит не в эфир, а в разборщик AT-команд,
         * и на той стороне не появится ни байта — ровно то, что мы наблюдаем.
         */
#if LINK_DIAG
        SerialMon.println("ПРОБА: AT после окна — ответа быть НЕ должно");
        atWindowCmd("AT+VERSION\r\n");
#endif
        if (P2P_BAUD != AT_BAUD) {
            SerialAT.updateBaudRate(P2P_BAUD);
        }
        halow_p2p_rx_init(&rx);   // выкидываем накопленный загрузочный лог модуля
        stat_tick = meta_tick = millis();
#if BAUD_HUNT
        hunt_tick = millis();
        hunt_bytes = 0;
#endif
        SerialMon.println("Окно закрыто, слушаю поток");
    }

#if BAUD_HUNT
    if (!hunt_done && millis() - hunt_tick > HUNT_STEP_MS) {
        if (hunt_bytes) {
            hunt_done = true;
            SerialMon.printf("СКОРОСТЬ НАЙДЕНА: %u бод, получено %lu байт\n",
                             (unsigned)hunt_bauds[hunt_idx], (unsigned long)hunt_bytes);
        } else {
            hunt_idx = (uint8_t)((hunt_idx + 1) % (sizeof(hunt_bauds) / sizeof(hunt_bauds[0])));
            SerialAT.updateBaudRate(hunt_bauds[hunt_idx]);
            halow_p2p_rx_init(&rx);
            SerialMon.printf("ПОИСК СКОРОСТИ: тишина, пробую %u бод\n",
                             (unsigned)hunt_bauds[hunt_idx]);
            halow_mon_settle();
        }
        hunt_bytes = 0;
        hunt_tick = millis();
    }
#endif

    if (millis() - stat_tick > STAT_PERIOD_MS) {
        stat_tick = millis();
        sendStat();
    }

    if (millis() - meta_tick > META_PERIOD_MS) {
        meta_tick = millis();

        bool alive = (millis() - last_video_ms) < 3000;

        // Метрики в просмотрщик. Ключи conn/rssi те же, что были — halow_viewer.py
        // читает именно их. rssi=0 просмотрщик показывает прочерком, что честно:
        // на прозрачной прошивке спросить его не у кого.
        char js[320];
        int n = snprintf(js, sizeof(js),
                         "{\"role\":\"ap\",\"conn\":%d,\"rssi\":0,\"fwd\":%lu,"
                         "\"ok\":%lu,\"crc_err\":%lu,\"len_err\":%lu,\"junk\":%lu,"
                         "\"margin\":%d,\"bgr\":%d,\"u_ovf\":%lu,\"u_bfull\":%lu,\"u_frame\":%lu,\"u_brk\":%lu}",
                         alive ? 1 : 0, (unsigned long)frames_fwd,
                         (unsigned long)rx.n_ok, (unsigned long)rx.n_crc_err,
                         (unsigned long)rx.n_len_err, (unsigned long)rx.n_junk,
                         ccaMarginNow(), ap_bgr,
                         (unsigned long)u_err_ovf, (unsigned long)u_err_bfull,
                         (unsigned long)u_err_frame, (unsigned long)u_err_brk);
        usbSendRecord(HALOW_USB_TYPE_META, (const uint8_t *)js, (uint16_t)n);

        /*
         * Текстовая диагностика для обычного монитора порта. Как читать:
         *   ok не растёт, junk растёт  — байты идут, но кадрирования в них нет.
         *                                Скорее всего STA ещё в стартовом окне,
         *                                либо у плат разные UART_P2P_BAUDRATE.
         *   ok не растёт, junk не растёт — из модуля вообще ничего не идёт:
         *                                нет линка, или прозрачный режим не
         *                                стартовал (проверь, что залита сборка
         *                                шага 3, а не шага 2).
         *   ok растёт, crc_err растёт  — байты теряются. Первый подозреваемый —
         *                                переполнение кольца модуля: снизить
         *                                скорость потока или размер кадра.
         */
        SerialMon.printf("DIAG conn=%d ok=%lu crc_err=%lu len_err=%lu junk=%lu "
                         "fwd=%lu frame=%lu ack=%lu log=%lu ack_late=%lu cca=%d "
                         "fec=%lu fec_rec=%lu fec_saved=%lu par=%lu resend=%lu\n",
                         alive ? 1 : 0,
                         (unsigned long)rx.n_ok, (unsigned long)rx.n_crc_err,
                         (unsigned long)rx.n_len_err, (unsigned long)rx.n_junk,
                         (unsigned long)frames_fwd, (unsigned long)last_frame_id,
                         (unsigned long)acks_sent, (unsigned long)airlog_fwd,
                         (unsigned long)acks_late, ccaMarginNow(),
                         (unsigned long)fec_frames, (unsigned long)fec_rec,
                         (unsigned long)fec_saved, (unsigned long)par_rx,
                         (unsigned long)resend_rx);

        halow_mon_settle();   // строка DIAG должна доезжать сразу, а не копиться

        led_state = !led_state;
        digitalWrite(BOARD_LED, alive ? led_state : LOW);
        oled_show();
    }
}
