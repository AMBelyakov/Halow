#pragma once

#include <stdint.h>
#include <string.h>
#include "halow_proto.h"

/*
 * Кадрирование потока для прозрачного режима (uart_p2p) прошивки 2.4.1.3.
 *
 * ЧЕМ ЭТО ОТЛИЧАЕТСЯ ОТ halow_proto.h
 * Там пакет собирался как готовый Ethernet+IPv4+UDP кадр, потому что AT+TXDATA
 * принимает именно кадр, а не сырые данные. Здесь ничего этого не нужно: модуль
 * отдаёт байты как есть, а UDP он строит себе сам внутри (uart_p2p_task зовёт
 * net_setup_udpdata). 62 байта служебных заголовков на пакет превращаются в 7.
 *
 * ЗАЧЕМ ВООБЩЕ СВОЁ КАДРИРОВАНИЕ, ЕСЛИ ЕСТЬ UDP
 * Прозрачный режим не сохраняет границы записей. Модуль режет поток по своим
 * правилам: по паузе на линии или по заполнению внутреннего кольца. На приёме
 * из UART выходит просто поток байт, без признака "здесь начался новый пакет".
 * Плюс к этому в кольце нет управления потоком — при переполнении байты
 * пропадают молча, а до старта прозрачного режима модуль ещё и печатает в тот
 * же UART свой загрузочный лог. Поэтому:
 *
 *   [0xA5][0x5A][type][len_lo][len_hi][crc_lo][crc_hi][ тело len байт ]
 *
 * Приёмник ищет двухбайтовый маркер, проверяет длину и CRC16 тела. Всё, что не
 * сошлось — мусор от лога модуля, потерянные байты или ложное совпадение
 * маркера — отбрасывается, и разбор продолжается со следующего маркера.
 *
 * Маркер и порядок полей нарочно те же, что у USB-кадрирования в halow_proto.h,
 * чтобы не держать в голове два разных формата. Отличие одно: здесь добавлена
 * CRC, потому что радио и UART теряют байты, а USB — нет.
 */

/*
 * ПОЧЕМУ ЗДЕСЬ НЕТ SerialMon.flush() И ПОЧЕМУ ЕГО НЕЛЬЗЯ ВОЗВРАЩАТЬ
 *
 * Измерено 01.09: закрытие консольного порта вешает плату намертво. Дважды из
 * двух — в одном прогоне камера встала через 70 секунд после того, как порт
 * закрыли и открыли заново, в другом через СЕМЬ секунд после закрытия:
 *
 *     11:24:30  закрылся COM6
 *     11:24:37  conn -> 0, счётчик приёмника замер
 *
 * Причина в самом фреймворке, HWCDC::flush() (HWCDC.cpp:308):
 *
 *     while(uxItemsWaiting){ delay(5); vRingbufferGetInfo(...); }
 *
 * Цикл без ограничения по времени. Консоль на этих платах — USB-Serial/JTAG:
 * запись только кладёт байты в кольцо, выгребает их хост. Пока порт открыт,
 * кольцо пустеет; как только закрыт — не пустеет никогда, и flush() крутится
 * вечно. Главный цикл встаёт, поток прекращается, плата перестаёт отвечать
 * даже загрузчику. Отсюда же половина мучений с заливкой: "Write timeout" и
 * "плата залипла" — та же причина.
 *
 * Проверка `if (SerialMon)` НЕ помогает: HWCDC::operator bool() возвращает
 * initial_empty, который выставляется при первом подключении хоста и при его
 * отключении не сбрасывается. То есть после первого же чтения он навсегда
 * true.
 *
 * А вот write() безопасен: xRingbufferSend с таймаутом tx_timeout_ms (100 мс
 * после подключения хоста, 0 до него). Переполнилось — отбросил и пошёл
 * дальше. Поэтому печатать можно, ждать опустошения нельзя.
 *
 * Замена — halow_mon_settle(): ограниченная пауза вместо неограниченного
 * ожидания. Она даёт прерыванию тот же шанс выгрести кольцо (ровно это и
 * делал delay(5) внутри flush), но не может подвесить плату.
 *
 * Исходная задача, ради которой flush когда-то появился, при этом решается:
 * лог загрузки терялся потому, что конвейер занимал ядро и кольцо не
 * выгребалось. Пауза ядро отдаёт.
 */
/*
 * Величина паузы. 2 мс, а не 8.
 *
 * Первым значением взяли 8 мс — по аналогии с delay(5) внутри flush. Прогон
 * 01.09 показал цену: четырнадцать провалов видео против одного в предыдущем
 * прогоне, и `UART 240 мс` на кадр против 156. Печать статистики идёт четырьмя
 * строками подряд, и на каждой цикл отдавал по 8 мс.
 *
 * Задача паузы — только отдать ядро, чтобы прерывание успело выгрести кольцо;
 * ждать его опустошения не нужно и нельзя. Для этого хватает минимального
 * кванта планировщика.
 */
#ifndef HALOW_MON_SETTLE_MS
#define HALOW_MON_SETTLE_MS 2
#endif

/*
 * Приём AT-команд с USB в стартовом окне.
 *
 * Пока окно открыто, модуль ещё понимает AT, а скетч всё равно молчит. Значит
 * это готовый канал управления: строку "AT+..." с USB пересылаем модулю и
 * печатаем ответ. После закрытия окна — выбрасываем, как и раньше.
 *
 * Зачем понадобилось: серия замеров по ширине канала. AT+BSS_BW пишется во
 * флеш и живёт между перезагрузками, но менять её иначе можно только через
 * сервисный мост — то есть залить мост, поменять, залить скетчи обратно, и так
 * на каждое из четырёх значений. С этим каналом смена полосы это одна строка,
 * посланная в порт, и ни одной перепрошивки.
 *
 * Возвращает true, если строка была командой и её отправили.
 */
static inline bool halow_usb_at_console(Stream &usb, Stream &at, bool window_open)
{
    static char line[64];
    static uint8_t len = 0;

    bool sent = false;
    while (usb.available()) {
        int c = usb.read();
        if (c < 0) {
            break;
        }
        if (!window_open) {
            len = 0;               /* окно закрыто — просто выбрасываем */
            continue;
        }
        if (c == '\r' || c == '\n') {
            if (len >= 3 && line[0] == 'A' && line[1] == 'T' && line[2] == '+') {
                line[len] = 0;
                usb.print("USB->модуль: ");
                usb.println(line);
                at.print(line);
                at.print("\r\n");
                sent = true;
            }
            len = 0;
        } else if (len < sizeof(line) - 1) {
            line[len++] = (char)c;
        } else {
            len = 0;               /* слишком длинная строка — это не команда */
        }
    }
    return sent;
}

static inline void halow_mon_settle(void)
{
    delay(HALOW_MON_SETTLE_MS);
}

#define HALOW_P2P_SYNC0      0xA5
#define HALOW_P2P_SYNC1      0x5A
#define HALOW_P2P_HDR_LEN    7

#define HALOW_P2P_TYPE_VIDEO 'V'   /* тело: halow_app_hdr_t + кусок JPEG */
#define HALOW_P2P_TYPE_STAT  'S'   /* тело: halow_p2p_stat_t, обратный канал AP -> STA */
/*
 * Маячок камеры, пока она ждёт первого отчёта приёмника. Тело — четыре байта
 * 'HLWP', смысла в нём нет: важен сам факт, что в UART модуля что-то пришло.
 *
 * Зачем. В прозрачном режиме модуль строит пакеты из того, что попало в UART.
 * Нет данных — нечего слать, и ассоциацию он не форсирует. Измерено 01.09:
 * камера, заглушённая гейтом WAIT_FOR_HELLO, молчала 240 секунд, а приёмник
 * всё это время показывал RSSI 0 и sta_cnt 0 — то есть не слышал её вовсе, ни
 * одного кадра, при полностью здоровой очереди (buf free=76, sq=0). Отчёт не
 * приходил, гейт не открывался, связь не вставала.
 *
 * То есть «курица и яйцо» здесь всё-таки есть — вопреки тому, что написано в
 * комментарии к WAIT_FOR_HELLO. Разрывается она маячком: несколько десятков
 * байт в секунду вместо 19 килобайт. Модулю есть что передавать и он
 * ассоциируется, а эфир при этом остаётся практически свободным — ради чего
 * гейт и вводился.
 *
 * Приёмник этот тип игнорирует: pumpStream пропускает всё, кроме 'V'.
 */
#define HALOW_P2P_TYPE_PING  'P'

/*
 * Полезная нагрузка на пакет. Ограничение сверху — 1500 байт на кадр в эфире
 * (лимит модуля, см. readme SDK). 1400 + 20 байт прикладного заголовка + 7
 * служебных = 1427, с запасом.
 */
#define HALOW_P2P_MAX_PAYLOAD 1400
#define HALOW_P2P_MAX_BODY    (HALOW_APP_HDR_LEN + HALOW_P2P_MAX_PAYLOAD)
#define HALOW_P2P_PKT_BUF_LEN (HALOW_P2P_HDR_LEN + HALOW_P2P_MAX_BODY)

/*
 * Обратный канал: приёмник раз в секунду отчитывается камере, что он жив и
 * сколько до него доехало. На прозрачной прошивке AT недоступен, а значит нет
 * ни AT+CONN_STATE, ни AT+RSSI — это единственный способ для камеры узнать,
 * что связь есть, и единственный источник статистики потерь.
 */
typedef struct __attribute__((packed)) {
    uint8_t  magic[4];      /* 'H','L','W','S' */
    uint32_t pkts_ok;       /* пакетов принято с целой CRC */
    uint32_t pkts_crc_err;  /* отброшено по CRC — байты потерялись в пути */
    uint32_t frames_done;   /* кадров собрано полностью и отдано в USB */
    uint32_t last_frame_id;
} halow_p2p_stat_t;

/*
 * Подтверждение кадра, AP -> STA (28.09). Приёмник шлёт его сразу, как только
 * разобрал ПОСЛЕДНИЙ чанк кадра, — до выдачи в USB. Передатчик по нему меряет
 * задержку: от конца записи кадра в UART и от момента съёмки до подтверждения.
 *
 * Зачем. «Шторка» 28.09 показала, что при плохом эфире модуль копит очередь на
 * 2–3 с, а передатчик об этом не знает: отчёт 'S' приходит раз в секунду и
 * говорит только «сколько доехало». Подтверждение на каждый кадр — основа для
 * окна кадров в полёте; первым шагом оно только меряет.
 *
 * Если последний чанк потерян, подтверждения на этот кадр не будет вовсе;
 * chunks_got < chunk_cnt — кадр пришёл неполным.
 *
 * 05.10: подтверждение уходит и тогда, когда последний чанк потерян, — по
 * первому чанку следующего кадра (чанки идут по порядку, больше по старому
 * кадру ничего не придёт). И несёт список пришедших чанков chunk_mask: бит i —
 * чанк i (первые 32). Нужен опыту «камера — точка доступа»: там чанки уходят
 * всем без повторов, и пропавший видно только по номеру.
 * Старые сборки шлют и читают первые HALOW_P2P_ACK_LEN_V1 байт; камера
 * проверяет длину не меньше нужной, поэтому новый приёмник со старой камерой
 * совместим, а новая камера принимает оба размера.
 */
#define HALOW_P2P_TYPE_ACK   'A'

typedef struct __attribute__((packed)) {
    uint8_t  magic[4];      /* 'H','L','W','A' */
    uint32_t frame_id;
    uint16_t chunks_got;    /* сколько чанков этого кадра принято с целой CRC */
    uint16_t chunk_cnt;     /* сколько их было в кадре */
    uint32_t chunk_mask;    /* 05.10: какие пришли, бит i — чанк i (первые 32) */
} halow_p2p_ack_t;

#define HALOW_P2P_ACK_LEN_V1 12   /* до 05.10: без chunk_mask */

/*
 * ЛОГ КАМЕРЫ ПО ВОЗДУХУ (28.09), STA -> AP. Тело: uint16_t seq (LE, с нуля
 * на каждой загрузке камеры) + кусок текста консоли камеры, до 1024 байт.
 * Границы строк не соблюдаются — приёмник склеивает куски по порядку, по
 * разрыву seq видно потерю. Приёмник отдаёт тело в USB записью 'L'.
 */
#define HALOW_P2P_TYPE_LOG   'T'

/* CRC16-CCITT (полином 0x1021, начальное 0xFFFF). Побитово: на 1420 байт это
 * около 11 тысяч операций, при 240 МГц незаметно даже на 460800 бод. */
static inline uint16_t halow_crc16(const uint8_t *p, uint16_t len)
{
    uint16_t crc = 0xFFFF;

    while (len--) {
        crc ^= (uint16_t)(*p++) << 8;
        for (uint8_t i = 0; i < 8; i++) {
            crc = (crc & 0x8000) ? (uint16_t)((crc << 1) ^ 0x1021) : (uint16_t)(crc << 1);
        }
    }
    return crc;
}

/*
 * Собирает пакет в out (буфер >= HALOW_P2P_PKT_BUF_LEN).
 * Возвращает полную длину — столько байт и надо записать в UART.
 */
static inline int halow_p2p_build(uint8_t *out, uint8_t type,
                                  const uint8_t *body, uint16_t body_len)
{
    uint16_t crc;

    if (body_len > HALOW_P2P_MAX_BODY) {
        return -1;
    }

    crc = halow_crc16(body, body_len);

    out[0] = HALOW_P2P_SYNC0;
    out[1] = HALOW_P2P_SYNC1;
    out[2] = type;
    out[3] = (uint8_t)(body_len & 0xff);
    out[4] = (uint8_t)(body_len >> 8);
    out[5] = (uint8_t)(crc & 0xff);
    out[6] = (uint8_t)(crc >> 8);
    memcpy(out + HALOW_P2P_HDR_LEN, body, body_len);

    return HALOW_P2P_HDR_LEN + body_len;
}

/* ---------------------- побайтовый разборщик потока ---------------------- */

enum {
    HALOW_P2P_ST_SYNC0 = 0,
    HALOW_P2P_ST_SYNC1,
    HALOW_P2P_ST_TYPE,
    HALOW_P2P_ST_LEN0,
    HALOW_P2P_ST_LEN1,
    HALOW_P2P_ST_CRC0,
    HALOW_P2P_ST_CRC1,
    HALOW_P2P_ST_BODY
};

typedef struct {
    uint8_t  state;
    uint8_t  type;          /* тип последнего собранного пакета */
    uint16_t len;
    uint16_t crc;
    uint16_t got;
    uint8_t  body[HALOW_P2P_MAX_BODY];

    /* Счётчики — это и есть диагностика линка на прозрачной прошивке.
     * n_crc_err растёт => байты теряются (переполнение кольца модуля,
     * слишком высокая скорость UART или плохой радиоканал). */
    uint32_t n_ok;
    uint32_t n_crc_err;
    uint32_t n_len_err;
    uint32_t n_junk;        /* байт выброшено вне пакетов: лог модуля и потери */
} halow_p2p_rx_t;

static inline void halow_p2p_rx_init(halow_p2p_rx_t *r)
{
    memset(r, 0, sizeof(*r));
}

/*
 * Скормить один байт. Возвращает 1, когда в r->body лежит целый проверенный
 * пакет длиной r->len и типом r->type. Иначе 0.
 */
static inline int halow_p2p_rx_byte(halow_p2p_rx_t *r, uint8_t b)
{
    switch (r->state) {
    case HALOW_P2P_ST_SYNC0:
        if (b == HALOW_P2P_SYNC0) {
            r->state = HALOW_P2P_ST_SYNC1;
        } else {
            r->n_junk++;
        }
        break;

    case HALOW_P2P_ST_SYNC1:
        if (b == HALOW_P2P_SYNC1) {
            r->state = HALOW_P2P_ST_TYPE;
        } else if (b == HALOW_P2P_SYNC0) {
            /* 0xA5 0xA5 — второй байт может оказаться началом настоящего
             * маркера, поэтому остаёмся здесь, а не откатываемся в SYNC0. */
            r->n_junk++;
        } else {
            r->n_junk += 2;
            r->state = HALOW_P2P_ST_SYNC0;
        }
        break;

    case HALOW_P2P_ST_TYPE:
        r->type = b;
        r->state = HALOW_P2P_ST_LEN0;
        break;

    case HALOW_P2P_ST_LEN0:
        r->len = b;
        r->state = HALOW_P2P_ST_LEN1;
        break;

    case HALOW_P2P_ST_LEN1:
        r->len |= (uint16_t)b << 8;
        if (r->len > HALOW_P2P_MAX_BODY) {
            /* Почти наверняка ложный маркер внутри мусора. */
            r->n_len_err++;
            r->state = HALOW_P2P_ST_SYNC0;
        } else {
            r->state = HALOW_P2P_ST_CRC0;
        }
        break;

    case HALOW_P2P_ST_CRC0:
        r->crc = b;
        r->state = HALOW_P2P_ST_CRC1;
        break;

    case HALOW_P2P_ST_CRC1:
        r->crc |= (uint16_t)b << 8;
        r->got = 0;
        if (r->len == 0) {
            r->state = HALOW_P2P_ST_SYNC0;
            if (halow_crc16(r->body, 0) == r->crc) {
                r->n_ok++;
                return 1;
            }
            r->n_crc_err++;
        } else {
            r->state = HALOW_P2P_ST_BODY;
        }
        break;

    case HALOW_P2P_ST_BODY:
        r->body[r->got++] = b;
        if (r->got >= r->len) {
            r->state = HALOW_P2P_ST_SYNC0;
            if (halow_crc16(r->body, r->len) == r->crc) {
                r->n_ok++;
                return 1;
            }
            r->n_crc_err++;
        }
        break;

    default:
        r->state = HALOW_P2P_ST_SYNC0;
        break;
    }

    return 0;
}
