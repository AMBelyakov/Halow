/*
 * HalowVideoP2P_STA — плата с камерой, прозрачный режим (uart_p2p).
 *
 * ЧЕМ ОТЛИЧАЕТСЯ ОТ HalowVideo_STA
 * Там каждый кусок кадра уезжал так: пишем в UART "AT+TXDATA=<len>", ждём "OK",
 * шлём len байт, ждём ответ, спим CHUNK_GAP_MS. То есть на каждые ~1.4 КБ данных
 * приходился разбор AT-команды, круговая задержка и фиксированная пауза.
 *
 * Здесь ничего этого нет. Прошивка 2.4.1.3 собрана с SYS_APP_UART_P2P=1, модуль
 * забирает UART1 себе и просто выдаёт всё записанное на другом конце линка.
 * Мы пишем байты — они выходят из UART приёмника. Никакого протокола с модулем.
 *
 * Скорость UART та же, 115200: её поднимает следующий шаг (UART_P2P_BAUDRATE).
 * Выигрыш этого шага — снятие пауз и круговых задержек AT, а не бод.
 *
 * ЧТО ЗА ЭТО ПОТЕРЯНО
 * AT-команд больше нет вообще: uart_p2p_init() делает uart_request_irq и
 * disable_print на том же UART1. Значит недоступны AT+CONN_STATE и AT+RSSI —
 * ни состояния связи, ни RSSI спросить не у кого. Поэтому:
 *   - поле rssi в halow_app_hdr_t всегда 0 (просмотрщик покажет прочерк);
 *   - живость связи определяется по обратному каналу: приёмник раз в секунду
 *     шлёт пакет типа 'S' со своими счётчиками, и это единственный признак,
 *     что нас кто-то слышит.
 * Для замеров RSSI/MCS остаётся сборка шага 2 (SYS_APP_UART_P2P=0), где AT жив.
 *
 * ОКНО ПРИ СТАРТЕ — НЕ ТРОГАТЬ
 * Прозрачный режим включается не сразу, а через UART_P2P_START_DELAY_MS
 * после загрузки модуля. Всё это время UART1 держит atcmd, и туда же модуль
 * печатает загрузочный лог. Окно существует ради AT+NOP2P: это единственный
 * способ вернуть AT-режим и перепрошить модуль, не вынимая флеш (см.
 * SDK/builds/STEP3_2026-08-13.txt). Поэтому первые P2P_WINDOW_MS мс мы молчим.
 *
 * Точное значение задержки зависит от залитой сборки и объявлено ниже
 * как MODULE_P2P_DELAY_MS. Держать его в согласии с прошивкой обязательно:
 * см. предупреждение там же.
 */

#include <Arduino.h>
#include "utilities.h"
#include "esp_camera.h"
#include "driver/ledc.h"      // опыт: остановка такта XCLK сенсора
#include "img_converters.h"   // fmt2jpg() — программное сжатие, сенсор JPEG не отдаёт
#include "esp_jpeg_enc.h"     // esp_new_jpeg — см. NEW_JPEG (путь в platformio.ini)
#include "esp_heap_caps.h"    // heap_caps_malloc() и порог malloc между SRAM и PSRAM
#include "halow_stream.h"
#include <Preferences.h>       // номер шага перебора MCS (MCS_SWEEP)

/*
 * ЛОГ КАМЕРЫ ПО ВОЗДУХУ (28.09): 1 — всё, что камера печатает в консоль,
 * копируется в кольцо и уезжает на приёмник пакетами 'T' (HALOW_P2P_TYPE_LOG)
 * тем же каналом, что и видео. Приёмник отдаёт их в USB записью 'L',
 * просмотрщик пишет tools/logs/cam_air_ДАТА_ВРЕМЯ_метка.txt — тот же текст,
 * что пишет cam_console.py, — и показывает хвост лога на своей странице.
 *
 * Зачем. Камере больше не нужен ноутбук: на столе она живёт от powerbank,
 * на БПЛА ноутбука нет в принципе, а наземная станция и так сидит у ПК.
 *
 * USB-консоль при этом НЕ ждёт хоста: ожидание записи 0 и буфер 8 КБ. Иначе
 * без ноутбука каждая печать стояла бы до 100 мс (ядро 2.0.9, HWCDC), а
 * печать идёт в том числе из pumpRx, то есть из тракта передачи.
 *
 * До связи текст копится в кольце AIRLOG_RING (загрузка, стартовое окно,
 * ожидание приёмника) и уезжает, как только приёмник отозвался. Кольцо
 * полно — новый текст выбрасывается, в лог встаёт отметка о пропуске.
 * Цена — эфир: в работе консоль даёт ~0,5–1 КБ/с, около 1 % канала.
 */
#define AIR_LOG          1
#define AIRLOG_RING      32768   /* байт; до связи копится ~30 с консоли */
#define AIRLOG_CHUNK     1024    /* текста в одном пакете 'T' */
#define AIRLOG_MIN_MS    100     /* не чаще одного пакета за столько мс */
#define AIRLOG_FLUSH_MS  500     /* неполный пакет ждёт добора не дольше */

#if AIR_LOG
static uint8_t  airlog_ring[AIRLOG_RING];
static volatile uint32_t airlog_head = 0;   /* свободно бегущие счётчики */
static volatile uint32_t airlog_tail = 0;
static uint32_t airlog_lost = 0;            /* выброшено с последней отметки */
static uint32_t airlog_lost_total = 0;
static portMUX_TYPE airlog_mux = portMUX_INITIALIZER_UNLOCKED;

static void airlog_copy_in(const uint8_t *b, uint32_t n)
{
    uint32_t pos = airlog_head % AIRLOG_RING;
    uint32_t first = AIRLOG_RING - pos;
    if (first > n) first = n;
    memcpy(airlog_ring + pos, b, first);
    memcpy(airlog_ring, b + first, n - first);
    airlog_head += n;
}

/* Зовётся из обоих ядер (loop и camera_task), отсюда спинлок. */
static void airlog_put(const uint8_t *b, size_t n)
{
    portENTER_CRITICAL(&airlog_mux);
    uint32_t used = airlog_head - airlog_tail;
    if (airlog_lost) {
        char mark[80] = "\n[лог: пропущено ";
        size_t k = strlen(mark);
        utoa(airlog_lost, mark + k, 10);
        strcat(mark, " байт]\n");
        k = strlen(mark);
        if (used + k + n <= AIRLOG_RING) {
            airlog_copy_in((const uint8_t *)mark, k);
            used += k;
            airlog_lost = 0;
        }
    }
    if (!airlog_lost && used + n <= AIRLOG_RING) {
        airlog_copy_in(b, n);
    } else {
        airlog_lost += n;
        airlog_lost_total += n;
    }
    portEXIT_CRITICAL(&airlog_mux);
}

/* Консоль: USB как раньше плюс копия в кольцо. Подменяет SerialMon ниже. */
class AirMon : public Stream {
public:
    void begin(unsigned long baud) { Serial.begin(baud); }
    void setTxTimeoutMs(uint32_t ms) { Serial.setTxTimeoutMs(ms); }
    void setTxBufferSize(size_t n) { Serial.setTxBufferSize(n); }
    int available() override { return Serial.available(); }
    int read() override { return Serial.read(); }
    int peek() override { return Serial.peek(); }
    void flush() override { }          /* ждать хоста нельзя, см. halow_mon_settle */
    size_t write(uint8_t c) override { return write(&c, 1); }
    size_t write(const uint8_t *b, size_t n) override
    {
        airlog_put(b, n);
        Serial.write(b, n);
        return n;
    }
    using Print::write;
};
static AirMon airMon;
#undef SerialMon
#define SerialMon airMon
#endif

// ---------------------------- настройки ----------------------------

/*
 * Скорость UART ESP32 <-> модуль. Должна совпадать с UART_P2P_BAUDRATE в
 * залитом bin.
 *
 * 230400, а не 460800. Причина не в наших измерениях — на 460800 брака не было
 * вовсе, — а в документации вендора: TXSDK_AT указывает для скорости UART
 * диапазон 9600-400K и предупреждает, что выше UART-BUS может работать
 * некорректно. 460800 лежит за этой границей, и на защите такое обосновать
 * нечем. 230400 — внутри диапазона.
 *
 * Стартовое окно всегда идёт на 115200 (в atcmd.c:242 скорость зашита
 * литералом), поэтому порт переоткрывается после окна.
 */
#define AT_BAUD   115200   // скорость стартового окна (жёстко 115200 в прошивке)
#define P2P_BAUD  3000000   // ДОЛЖНА совпадать с UART_P2P_BAUDRATE залитого bin
                           // 24.09: модули на 3000000 с патчем кольца 8 КБ (запас 27.3 мс).
                           // Чанк поднять НЕЛЬЗЯ: 1400 — предел эфирного
                           // кадра модуля (1500 Б), см. halow_stream.h:175.
                           // Поэтому пауза 6 мс платится с каждых 1400 Б.
                           // Прежде:
                           // (APP_..._2026-09-24_step3-1000000-RING8K_...bin).
                           // 96e6/1000000 = 96 ровно, ошибка частоты 0%.
                           // Откат на 384000 — и прошивку модуля откатывать тоже.

/*
 * ЗАДЕРЖКА ПРОЗРАЧНОГО РЕЖИМА В ЗАЛИТОЙ ПРОШИВКЕ МОДУЛЯ.
 *
 * Это не наш параметр, а копия UART_P2P_START_DELAY_MS из project_config.h той
 * сборки, что лежит в модуле ЭТОЙ платы. Держать в согласии обязательно.
 *
 * 30000, ПРОВЕРЕНО ОПРОСОМ 27.08, а не предположено. В модуле этой платы
 * лежит сборка delay30s:
 *
 *     AT+VERSION -> v2.4.1.3-43933, app:0
 *     AT+SYSCFG  -> hgSDK-v2.4.1.3-43933, app-0, build time:Aug 25 2026 17:48:12
 *
 * Это APP_2.4.1.3-43933_2026-08-25_step3-230400-delay30s-nonetlog.bin.
 * Не delay180s от 26.08, как считалось: в приёмник её залили, в камеру — нет.
 *
 * Отсюда важный метод: слот и время сборки модуль сообщает сам. Раньше вопрос
 * «какая из двух сборок реально поднялась» считался неразрешимым и породил
 * пробу AT+VERSION на 15-й секунде (ниже, LINK_DIAG). Проба остаётся полезной
 * как быстрый признак, но точный ответ даёт AT+SYSCFG через мост.
 *
 * ПЕРЕД КАЖДОЙ СМЕНОЙ ПРОШИВКИ МОДУЛЯ сверять это число со временем сборки.
 * Окно скетча меньше задержки — двоичный поток уходит в живой разборщик AT;
 * больше — просто теряется время, это безопасно.
 */
#define MODULE_P2P_DELAY_MS 30000

// Молчим на 3 с дольше модуля: если ESP32 стартовал раньше него, запас съест
// разницу. Меньше задержки модуля ставить НЕЛЬЗЯ, см. выше.
#define P2P_WINDOW_MS (MODULE_P2P_DELAY_MS + 3000)

// Мастер-выключатель всего, что скетч делает с модулем в стартовом окне.
#define USE_AT_WINDOW 1

/*
 * 27.08: ОКНО РАЗДЕЛЕНО НА ЧТЕНИЕ И ЗАПИСЬ.
 *
 * Раньше оба скетча при каждой загрузке переписывали конфигурацию модуля:
 * MCAST_BW, MCAST_MCS, ENCRYPT, TXPOWER. Восемь команд по 300 мс — это секунды
 * 1-6 жизни модуля, ровно то время, когда идёт ассоциация. Что при этом делает
 * AT+ENCRYPT на точке доступа, описано ниже: пересобирает ключи, удаляет GTK и
 * роняет интерфейс. Прогон 26.08 умер именно там — станция подключилась на
 * 3.36 с и к 10-й секунде исчезла.
 *
 * Пока стартовый скрипт остаётся частью прогона, прибор возмущает объект и
 * прогоны несравнимы. Поэтому запись выключена: конфигурация ставится ОДИН РАЗ
 * с терминала (tools/halow_at.py setup) и живёт во флеше.
 *
 * AT_WINDOW_WRITE  — команды, меняющие радио, ключи или флеш. По умолчанию 0.
 * AT_WINDOW_LOGCFG — только AT+SYSDBG и AT+PRINT_PERIOD. Они меняют
 *                    многословность печати LMAC и ничего больше: полей в
 *                    struct sys_config под них нет, syscfg_save не зовётся,
 *                    во флеш не пишутся. Поэтому оставлены включёнными.
 * AT_WINDOW_READ   — читающие запросы. AT+SYSCFG вываливает конфигурацию
 *                    целиком, и она попадает в консольный лог прогона — это и
 *                    есть паспорт прогона со стороны модуля.
 */
#define AT_WINDOW_WRITE  0
#define AT_WINDOW_LOGCFG 1
#define AT_WINDOW_READ   1

/*
 * ЗАМЕР: шумит ли сенсор в собственный приёмник. 1 — мерить, 0 — обычный ход.
 *
 * Зачем. 01.09 выяснилось, что связь встаёт в 4 случаях из 7, и причина не в
 * рукопожатии, как я сначала решил, а в том, что до камеры **не доходит ответ
 * точки доступа на запрос подключения**. Её лог: WPA_ASSOCIATING ->
 * ieee80211_sta_assoc_timeout, до рукопожатия дело вообще не доходит. При этом
 * вверх всё работает: приёмник слышит камеру на −30 и станцию добавляет.
 *
 * Асимметрия направлений совпадает с разницей фона: модуль камеры намеряет
 * −60 дБм, модуль приёмника −85. Двадцать пять децибел — это шина DVP, PSRAM
 * и XCLK 20 МГц в сантиметрах от антенны. Оглушённый приёмник теряет одиночные
 * адресованные кадры, а маяки ловит, потому что они повторяются дважды в
 * секунду.
 *
 * НО: те −60 сняты через сервисный мост, который сенсор не инициализирует
 * вовсе. То есть фон был высоким и при выключенной камере, и версия про
 * «сенсор глушит» пока не доказана. Этот замер её и проверяет:
 *
 *   A — фон при работающем сенсоре (сюда setup приходит уже с камерой);
 *   B — фон через несколько секунд после esp_camera_deinit();
 *   C — фон после повторной инициализации.
 *
 * Если A и C около −60, а B заметно ниже — сенсор виноват, и лечение простое:
 * не включать его, пока связь не установилась. Если все три одинаковы — версия
 * неверна, шумит сама плата или антенна, и надо смотреть служебный тракт
 * (MCAST_BW/MCAST_MCS), которым и передаётся ответ на подключение.
 *
 * Пауза между замерами не случайна: модуль усредняет фон, AT+CCA_OBSV
 * показывает окно наблюдения 4 секунды.
 */
/*
 * ВЫКЛЮЧЕН 01.09, ПОСЛЕ ТОГО КАК ОТВЕТИЛ И СЛОМАЛ СТЕНД.
 *
 * Ответ: фон одинаков во всех трёх замерах, −60 дБм и с работающим сенсором,
 * и с выключенным. Камера собственный приёмник НЕ глушит, версия закрыта.
 *
 * Цена: с этим замером связь встала в 0 прогонах из 5 против 4 из 7 без него.
 * Лог камеры обрывается ровно на строке «B — сенсор выключен», то есть сразу
 * после esp_camera_deinit(), дальше перезагрузка и всё сначала. Выключение и
 * повторная инициализация сенсора на этой сборке не переживаются — плата
 * падает, до передачи дело не доходит.
 *
 * Урок общий: диагностика, вставленная в стартовое окно, вмешивается в то, что
 * измеряет. Замер, меняющий состояние железа, ставить в рабочий путь нельзя —
 * только отдельной сборкой, которую после ответа выбрасывают.
 */
#define NOISE_PROBE      0
#define NOISE_SETTLE_MS  6000

/*
 * ЗАПАС ПО ПОРОГУ ЗАНЯТОСТИ КАНАЛА, дБ. 0 — не трогать.
 *
 * На камере по умолчанию 0, и это осознанно. Проблема была на приёмнике: он
 * измеряет фоновый уровень около −87 дБм и потому считает канал занятым почти
 * всегда. У камеры тот же измеренный уровень около −60 — плата электрически
 * шумнее (шина DVP, PSRAM, XCLK 20 МГц), — и она передаёт свободно без всякого
 * запаса. Поднимать порог ещё и здесь значит делать передатчик невежливым без
 * нужды.
 *
 * Ручка оставлена, потому что уровень измеряется, а не задаётся: если камеру
 * переставить или экранировать, её фон уедет, и тогда запас понадобится.
 * Смотреть текущее значение — AT+SET_BGRSSI=? в читающем блоке ниже.
 * Настройка живёт только в ОЗУ и слетает при перезагрузке модуля.
 */
/*
 * 05.10: фон камеры теперь −100…−101 дБм (лог 30.09), а не −60, — плата больше
 * не шумнее приёмника. В опыте ROLE_SWAP камера — точка доступа, и ей нужен тот
 * же запас, что приёмнику-точке 28.08 (иначе не успевает ответить на запрос
 * подключения). Сам ROLE_SWAP объявлен ниже, у P2P_UNICAST.
 */
#define CCA_MARGIN_DB (ROLE_SWAP ? 20 : 0)

/*
 * ДИАГНОСТИКА ЛИНКА: 1 — спросить модуль, кто он и в каком режиме.
 *
 * Нужна, потому что прозрачный режим невозможно проверить изнутри: мы пишем
 * байты и не получаем на них никакого подтверждения. Если модуль остался в
 * AT-режиме, запись просто исчезает, а скетч продолжает показывать бодрые fps.
 */
#define LINK_DIAG 1

// 1 — ГЛУШИТЬ. Вернул 25.08, и это не косметика.
//
// В прошивке модуля включён netlog (SYS_APP_NETLOG=1): он дублирует ВЕСЬ лог
// модуля в сеть пакетами UDP. Пока к точке доступа никто не подключён, каждую
// такую строку отправить некому — netdev_send_data возвращает -1, lwIP печатает
// "Send to netdev error", и буфер не возвращается в пул.
//
// Замерено 25.08: пул из ~75 буферов выедается за 60 секунд, из них половина
// уходит за первые 4 секунды (загрузочный лог), дальше ровно по 0.6 буфера в
// секунду — это периодический дамп LMAC STATUS, пятнадцать строк каждые шесть
// секунд. С нулём буферов модуль не может передать даже ответ на запрос
// подключения, и связь перестаёт устанавливаться навсегда.
//
// Поставив здесь 0 ради диагностики, я открыл этот кран и на сутки лишил стенд
// связи. Ставить 0 можно только на короткий разбор и помня о цене.
#define QUIET_MODULE 1

/*
 * ШИРОКОВЕЩАТЕЛЬНЫЙ ТРАКТ — им идёт всё наше видео.
 *
 * Измерено 18.08 на живой прошивке: AT+MCAST_BW отвечал "tx bw=2 MHz",
 * AT+MCAST_MCS — "muticast tx mcs= 0". То есть видео шло в полосе 2 МГц из
 * доступных 8 и на самой нижней модуляции.
 *
 * Физическая скорость 802.11ah, один поток:
 *      2 МГц MCS0 —   650 кбит/с      8 МГц MCS0 —  2925
 *      2 МГц MCS7 —  5850             8 МГц MCS7 — 26000
 *
 * Почему это вообще так: uart_p2p шлёт кадры на адрес ff:ff:ff:ff:ff:ff.
 * Широковещательные кадры никто не подтверждает, значит нет ни повторов, ни
 * обратной связи — а без обратной связи модуль не может подбирать модуляцию и
 * ставит заведомо живучую. Отсюда же наши потери при нулевой порче байтов:
 * у каждого пакета ровно одна попытка.
 *
 * Эти два параметра, похоже, НЕ сохраняются между перезагрузками (в отличие от
 * AT+BSS_BW, который пишет в параметры). Поэтому выставляем их здесь, при
 * каждом старте, в том же окне, где ещё жив AT.
 *
 * ОСТОРОЖНО С MCS. 18.08: поставили MCAST_MCS=7, разнесли платы — связь
 * перестала УСТАНАВЛИВАТЬСЯ вовсе. Причина в том, что "multicast" здесь это
 * все кадры на широковещательный адрес, включая МАЯКИ точки доступа и обмен
 * при подключении. По маякам станция находит AP; на MCS 7 они добивают только
 * вплотную. То есть параметр бьёт не по скорости видео, а по самой связи.
 *
 * Поэтому MCS поднимать по одной ступени и каждый раз проверять, что платы
 * вообще сходятся на рабочей дистанции. Полоса (MCAST_BW) в этом смысле
 * безопаснее: 8 МГц совпадает с полосой самого канала.
 */

/*
 * 03.09: MCAST_BW поднят до 8, чтобы полоса сигнала совпала с BSS_BW=8.
 *
 * Зачем. При BSS_BW=8 и MCAST_BW=2 приёмник слушает вчетверо более широкую
 * полосу, чем занимает сигнал, и набирает вчетверо больше шума — около 6 дБ
 * впустую. Проверяем, вернёт ли согласование эти децибелы.
 *
 * Риск известен и измерен 01.09: при MCAST_BW=8 связь не встала (ok=0) —
 * "multicast" здесь это все кадры на широковещательный адрес, включая маяки.
 * Откат бесплатный: MCAST_BW и MCAST_MCS живут только в ОЗУ, снятие питания
 * возвращает 2.
 *
 * Блок вынесен из-под AT_WINDOW_WRITE по той же причине, что и CCA_MARGIN_DB:
 * эти две команды не пишут флеш и не пересобирают ключи, а без них замер
 * попросту не состоится. Всё остальное в окне по-прежнему не пишется.
 */
#define SET_MCAST  1       // 03.09: включён ради замера согласованной полосы

/*
 * ОДНОАДРЕСНАЯ ПЕРЕДАЧА: 1 — попросить модуль слать видео не «всем», а
 * персонально приёмнику.
 *
 * ЗАЧЕМ. uart_p2p шлёт кадры на широковещательный адрес. Такие кадры никто не
 * подтверждает: нет ни повторов, ни обратной связи, а без обратной связи
 * модуль не может подбирать модуляцию и обязан сидеть на MCS 0. Отсюда и
 * характер потерь — пакет пропадает целиком при нулевой порче байтов, потому
 * что попытка у него ровно одна. Назвав получателя, включаем штатные
 * подтверждения, повторы и автоподбор скорости.
 *
 * ЧЕМ ЭТО ДЕЛАЕТСЯ. Командой AT+P2PDEST, которой в заводской прошивке нет —
 * она добавлена в project/atcmd.c и собрана 15.09 (образ
 * SDK/builds/APP_..._p2pdest.bin, карточка P2PDEST_2026-09-15.txt). На старой
 * прошивке команда просто не ответит, и скетч продолжит работать
 * широковещательно — поэтому флаг безопасно держать включённым на обеих
 * платах.
 *
 * АДРЕС НЕ ЗАШИТ. Берём bssid из ответа AT+SYSCFG, который и так читается
 * строкой ниже: у станции bssid — это MAC точки доступа, то есть ровно тот,
 * кому мы и шлём. Зашитый адрес разошёлся бы с железом при первой же замене
 * платы, а у нас модуль камеры уже меняли 14.09.
 *
 * ОТКАТ без перепрошивки: поставить 0 — и скетч команду не пошлёт, транспорт
 * останется широковещательным. В самом модуле переключение тоже обратимо
 * командой AT+P2PDEST=ff:ff:ff:ff:ff:ff.
 *
 * 05.10: при ROLE_SWAP выключено само. У точки доступа bssid — её же MAC:
 * скетч назначил бы получателем самого себя, и в эфир не ушло бы ничего.
 */
#define P2P_UNICAST  (!ROLE_SWAP)

/*
 * СМЕНА РОЛЕЙ (05.10): 1 — модуль камеры работает точкой доступа (ползунок AP
 * на плате камеры), модуль приёмника — клиентом (ползунок STA на его плате).
 *
 * Зачем. Опыт 30.09 (var0930bc): «всем» от клиента в эфире не вещание — клиент
 * отдаёт кадр точке адресно, с подтверждением и повторами (PER tx0 81–87 %), а
 * точка потом рассылает копию. Напрямую, без подтверждений и повторов, вещает
 * только точка доступа. Главный вопрос опыта: доходят ли куски с первой
 * попытки, когда повторов нет вовсе. Ответ — строка «ОПЫТ КУСКИ» (по списку
 * пришедших кусков в квитанции нового приёмника).
 *
 * Что меняется: P2P_UNICAST выключен (видео — всем), запас порога CCA 20 дБ
 * (см. CCA_MARGIN_DB), модуляция видео — AT+MCAST_MCS из варианта перебора.
 * ОСТОРОЖНО: на точке MCAST_MCS задаёт и скорость маяков (18.08 на MCS 7 связь
 * не вставала, см. «ШИРОКОВЕЩАТЕЛЬНЫЙ ТРАКТ»). Мощность прибита
 * (PWRCTL_MODE 0): регулятор ведёт по обратной связи от одноадресных кадров, а
 * их у камеры-точки нет. Скетч приёмника тот же, с квитанцией со списком.
 * ОТКАТ: ползунки обратно (камера STA, приёмник AP), ROLE_SWAP 0, рабочие
 * образы обеим платам, снять питание.
 */
#define ROLE_SWAP     1
/*
 * ПОДСТРОЙКА МОДУЛЯЦИИ «ВСЕМ» в модуле (05.10): AT+MCSCTL=<режим> в стартовом окне,
 * только при ROLE_SWAP. Команда есть только в сборке модуля ..._mcsctl.bin
 * (SDK/builds/MCSCTL_2026-10-05.txt); старая ответит ERROR, и модуляция останется
 * той, что задал AT+MCAST_MCS. Модуль сам меняет её раз в секунду по SNR, с
 * которым приёмник слышит камеру: стартует с MCAST_MCS, дальше — по порогам.
 * -1 — не слать.
 *
 * 06.10: опыт swap4 (автокачество 2/3 × CCA приёмника 20/0) — модуляция закреплена
 * на MCAST_MCS, режим 0: модуль только печатает строку MCSCTL (mcs=, cca=).
 * MCSCTL_ALT_S > 0 — пятый параметр сборки модуля ..._ccasw: модуль сам чередует
 * подстройку и закреплённую MCAST_MCS по столько секунд (опыт ABAB для MCSCTL).
 */
#define MCSCTL_MODE   1
#define MCSCTL_ALT_S  0     /* 06.10 swap6 был 90 (ABAB подстройка / MCS 4); рабочая — подстройка всегда */

/*
 * ПРОВЕРКА ЛОЖНЫМ АДРЕСОМ: 1 — вместо настоящего MAC приёмника подсунуть
 * заведомо несуществующий.
 *
 * ЗАЧЕМ. Модуль отвечает OK на AT+P2PDEST, но это значит лишь «указатель
 * переставлен», а не «кадры в эфире действительно стали адресными». Косвенных
 * признаков мало: скорость перестала быть прибитой к 180 кбит/с и поднималась
 * до 222 — похоже на подбор модуляции, но доказательством не является.
 *
 * ПРОВЕРКА. Назовём получателем адрес, которого в эфире нет. Если правка
 * настоящая — видео обязано пропасть ПОЛНОСТЬЮ: кадры уйдут в никуда. Если
 * картинка продолжит идти как ни в чём не бывало, значит адрес назначения нас
 * не слушается, передача всё это время была широковещательной, и все выводы
 * про адаптивную модуляцию надо выбросить.
 *
 * Адрес взят из диапазона 02:xx (локально администрируемый) — такие вендорам
 * не выдаются, случайно совпасть не с чем.
 *
 * ПОСЛЕ ПРОВЕРКИ ВЕРНУТЬ 0. Это отладочный режим, связь в нём не работает.
 */
/*
 * СКОРОСТЬ ОДНОАДРЕСНОЙ ПЕРЕДАЧИ: -1 — не трогать, 0..7 — прибить гвоздём,
 * 255 — явно включить автоподбор.
 *
 * ЗАЧЕМ. `AT+MCAST_MCS` задаёт скорость ШИРОКОВЕЩАТЕЛЬНЫХ кадров, и мы её
 * держим в нуле. У одноадресных кадров своя ручка — `AT+TX_MCS`, и до 16.09 мы
 * про неё не знали. Нашлась разбором прошивки: `atcmd_tx_mcs_hdl` по адресу
 * 0x200354b8, рядом `AT+TX_MCS_MAX`, `AT+TX_MCS_MIN`, `AT+TX_RATE_FIXED`.
 *
 * ЗАЧЕМ ПРИБИВАТЬ. Чтобы выяснить, ограничено ли кольцо модуля радио. Пауза
 * между чанками нужна ровно на то, чтобы радио успело кольцо выгрести; если
 * поднять модуляцию, сток ускорится и порог паузы должен упасть. Прибив MCS 7
 * и MCS 0 и перемерив порог, получаем ответ числом:
 *
 *   порог упал на MCS 7 и вырос на MCS 0 -> узкое место в эфире, адаптивная
 *       модуляция имеет смысл, её выигрыш равен разнице порогов;
 *   порог не двинулся -> узкое место не в эфире, и на этой дистанции
 *       адаптивная модуляция не может дать ничего.
 *
 * ЧИТАТЬ БЕЗОПАСНО. У `AT+PAIR` режима чтения нет и "?" там превращается в 0,
 * то есть в запись. Здесь не так: в обработчике стоит `cmpnei r3, 63` и переход
 * через atoi, то есть "?" честно пропускает запись и печатает текущее значение.
 * Проверено по дизассемблеру для всех четырёх команд.
 */
/*
 * СТАТИСТИКА МОДУЛЯ ВО ВРЕМЯ ПОТОКА: 0 — молчать (обычный ход),
 * иначе — период печати в миллисекундах.
 *
 * ЗАЧЕМ. Прошивка умеет печатать по каждой станции строку вида
 *
 *     tx0: mcs=3 snr=28 data=1234KB(210kbps) per=7
 *
 * `per` — доля НЕУДАЧНЫХ передач. Узнать, что одноадресный пакет не дошёл,
 * можно ТОЛЬКО по отсутствию подтверждения. Значит ненулевой `per` — прямое
 * доказательство, что подтверждения работают, а `mcs` показывает, какую
 * модуляцию автоподбор выбрал на самом деле. Это те два числа, которых не
 * хватало, чтобы закрыть вопрос про ACK (журнал, раздел 4ж).
 *
 * КАК ЭТО РАБОТАЕТ. Печатает `lmac_transceive_statics` (0x200230bc), она зовёт
 * `lmac_sta_info_statics_print` (0x20022c08). Мы сами её глушим командой
 * `AT+SYSDBG=LMAC,0` в стартовом окне — здесь она включается обратно, а
 * `AT+PRINT_PERIOD` задаёт период.
 *
 * ПОЧЕМУ ЭТО БЕЗОПАСНО ДЛЯ ВИДЕО. Печать идёт в направлении модуль -> ESP32,
 * то есть НАВСТРЕЧУ видеопотоку. Исходящие кадры она не трогает совсем. На
 * приёме смешается с отчётами приёмника, но там своё кадрирование с CRC:
 * текст не совпадёт с заголовком и будет отброшен как мусор. Мы его
 * перехватываем до отбрасывания и печатаем в консоль.
 *
 * ЦЕНА. Печать занимает полосу обратного канала, по которому приходят отчёты
 * приёмника. Слишком частая печать может их вытеснить и уронить признак
 * связи. Поэтому период задавать в секундах, а не в миллисекундах: 5000 —
 * разумный минимум.
 */
#define LMAC_STATS  5000

/*
 * РЕЖИМ ПРИЁМА UART В МОДУЛЕ КАМЕРЫ (24.09).
 *   0 — как у вендора: прерывание на каждый байт, ОДИН байт за вход;
 *   1 — выгребать FIFO целиком за вход (до 64 байт).
 * Нужна прошивка модуля SDK/builds/APP_..._UARTDIAG_... (команда AT+UARTDRAIN,
 * правка в sdk/driver/uart/hguart.c). На старой прошивке команда ответит ERROR
 * и ничего не изменит.
 *
 * Модуль печатает счётчики строкой «UARTSTAT ... oe=N» с периодом LMAC_STATS:
 * oe — сколько раз FIFO модуля переполнился, то есть прямое число потерь на
 * плече «ESP32 камеры -> модуль камеры». Переключение — без перепрошивки
 * модуля: поменять число, залить скетч, снять питание.
 */
#define UART_DRAIN  1

/*
 * РЕГУЛЯТОР МОЩНОСТИ В МОДУЛЕ (28.09): -1 — не слать команду, 0 — только
 * мерить и печатать, 1 — регулировать.
 *
 * Нужна прошивка модуля SDK/builds/APP_..._pwrctl.bin (команда AT+PWRCTL,
 * project/atcmd.c). Модуль раз в секунду сравнивает tx_snr — SNR, с которым
 * СОСЕД слышит нас, — с коридором PWRCTL_LO..PWRCTL_HI и двигает свою мощность
 * на 2 дБ в пределах 1..20. Стартует с AT+TXPOWER (TX_POWER_DBM). На старой
 * прошивке команда ответит ERROR, и прогон пойдёт с постоянной мощностью.
 *
 * Печать «PWRCTL snr=... pwr=...» идёт с периодом LMAC_STATS рядом со
 * строкой модуля «tx0: snr=» — по ним сверяем, что регулятор видит то же
 * число, что и статистика LMAC.
 */
#define PWRCTL_MODE 1
#define PWRCTL_LO   25
#define PWRCTL_HI   35
/* Потолок мощности регулятора, дБм. 14 дБм = 25 мВт — предел ГКРЧ
 * 07-20-03-001 для 866–868 МГц. Нужна сборка модуля ..._pwrctl14.bin (четвёртый
 * параметр AT+PWRCTL); прежняя сборка его не знает и держит потолок 20. */
#define PWRCTL_MAX  14

/*
 * ПОРОГ RTS, символов эфира (~40 мкс каждый): 0 — не трогать (заводской 50,
 * ~2 мс). Перед посылкой длиннее порога модуль спрашивает разрешение
 * (RTS/CTS), а при PER ~70 % — и перед каждым повтором. Нас двое и мы слышим
 * друг друга — это чистый расход эфира. 29.09 выключенный RTS (1000) был
 * лучше на всех 9 этапах опыта: синтетика 252 -> 463 кбит/с, видео Q80
 * 282 -> 618, RTT втрое меньше. Живёт в ОЗУ модуля — шлём в каждом окне.
 */
#define RTS_SET_SYM 1000

/*
 * ОТЧЁТ МОДУЛЯ ЦЕЛИКОМ (30.09): 0 — строгий фильтр (обычный ход), N — каждый
 * N-й периодический отчёт модуля (LMAC_STATS) пропускать в лог целиком, не
 * больше LMAC_DBG_LINES строк, плюс строки смены лучшей модуляции (tp1=/tp2=).
 *
 * Зачем. AT+LMAC_DBGSEL=2 (в VAR_SWEEP) добавляет в отчёт таблицу по всем MCS:
 * попытки, доля успеха, оценка. Это единственный способ увидеть, что выбрал
 * автоподбор: mcs= в строке tx0 — модуляция ПОСЛЕДНЕЙ попытки, а не выбор
 * (журнал, «30.09: как модуль выбирает модуляцию»). Формат строк таблицы
 * заранее не известен, поэтому отчёт пропускается целиком — в том числе без
 * таблицы, для сравнения. Лог идёт по воздуху и делит эфир с видео: при
 * отчёте раз в ~4 с это ~2 кбит/с.
 */
#define LMAC_DBG_EVERY  0
#define LMAC_DBG_LINES  64   /* ~20 строк отчёта + таблица до 32 модуляций */

/*
 * МОЩНОСТЬ ПЕРЕДАТЧИКА, дБм: 0 — не трогать, иначе 1..20.
 *
 * ДИАПАЗОН РОВНО 1..20, ноль отвергается. Проверено по обработчику:
 *     200382a6:  blsz r0, ERROR     ; значение <= 0 -> ошибка
 *     200382b0:  cmplti r0, 21      ; и должно быть < 21
 * 17.09 на этом потеряли прогон: послали AT+TXPOWER=0, получили ERROR, а
 * мощность осталась прежней — и заметили это только по AT+TXPOWER=? в логе.
 *
 * ЗАЧЕМ. На столе платы стоят в двух метрах, а передатчик жарит на 20 дБм.
 * Замер 17.09 показал уровень на входе приёмника около НУЛЯ дБм (минимум -10,
 * максимум +4, 90 замеров из 91 выше -10). Приёмник рассчитан на -60...-90.
 * Это не «отличный сигнал», а перегрузка: мы вгоняем в него на пять порядков
 * больше, чем он ждёт. При этом PER держится 52% в среднем — половина передач
 * требует повтора, и именно там теряется весь выигрыш от быстрой модуляции.
 *
 * Убавив мощность, проверяем догадку напрямую: упадёт PER — значит виновато
 * насыщение, и все столовые замеры до сих пор мерили артефакт близости.
 * Заодно стенд становится честнее: канал начинает походить на настоящий, а не
 * на «антенна в антенну».
 *
 * ОСТОРОЖНО С ВЫВОДАМИ. EVM при перегрузке держался -31 дБ и почти не плыл, а
 * это неплохое качество созвездия. Значит грубого насыщения на ПРИЁМЕ нет, и
 * одна лишь мощность может не объяснить всё. Второй подозреваемый — сам
 * автоподбор: половину времени он сидит на MCS 6-7, а на прибитом MCS 7 связь
 * измеримо сыплется. Его проверяет TX_MCS_MAX, см. ниже.
 *
 * ВО ФЛЕШ НЕ ПИШЕТСЯ. Обработчик AT+TXPOWER зовёт lmac_ioctl и не вызывает
 * syscfg_save — правка живёт только в ОЗУ и сбрасывается снятием питания.
 * Поэтому её можно слать в стартовом окне, не нарушая правила «конфигурация
 * ставится один раз с терминала».
 */
/* 26.09: стол, платы в полуметре. TX_PWR_AUTO=1 держала PER 44-82 — то есть
 * ответ на вопрос выше получен: автоподстройка идёт по линейности MCS, а от
 * перегрузки приёмника не спасает. Проверяем прямым убавлением, как 17.09. */
/* 28.09: 14, а не 20 — стартовая мощность до первого решения регулятора
 * тоже должна укладываться в предел ГКРЧ (25 мВт), см. PWRCTL_MAX. */
#define TX_POWER_DBM  3

/*
 * ПОТОЛОК МОДУЛЯЦИИ: -1 — не трогать, 0..7 — ограничить сверху.
 *
 * КОДИРОВКА НЕОЧЕВИДНА. Ограничение включается СТАРШИМ битом, значение лежит в
 * младших семи:
 *
 *     2002da78:  ld.b  r3, (r6, 0x888)   ; tx_mcs_max
 *     2002da7e:  bhsz  r2, 0x2002da90    ; если >= 0 — ПЕРЕПРЫГНУТЬ ограничение
 *     2002da82:  andi  r3, r3, 127       ; сюда только при взведённом бите 7
 *
 * То есть AT+TX_MCS_MAX=7 не ограничит НИЧЕГО (7 >= 0, переход), а нужное
 * значение — 128+7=135 для потолка MCS 7, 128+4=132 для MCS 4. Ровно поэтому
 * прочитанный на плате «limit tx mcs max= 0» означает «не задано», а не
 * «потолок MCS 0».
 */
#define TX_MCS_MAX_CAP  -1

/*
 * АВТОПОДСТРОЙКА МОЩНОСТИ: -1 — не трогать, 0 — выключить, 1 — включить.
 *
 * ЧТО ЭТО. Штатная команда прошивки AT+TX_PWR_AUTO, о которой мы не знали до
 * 18.09. Отвечает "tx power auto adjust enabled/disabled". Рядом лежат
 * AT+TX_PWR_MAX (потолок мощности), AT+TX_PWR_SUPER и TX_PWR_SUPER_TH.
 *
 * ЗАЧЕМ. На двух метрах при 20 дБм приёмник в перегрузке: уровень около нуля
 * дБм при норме -60...-90, и PER от этого 52% вместо 38%. Ручное убавление до
 * 1 дБм проблему снимало, но это костыль: в поле мощность нужна полная.
 * Автоподстройка решала бы это сама.
 *
 * ЧЕГО МЫ НЕ ЗНАЕМ. От ЧЕГО она подстраивается. В прошивке есть отдельная
 * функция tx_pwr_adjust_by_mcs (0x2002cac0), которая срезает мощность на
 * высоких MCS ради линейности — это НЕ то же самое, что подстройка под
 * дистанцию. Разобрать по дизассемблеру за разумное время не вышло: флаг
 * лежит в структуре, к которой обращаются из десятка мест.
 *
 * КАК ПРОВЕРИТЬ ОПЫТОМ. Включить на столе при полной мощности и посмотреть на
 * PER в статистике модуля:
 *   PER упал к 38% (как при ручных 1 дБм)  -> подстраивается под уровень, годится;
 *   PER остался около 52%                  -> это только линейность по MCS,
 *                                             от перегрузки не спасает.
 * Прибор для этого уже есть — LMAC_STATS.
 */
#define TX_PWR_AUTO  0   /* 28.09: с регулятором PWRCTL автомощность, похоже, перекрывает заданную мощность — проверяем без неё */

#define TX_MCS_FIX -1   /* 29.09: автоподбор (на 5 м сам уходит на MCS 5-7) */

/*
 * ПЕРЕБОР МОДУЛЯЦИЙ (28.09): 1 — при каждом включении питания брать
 * следующий MCS из MCS_SWEEP_LIST (-1 — автоподбор, AT+TX_MCS не шлём).
 * Номер шага лежит в NVS, поэтому для перехода к следующей точке хватает
 * переподключить питание камеры — без перепрошивки.
 *
 * Шаг засчитывается, только если окно было настоящим (не меньше трёх OK) и
 * модуль принял AT+TX_MCS. Перезапуск одного ESP32 (заливка, открытие порта)
 * окна не открывает и шаг не сдвигает — следующий пуск повторит ту же точку.
 * При MCS_SWEEP TX_MCS_FIX не действует. Новый перебор — новое имя MCS_SWEEP_NS.
 */
#define MCS_SWEEP      0   /* 28.09: перебор 3/5/7/авто снят, PER 68–73 % на любой MCS */
#define MCS_SWEEP_LIST { 3, 5, 7, -1 }
#define MCS_SWEEP_NS   "mcsw0928"

/*
 * ПЕРЕБОР НАСТРОЕК MAC (28.09): 1 — при каждом включении питания брать
 * следующий вариант из var_sweep (до двух AT-команд), механизм как у
 * MCS_SWEEP. Зачем: перебор MCS показал, что PER 68–73 % не зависит от
 * модуляции, значит повторы рождаются в MAC. Проверяем по одному:
 *   AT+TX_MAX_AGG=1 — без склейки пакетов (в статистике модуля agg=5);
 *   AT+ACK_TO=100   — ждать подтверждение на 100 мкс дольше (по документации
 *                     производителя добавка в мкс, по умолчанию 0; в старой
 *                     версии сохранялась во флеш — отсюда повтор A в конце).
 * Идёт на прибитом TX_MCS_FIX, чтобы автоподбор не смешивал картину.
 */
#define VAR_SWEEP      0   /* 30.09: ручки выбора модуляции (var0930rc); 0 — рабочая прошивка */
#define VAR_SWEEP_NS   "var1005sw"    /* короткий (VAR_RC_SHORT) — "var0930rs" */
typedef struct {
    const char *name;
    const char *cmd[2];
    uint16_t    gap_us;     /* пауза после пакета, мкс; 0 — CHUNK_GAP_US */
} var_step_t;
/* 28.09 23:08 (var0928a): A / B без склейки / C ACK+100 / A2 — склейка и
 * таймаут ACK не виноваты. 28.09 ночью (var0928b): канал 2 МГц на 867,0.
 * 29.09 (var0929g): пауза после пакета на прошивке модуля с таймером тишины
 * 400 мкс. 0,6 мс провалились (переполнение приёма UART модуля камеры, 29 %
 * битых у приёмника); ищем самую короткую, которую модуль переваривает.
 * 2,0 мс — контроль: примерно столько тишины было ночью (~2,6 мс). */
/* 29.09 (var0929r): порог RTS. Модуль спрашивает разрешение (RTS/CTS) перед
 * посылкой длиннее 50 символов (~2 мс эфира: склейки, низкие MCS). Нас двое и
 * мы слышим друг друга — это лишний обмен. Порог 1000 символов = выключен.
 * Настройка живёт в ОЗУ модуля, после выключения — заводская. */
/* 29.09 (var0929p): мощность камеры. Днём в 5 м регулятор держал её на
 * 1–3 дБм (приёмник слышит с SNR выше 25–35 дБ), MCS 2–4, 250–600 кбит/с;
 * ночью в той же точке она доходила до 14 дБм — MCS 5–7, 960 кбит/с. Мощность
 * приёмника проверяли, мощность камеры — нет. Команды идут после AT+PWRCTL из
 * окна и перекрывают его. На видео при 8 дБм и выше включаются паузы съёмки
 * (GATED_CAPTURE) — это тоже часть цены. */
/* 14:56–15:20 (var0929p): мощности 14 дБм не помогает, регулятор 25–35
 * оставлен. Сейчас (var0929a): автосклейка модуля (заводская — выкл, что
 * делает — не описано) и добавка к ожиданию ACK +500 мкс (+100 не помогло
 * 28.09): если повторы упадут, подтверждения приходят, но поздно. */
/* 16:07–17:06 (var0929a): автосклейка и ACK +500 — без эффекта. Сейчас
 * (var0930rc): ручки выбора модуляции из AT-таблицы прошивки модуля (журнал,
 * «30.09: как модуль выбирает модуляцию»). По заводской цепочке каждый
 * неудачный повтор идёт на ступень ниже, с 6-й попытки — на MCS 1, а такой
 * повтор занимает эфир в ~5 раз дольше, чем на MCS 7. При PER ~70 % на любой
 * MCS это чистый расход эфира. Проверяем, что даёт каждая ручка:
 *   R2 AT+LMAC_DBGSEL=2   — только таблица выбора в отчёте (контроль: сама
 *                           печать не должна менять скорость против R1);
 *   R3 AT+RC_NEW=1        — другая цепочка: 4 попытки на лучшей, 2 на второй,
 *                           дальше MCS 1 (по модели +7 %);
 *   R4 AT+TX_RATE_FIXED=1 — все повторы на лучшей MCS (по модели ±0);
 *   R5 AT+TX_MCS_MIN=4    — пол MCS 4. Если пол действует и на повторы, mcs=
 *                           в строке tx0 не опустится ниже 4. Если связь не
 *                           встанет — снять питание, следующий шаг снова R1.
 *                           30.09 утром 132 (бит 7 «задано», как у потолка,
 *                           см. TX_MCS_MAX_CAP) модуль НЕ принял: ответил
 *                           «limit tx mcs min= 0» — пола не было.
 * AT+RC_NEW=? и AT+LMAC_DBGSEL=? НЕ слать: не проверено, что «?» не
 * превращается в запись нуля (RC_NEW=0 — другой, старый механизм).
 *
 * VAR_RC_SHORT 1 — короткий перебор R2 / R5 (по кругу: R2, R5, R2 — третье
 * включение проверяет, не уплыл ли канал). Модель: пол MCS 4 +40 % на 5 м,
 * R3 +8 %, R4 ±0 — последние два тонут в разбросе включений (±20 %). */
#define VAR_RC_SHORT  0
/*
 * VAR_BCAST 1 (30.09, var0930bc): одноадресно с полом MCS 4 (лучшее из
 * var0930rc) против ШИРОКОВЕЩАНИЯ на MCS 4/5/6.
 *
 * Зачем. Повторы (PER ~80 %) — это неуслышанные подтверждения, а не
 * потерянные данные: 17.09 широковещание на MCS 4 теряло 0,05 % кусков. У
 * широковещательного кадра подтверждения нет вовсе — нет и повторов, кусок
 * уходит в эфир ровно один раз. Цена: MCS задаётся в окне и держится всё
 * включение (своей подстройки нет), потерянный кусок не переспрашивается.
 * Наша квитанция 'A' кумулятивная и приходит и на неполный кадр, так что
 * окно на потере не встаёт.
 *
 * Широковещание включаем явно (AT+P2PDEST=ff:..:ff): одноадресность
 * выставляется в окне раньше, чем вариант, и живёт только в ОЗУ модуля.
 * Мощность в этом переборе прибита (PWRCTL_MODE 0, TX_POWER_DBM 3): регулятор
 * ведёт по обратной связи MFB, а будет ли она без одноадресных кадров — не
 * проверено; 3 дБм — там же, где держал регулятор на этом месте (1–4 дБм).
 */
#define VAR_BCAST     0
/*
 * ROLE_SWAP (05.10, var1005sw): камера — точка доступа, видео всем на MCS 4 / 6
 * / 2. MCS одна на всё включение: своей подстройки у широковещания нет. Если
 * связь на варианте не встала (маяки на этой MCS не добивают), через минуту
 * без видео снять питание — пойдёт следующий.
 */
static const var_step_t var_sweep[] = {
#if ROLE_SWAP
    { "S1: камера-точка, всем MCS 4", { "AT+MCAST_MCS=4\r\n", NULL }, 0 },
    { "S2: камера-точка, всем MCS 6", { "AT+MCAST_MCS=6\r\n", NULL }, 0 },
    { "S3: камера-точка, всем MCS 2", { "AT+MCAST_MCS=2\r\n", NULL }, 0 },
#elif VAR_BCAST
    { "B1: одноадресно, пол MCS 4",  { "AT+TX_MCS_MIN=4\r\n", NULL }, 0 },
    { "B2: широковещание MCS 4",     { "AT+P2PDEST=ff:ff:ff:ff:ff:ff\r\n", "AT+MCAST_MCS=4\r\n" }, 0 },
    { "B3: широковещание MCS 5",     { "AT+P2PDEST=ff:ff:ff:ff:ff:ff\r\n", "AT+MCAST_MCS=5\r\n" }, 0 },
    { "B4: широковещание MCS 6",     { "AT+P2PDEST=ff:ff:ff:ff:ff:ff\r\n", "AT+MCAST_MCS=6\r\n" }, 0 },
#else
#if !VAR_RC_SHORT
    { "R1: как есть",            { NULL, NULL }, 0 },
#endif
    { "R2: таблица выбора",      { "AT+LMAC_DBGSEL=2\r\n", NULL }, 0 },
#if !VAR_RC_SHORT
    { "R3: RC_NEW=1 + таблица",  { "AT+RC_NEW=1\r\n", "AT+LMAC_DBGSEL=2\r\n" }, 0 },
    { "R4: TX_RATE_FIXED=1 + таблица", { "AT+TX_RATE_FIXED=1\r\n", "AT+LMAC_DBGSEL=2\r\n" }, 0 },
#endif
    { "R5: пол MCS 4 + таблица", { "AT+TX_MCS_MIN=4\r\n", "AT+LMAC_DBGSEL=2\r\n" }, 0 },
#endif
};

/*
 * КАНАЛ (28.09): ширина BSS (МГц) и частота (десятые МГц). -1 — не трогать.
 * ДОЛЖНЫ СОВПАДАТЬ СО СКЕТЧЕМ ПРИЁМНИКА.
 *
 * Зачем. До 28.09 модули стояли на BSS 4 МГц с центром 866,0 (864–868 МГц),
 * а данные шли на 2 МГц. Предел ГКРЧ — канал не шире 2 МГц в 866–868, то есть
 * 2 МГц с центром 867,0. Плюс подозрение: камера не слышит часть
 * подтверждений (PER 21–59 % уже на пустом эфире, все неудачи — таймаут ACK).
 *
 * Оба параметра пишутся ВО ФЛЕШ модуля (syscfg) и действуют со следующего
 * включения питания. Окно сначала читает и пишет только при расхождении.
 * В загрузке, где канал записан, шаг VAR_SWEEP не засчитывается: модуль ещё
 * работает на старом канале. Откат: 4 и 8660.
 */
#define BSS_BW_SET  2
#define CHAN_SET    8670

#define P2P_DEST_TEST 0
#define P2P_DEST_TEST_MAC "02:00:00:00:00:01"
#define MCAST_BW   2       // 1 / 2 / 4 / 8 МГц. ПОДНИМАТЬ ПО ОДНОЙ СТУПЕНИ
                           // ОБЯЗАНА быть <= BSS_BW: сигнал шире окна приёма
                           // приёмник срежет, это уже не потеря дБ, а потеря сигнала
/* 05.10: в ROLE_SWAP — 4, лучшее по перебору var1005sw (5 м: 0,3–0,6 % пропавших кусков,
 * связь встаёт). Варианты VAR_SWEEP, если включены, перекрывают своей командой. */
#define MCAST_MCS  (ROLE_SWAP ? 4 : 0)  // 0..7. ВЫШЕ 0 ПОДНИМАТЬ ПО ОДНОЙ СТУПЕНИ, см. выше

/*
 * Мощность передатчика, дБм. 0 — не трогать, оставить заводскую (20).
 *
 * Снижать имеет смысл только вблизи: сильный сигнал перегружает приёмник, и
 * платы начинают терять пакеты, стоя рядом. На дистанции наоборот нужна вся.
 * Порчу изображения мощностью НЕ лечат: всё, что портит радио, ловится
 * контрольными суммами, а у нас frame_crc_err нулевой.
 */
#define TX_POWER 0


// --- камера ---
//
// OV5640 на этой плате: аппаратный JPEG-энкодер виснет и отдаёт пустые кадры на
// любом разрешении (проверено на двух модулях). Рабочий режим — снимать в
// RGB565 и жать в JPEG программно через frame2jpg().
// HQVGA — рабочий предел ЗАХВАТА на этой плате, а не выбор из экономии канала.
// 13.08-14.08: на 20 МГц HQVGA идёт чисто, QVGA (320x240) рвётся в клочья.
// QVGA это 153600 байт на кадр против 84480, почти вдвое больше через DMA в
// PSRAM — тракт не тянет. Он же выдавал EV-VSYNC-OVF в CameraSelfTest именно
// на QVGA. Сжатие тут ни при чём: на HQVGA работает то же самое сжатие.
// Чёткость поднимать через JPEG_QUALITY_SW, а не через разрешение.
/* 29.09 ОПЫТ: QVGA. Камера на HQVGA упирается в ~20 к/с сенсора, два кодировщика
 * дают запас по пикселям. Запреты 13-14.08 выше сняты на тракте без слип-диагноза;
 * смотреть EV-VSYNC-OVF и «ЗАХВАТ: поражено». Не взлетит — вернуть HQVGA. */
/* 06.10 ночь, ЧЕКПОИНТ 2: 480×320. С током выходов сенсора ×1 (CAM_DRIVE) и новым
 * кодировщиком (NEW_JPEG) на 5 м — 0,9–1,0 Мбит/с, 5–6 целых кадров/с, сенсор 8,8 к/с
 * (опыт drvq). На ×4 тот же кадр тяжелее на 13–18 % и захват вставал — см. CAM_DRIVE. */
#define FRAME_SIZE      FRAMESIZE_HVGA   // QQVGA(160x120) | HQVGA(240x176) | QVGA(320x240) | HVGA(480x320)

// 20 МГц — проверено обеими сторонами: на 16 кадр рвётся, на 24 (вместе с
// QVGA) захват уходит в сплошной EV-VSYNC-OVF и плата падает по сторожевому
// таймеру. 20 — единственная рабочая точка.
//
// 20 МГц, а не 16. Раньше стояло 16 «для запаса против EV-VSYNC-OVF».
// 13.08 выяснилось, что кадр приходит от драйвера уже рваным (проверено:
// буфер во время сжатия не меняется, два сжатия одного кадра дают побайтно
// одинаковый JPEG, crc_err на приёмнике 0 — то есть портит именно захват).
// У OV5640 внутренний PLL рассчитан на 20-24 МГц; на 16 МГц драйвер считает
// нестандартные делители, и PCLK выходит на грани того, что успевает
// защёлкнуть LCD_CAM у ESP32-S3. Отсюда пропущенные строки в кадре.
/*
 * 06.10: ОПЯТЬ 16 МГц — ради режима «DMA прямо в PSRAM», а не ради такта.
 *
 * Записи выше — эпоха радуги, которая 25.09 оказалась шлейфом (механика), так что
 * «на 16 хуже» тех дней доказательством не служит.
 *
 * Разобрано по дизассемблеру cam_config в libesp32-camera.a (arduino 2.0.9):
 * psram_mode = (xclk_freq_hz == 16000000) — литерал −16000000 и moveqz. Только
 * ровно 16 МГц включает режим, где DMA пишет кадр прямо в буфер в PSRAM.
 * На 20 МГц драйвер принимает строки во внутренний буфер DMA 30720 Б из двух
 * половин по 15360 Б (24 строки QVGA), и cam_task копирует каждую половину в
 * PSRAM. Очередь событий у неё — половин минус одна, то есть ОДНО место. Копию
 * последней половины надо успеть до VSYNC следующего кадра; при такте сенсора
 * ×1,5 (pll12, кадр 84 мс) не успевала: 1076 EV-VSYNC-OVF за 12 с, 2–3 к/с
 * вместо 5,5. В режиме PSRAM копии нет, очередь на 9 мест (10 половин).
 *
 * Цена режима: DMA пишет в PSRAM мимо кэша процессора — см. cam_cache_fresh().
 * Такт сенсора при 16 МГц восстанавливается множителем PLL (CAM_PLL_MUL).
 *
 * 06.10 12:19, ИТОГ: ОТКАЧЕНО В 20. Очередь вылечилась (EV-*-OVF 0 за 75 с), к/с
 * 6,1–7,8 против 5,5 — но «ЗАХВАТ: поражено» 99 % (838 из 843), шершавость ~11:
 * сдвиг байта почти в каждом кадре. Механизм тот же, что 15.09 (см.
 * CAM_FB_IN_DRAM): буфер GDMA крошечный, пока PSRAM занята кодировщиками, он
 * переполняется и байты теряются поштучно. На 20 МГц DMA пишет во внутреннюю
 * память, где делить шину не с кем. Значит, «13.08 на 16 хуже» было про это же.
 */
#define CAM_XCLK_HZ     20000000

/*
 * ДЕЛИТЕЛЬ PCLK СЕНСОРА: 1 — как настроил драйвер, 2 — вдвое медленнее.
 *
 * 15.09. Разобрана радуга: в сыром кадре RGB565, ещё до сжатия, начиная с
 * какого-то места пиксельная сетка съезжает на один байт, и дальше до конца
 * кадра старший и младший байты меняются ролями. Доказано сдвигом хвоста на
 * байт — картинка становится чистой (кадр 06: грубость 14.34 -> 2.99).
 * Значит на шине DVP теряется или появляется лишний байт, то есть не хватает
 * запаса по фронтам PCLK у LCD_CAM.
 *
 * Почему делитель, а не xclk. Понижать xclk уже пробовали 13.08 — см. запись
 * выше: на 16 МГц стало ХУЖЕ, потому что PLL самого OV5640 рассчитан на
 * 20-24 МГц и на 16 драйвер считает нестандартные делители. Ручка xclk тянет
 * за собой PLL. А регистр 0x3035 (SC_PLL_CONTRL1, биты 7:4 — системный
 * делитель) режет такт ПОСЛЕ PLL: xclk остаётся 20 МГц, PLL в расчётном
 * режиме, а PCLK становится вдвое медленнее.
 *
 * Кадров это не отнимет: сенсор и так выдаёт больше, чем мы успеваем
 * отправить — потолок стоит на UART, около 3.5-5 кадров/с.
 *
 * Пишем ПОСЛЕ esp_camera_init: инициализация сама программирует PLL, и наша
 * правка должна лечь поверх. Значение читается обратно и печатается в лог —
 * если драйвер его переиграет, это будет видно сразу.
 *
 * 15.09, ИТОГ: ОТКАЧЕНО В 1, ГИПОТЕЗА ЗАКРЫТА. Делитель применился
 * (в логе «0x3035 было 0x11, стало 0x21»), сенсор поехал вдвое медленнее —
 * и радуга осталась ровно та же, байт в байт того же характера. Значит дело
 * НЕ в запасе по фронтам PCLK: если бы LCD_CAM не успевал защёлкнуть, вдвое
 * более медленный такт это бы вылечил.
 *
 * Заплачено при этом дорого: съём кадра вырос с 0-4 мс до 2.8-3.4 с, поток
 * упал до 0.3 кадра в секунду. Так что /2 по этому регистру — не «вдвое
 * медленнее сенсор», а что-то заметно более грубое.
 *
 * Оставлено на 1 и с рабочим кодом: ручка проверена, писать её заново не
 * нужно, а понадобится другой делитель — менять одно число.
 */
#define CAM_PCLK_DIV    1

/*
 * ТАКТ СЕНСОРА — PLL OV5640 (06.10): 0 — как ставит драйвер, иначе множитель PLL.
 *
 * Зачем. На QVGA сенсор отдаёт кадр раз в 126 мс (~8 к/с, «кадр сенсора» в логе),
 * а на HQVGA тот же сенсор давал ~20 к/с (29.09). Камера сейчас — потолок всего
 * тракта: эфир и UART свободны наполовину, 5,5 к/с упираются в сенсор и сжатие.
 *
 * Почему так. Драйвер esp32-camera для RGB565 выбирает PLL по размеру кадра:
 * QVGA..HVGA — множитель 8, делитель PCLK 4 (такт системы ~16 МГц, PCLK ~8 МГц);
 * меньше QVGA — множитель 20, делитель 8 (~40 и ~10 МГц). Частота кадров идёт от
 * такта системы — на QVGA он в 2,5 раза ниже, отсюда и 126 мс. Ставим QVGA тот PLL,
 * что драйвер ставит HQVGA: на этой плате он проверен, а PCLK растёт только с 8
 * до 10 МГц (CAM_PCLK_DIV выше показал: срывы кадров не от фронтов PCLK).
 *
 * Пишем ПОСЛЕ esp_camera_init — он программирует PLL сам. Регистры PLL (0x3034..
 * 0x3037, 0x3108, 0x3824, 0x460C) печатаются до и после: по 0x3036 (множитель)
 * видно, что стояло на самом деле. Смотреть в логе «кадр сенсора» (ждём ~50 мс),
 * «ЗАХВАТ: поражено», «STAGE камера».
 *
 * 06.10, итог при XCLK 20 МГц: множитель 20/делитель 8 (кадр 50 мс) и 12/6 (84 мс)
 * — сенсор ускорялся как задумано, но драйвер тонул в EV-VSYNC-OVF (см.
 * CAM_XCLK_HZ). Теперь XCLK 16: множитель 15 даёт тот же такт системы, что 12 при
 * 20 МГц (16×15 = 20×12 = 240), то есть кадр 84 мс; делитель 6 оставляет PCLK
 * ~8 МГц, как у драйвера по умолчанию, — DMA в PSRAM пишет не быстрее прежнего.
 * 06.10 12:19: на 16 МГц кадры с порчей 99 % (см. CAM_XCLK_HZ) — назад 20 и 12/6,
 * теперь вместе с ENC_BUF_INTERNAL и VSYNC_PROBE.
 */
/* 06.10 17:35–17:40, опыт pllab (ABAB в одном включении, Q80, W=4, буферы jpge во
 * внутренней памяти, фильтр VSYNC 7): x1 — 6,5 и 7,6 к/с, сдвигов байта +13 и +12 за
 * этап; x1,5 — 6,9 и 5,5 к/с, сдвигов +494 и +441 (почти каждый кадр, радуга), кадр
 * JPEG от этого 12 КБ против 8. К/с такт ×1,5 не прибавил: конвейер упирается в JPEG
 * и UART, а правка слипа стоит 38 мс на кадр. ВЫКЛЮЧЕНО (0 — такт драйвера). */
#define CAM_PLL_MUL       0
#define CAM_PLL_PCLK_DIV  6
/* 1 — сенсор на CAM_PLL_MUL, 0 — как ставит драйвер; меняет опыт (exp_step_t.pll). */
static uint8_t cam_pll_fast = (CAM_PLL_MUL > 0) ? 1 : 0;
// 30, а не 20: чёткость поднимаем здесь, потому что разрешение упирается в
// захват (см. FRAME_SIZE выше), а канал ещё не выбран — на 460800 доступно
// около 46 КБ/с, а тратим примерно половину. Кадр вырастет примерно в
// полтора раза. Если fps просядет сильнее, чем хочется, — возвращать к 25.
/* 25.09: 60, а не 30. Узкое место переехало с провода на захват: после
 * FRAME_GAP_MS=0 стадия UART упала до 28 мс, но стадия камеры выросла до
 * 14-27 мс — конвейер просит кадры быстрее, чем их отдаёт сенсор, и ждёт.
 * Частоту уже не поднять (потолок ~18 к/с), значит поток растёт только
 * размером кадра: 125000 Б/с / 18 = 6950 Б на кадр против нынешних 4644.
 *
 * Почему это дёшево: время сжатия почти не зависит от размера выхода —
 * замеры 24.09 дали 2800 Б за 36 мс и 7300 Б за 40 мс, то есть выход
 * вырос в 2.6 раза, а время на 11%. DCT считается по пикселям, от
 * качества растёт только энтропийное кодирование. В бюджете кадра сейчас
 * 56 мс, из них 14-27 — простой в ожидании камеры; время на более крупный
 * JPEG там уже есть, оно просто тратится впустую.
 *
 * Побочно: картинка станет ЛУЧШЕ, а не хуже, и доля искажений сломанного
 * захвата в размере кадра уменьшится. */
/* 29.09: 80. С заводским RTS выше 60 не окупалось — канал не пропускал; с
 * выключенным RTS (RTS_SET_SYM) Q80 даёт 618 кбит/с при 6 к/с против 425 и 7
 * у Q60, Q90 — 680 кбит/с, но 3,9 к/с. См. журнал 29.09, 14:03–14:51. */
/* 06.10 ночь, ЧЕКПОИНТ 2: 70 — старт автокачества для 480×320. На 5 м оно на нём и
 * стоит: задержка ~350 мс между порогами AUTOQ_RTT_LO 300 и AUTOQ_RTT_HI 600. */
#define JPEG_QUALITY_SW 70               // 1..100, меньше — сильнее сжатие

/*
 * САМОПРОВЕРКА ЗАХВАТА ПРИ СТАРТЕ.
 *
 * 24.09. Байтовый слип («радуга») оказался НЕ накапливающимся: внутри прогона
 * размер кадра не растёт (по четвертям: чистый 2762->2675 Б, грязный
 * 6524->6156 Б). Прогон с первой секунды либо чистый, либо грязный, и таким
 * остаётся до конца. Значит состояние определяется при инициализации камеры.
 *
 * Отсюда две беды. Первая: половина прогонов 24.09 снята на испорченном
 * захвате, и мы этого не знали. Вторая: A/B по любому параметру требует цикла
 * питания на каждое плечо, то есть новой инициализации — и мы сравнивали не
 * параметр, а везение.
 *
 * Метрика та же, что в tools/frame_check.py: средняя разница между соседними
 * пикселями по горизонтали. Съехавшая на байт сетка RGB565 делает картинку
 * шершавой. Замеры 15.09 на ПК: чистый кадр 3.1-5.5, поражённый 12-21.
 * Порог 8.0 лежит посередине широкого зазора.
 *
 * ВАЖНО: сюжет влияет. Очень мелкий контрастный кадр (текст, жалюзи во весь
 * кадр) поднимает шершавость сам по себе. Поэтому вердикт ПЕЧАТАЕТСЯ ВСЕГДА:
 * даже без лечения это даёт признак «прогону верить нельзя», которого нам
 * не хватало.
 */
#define CAM_CHECK_ON        1     // 0 — не проверять вовсе
#define CAM_CHECK_THRESHOLD 8.0f  // выше — считаем захват испорченным
#define CAM_CHECK_FRAMES    5     // сколько кадров мерить (берём медиану)
#define CAM_CHECK_SKIP      2     // выбросить первые кадры: сенсор не устоялся
#define CAM_CHECK_ROW_STEP  8     // считать каждую N-ю строку
#define CAM_CHECK_TRIES     4     // сколько раз переинициализировать камеру

/*
 * Паузы.
 *
 * В версии на AT+TXDATA стояли CHUNK_GAP_MS=12 и FRAME_GAP_MS=80 — модуль
 * захлёбывался на третьей подряд команде и отвечал ERROR. Здесь команд нет,
 * захлёбываться нечему, и главный ограничитель — сам UART: 1427 байт на 115200
 * это 124 мс, паузы на их фоне почти ничего не значат.
 *
 * Небольшой зазор между пакетами всё же полезен: модуль режет поток по паузе на
 * линии, и если дать ему передохнуть, границы его кусков будут ближе к нашим.
 * На целостность это не влияет (у нас своё кадрирование), но чуть снижает
 * шанс переполнить внутреннее кольцо на всплеске.
 */
/*
 * ИЗМЕРЕНО 15.08 автоматическим перебором на 460800 (лог
 * tools/logs/halow_20260815_002744_gap-sweep.csv, счётчики брака сняты с
 * приёмника по USB — обратный канал по радио для этого не годится, он
 * глохнет, пока передатчик занимает эфир):
 *
 *   пауза   кбит/с   брак CRC
 *    15      165        0
 *    12      194        0
 *    10      197        0
 *     8      200        0
 *     6      203        0
 *     4      228        0
 *     2      5.7      115     <- обвал
 *
 * Между 4 и 2 мс не спад, а порог: пропускная способность падает в сорок раз
 * и появляется брак. Механика: кольцо модуля 2048 байт, пакет 1427, два
 * подряд не влезают, управления потоком нет. Пока радио успевает выгребать
 * кольцо между пакетами — потерь нет вовсе; как только перестаёт — рушится
 * сразу всё.
 *
 * 8 мс, а не 4: за 12% пропускной способности берём вчетверо больший отступ
 * от обрыва. На столе работало бы и 4, но в поле радио выгребает кольцо
 * медленнее (дистанция, помехи, ретрансмиссии), и запас понадобится.
 *
 * ВНИМАНИЕ: таблица снята на 460800, а сейчас стоит 230400. На вдвое более
 * медленной линии тот же пакет уходит вдвое дольше (62 мс вместо 31), то есть
 * у радио вдвое больше времени выгрести кольцо, и порог обвала сдвинут вниз.
 * 8 мс здесь заведомо с запасом. Захочешь вернуть потерянную скорость —
 * перезапусти GAP_SWEEP уже на 230400 и найди новую точку.
 */
/*
 * КОНВЕЙЕР: 1 — захват и сжатие на отдельном ядре, параллельно с передачей.
 *
 * Замерено 15.08: цикл кадра около 200 мс = сжатие 60 + UART 87 + паузы. Пока
 * шло сжатие, провод молчал; пока шла передача, простаивал процессор. Развели
 * по ядрам — цикл стал максимумом из двух времён, а не суммой.
 *
 * 0 — прежний последовательный путь, если понадобится сравнить.
 */
/*
 * 18.08: ВЫКЛЮЧАЛСЯ. С конвейером возвращалась порча картинки при нулевом
 * frame_crc_err — то есть кадр доезжал побайтно тем же, каким уехал, а уехал
 * уже битым. Камера пишет кадр по DMA в PSRAM одновременно с тем, как
 * кодировщик читает оттуда предыдущий, и шина этого не тянет.
 *
 * 20.08: ВКЛЮЧЁН СНОВА. Конкуренции за PSRAM больше нет: кодировщик работает
 * во внутренней памяти (см. ENCODE_FROM_SRAM ниже), и от него в PSRAM осталось
 * одно чтение кадра подряд вместо шестидесяти миллисекунд доступа вразнобой.
 *
 * Если полосы вернутся — вернуть сюда 0 и смотреть, помогло ли. Не помогло,
 * значит дело в окне копирования (оно есть и в последовательном режиме) —
 * его ловит CHECK_COPY.
 */
#define PIPELINE 1

/*
 * КОДИРОВЩИКОВ JPEG (29.09): 1 — одна задача на ядре 1, как было; 2 — вторая
 * такая же задача на ядре 0.
 *
 * Зачем. Кодер тратит время на пиксель: HQVGA ~41 мс на кадр на одном ядре,
 * это ~20 к/с и 0,5–0,7 Мбит/с, меньше, чем уже отдаёт канал (0,9–1 Мбит/с на
 * 5 м). Две задачи жмут два кадра одновременно.
 *
 * Почему на ядре 0 теперь можно. 25.08 конвейер оттуда увели: рвались кадры,
 * и это списали на голодание драйвера камеры (его задача живёт на ядре 0,
 * CONFIG_CAMERA_CORE0). 26.09 доказано, что слип — наводка собственного
 * передатчика, а не драйвер. Кроме того, задача драйвера идёт с приоритетом
 * configMAX_PRIORITIES-2 и вытесняет наш приоритет 1 сразу. Проверка встроена:
 * строка «ЗАХВАТ: поражено …» покажет, если рвань вернётся.
 *
 * Как устроено. Захват (fb_get, проверка и правка слипа) общий и идёт под
 * замком cap_mutex, сжатие — параллельно, каждый из своего буфера камеры (они
 * в PSRAM, копия не нужна). Кадры нумеруются при захвате (cap_seq); если новый
 * сожмётся раньше старого, старый при отправке выбрасывается (enc_reordered),
 * порядок на приёмнике не ломается. Буферов камеры 4: два держат кодировщики,
 * драйверу остаётся куда писать.
 *
 * Только с ENCODE_FROM_SRAM 0 и CAM_FB_IN_DRAM 0 (там один общий буфер).
 */
#define ENC_WORKERS 2

/*
 * СЖАТИЕ ИЗ ВНУТРЕННЕЙ ПАМЯТИ: 1 — скопировать кадр из PSRAM в SRAM и сжимать
 * уже копию.
 *
 * ЧТО ЛЕЗЛО В PSRAM РАНЬШЕ — не только кадр. arduino-esp32 собран с
 * CONFIG_SPIRAM_MALLOC_ALWAYSINTERNAL=4096, то есть обычный malloc отдаёт из
 * PSRAM всё, что крупнее 4 КБ. А крупнее 4 КБ у нас:
 *   - строчные буферы самого кодировщика (jpge держит полосу в 16 строк,
 *     на ширине 240 это около 12 КБ);
 *   - готовый JPEG, который frame2jpg возвращает через malloc (7-9 КБ);
 *   - и из этого же JPEG потом читает UART все 150 мс передачи.
 * Плюс сам кадр: 84 КБ, которые кодировщик читает не подряд, а блоками по
 * 16 строк, то есть с постоянными промахами кэша.
 *
 * Против всего этого стоит DMA камеры, которому опаздывать нельзя: строка
 * пришла с сенсора — положить её надо сейчас, а не когда освободится шина.
 * Проигрывает он, и это те самые полосы.
 *
 * ЧТО ДЕЛАЕМ — два действия, оба в setup():
 *   1) heap_caps_malloc_extmem_enable(INTERNAL_MALLOC_LIMIT) поднимает порог,
 *      после чего буферы кодировщика и готовый JPEG живут во внутренней
 *      памяти, а UART оттуда же их и читает;
 *   2) один раз выделяем внутренний буфер под кадр и копируем кадр в него.
 * После этого в PSRAM остаются только запись DMA и одно наше чтение 84 КБ
 * подряд — самый дружелюбный к шине режим доступа, единицы миллисекунд.
 *
 * ПОБОЧНЫЙ ВЫИГРЫШ: сжатие из SRAM само по себе быстрее, чем из PSRAM. На
 * сколько — видно в строке STAGE, где копия и JPEG печатаются раздельно.
 *
 * ЕСЛИ БУФЕР НЕ ВЫДЕЛИЛСЯ (не хватило внутренней памяти) — работаем как
 * раньше, прямо из PSRAM, и конвейер тогда НЕ включается: без развязки он
 * снова порвёт картинку. Об этом печатается строка в лог.
 */
#define ENCODE_FROM_SRAM 0

/*
 * БУФЕР ЗАХВАТА ВО ВНУТРЕННЕЙ ПАМЯТИ: 1 — кадр от камеры сразу в SRAM,
 * PSRAM в тракте захвата не участвует вовсе.
 *
 * 15.09. Разобрана радуга: в сыром кадре, ещё до сжатия, с какого-то места
 * пиксельная сетка съезжает на ОДИН БАЙТ, и дальше до конца кадра старший и
 * младший байты RGB565 меняются ролями. Доказано сдвигом хвоста на байт —
 * картинка становится чистой (кадр 06: грубость 14.34 -> 2.99).
 *
 * Поимённо оправданы: провод (frame_crc_err 0 при живой радуге), копия в
 * SRAM (CHECK_COPY: 0 расхождений на 71 кадре), конвейер (выброшено 0),
 * кодировщик (разница с сырым кадром — только шум квантования), и наконец
 * скорость шины (делитель PCLK выше — не помог).
 *
 * Остаётся пропускная способность PSRAM. Пока DMA камеры пишет туда кадр, мы
 * из той же PSRAM читаем предыдущий. Буфер GDMA между шиной камеры и памятью
 * крошечный: PSRAM занята нашим чтением — он переполняется и байты теряются
 * поштучно. Это сходится и с разбросом смещений от кадра к кадру, и с тем,
 * что перенос СЖАТИЯ в SRAM (26.08) улучшил картину, но не вылечил: чтение
 * 84 КБ никуда не делось, оно лишь стало короче.
 *
 * Здесь убираем PSRAM из тракта совсем: буфер камеры в SRAM, DMA пишет во
 * внутреннюю память, делить с нами ей нечего.
 *
 * ПОЧЕМУ ENCODE_FROM_SRAM при этом 0. Копия PSRAM->SRAM теряет смысл: кадр и
 * так уже в SRAM, копировать его самому в себя незачем. Заодно освобождаются
 * 84 КБ, без которых два буфера захвата во внутреннюю память не влезли бы:
 * свободно 227 КБ, два буфера по 84 КБ это 169.
 *
 * ДВА буфера, а не один: пока мы 36 мс сжимаем кадр из своего буфера,
 * сенсору надо куда-то писать следующий. Если двух не хватит (init вернёт
 * ESP_ERR_NO_MEM), код сам переспросит один — тогда сенсор будет ждать нас,
 * кадров станет меньше, но рвани не будет.
 */
/* 25.09 ОПЫТ: временно 0. Захват сломан (самопроверка 17-18 при пороге 8),
 * и единственное, что изменилось с чистого состояния 24.09, — скорость UART:
 * было 460800, стало 3000000. На 3 Мбод ESP32 гоняет через внутреннюю память
 * ~300 КБ/с в обе стороны, а буфер камеры с 15.09 лежит ТАМ ЖЕ. Это та же
 * конкуренция за шину, что 15.09 диагностировали для PSRAM, только теперь мы
 * сами создали её в SRAM.
 * Уйдёт слип — версия верна. Усилится — дело не в шине, возвращаем 1. */
#define CAM_FB_IN_DRAM 0

/*
 * Порог, ниже которого malloc берёт из внутренней памяти. Заводские 4 КБ малы
 * для буферов кодировщика (12 КБ) и готового JPEG (до 20 КБ на высоком
 * качестве), 64 КБ покрывают оба с запасом.
 *
 * Это не «отключить PSRAM»: когда внутренняя память кончится, аллокатор всё
 * равно возьмёт из PSRAM — просто перестанет делать это по умолчанию. WiFi мы
 * не поднимаем, других крупных потребителей внутренней памяти нет.
 */
#define INTERNAL_MALLOC_LIMIT 65536

/*
 * БУФЕРЫ КОДИРОВЩИКА ВО ВНУТРЕННЕЙ ПАМЯТИ (06.10): 1 — порог malloc поднят всегда.
 *
 * 25.09 вместе с CAM_FB_IN_DRAM выключился и подъём порога: он стоял под
 * #if ENCODE_FROM_SRAM || CAM_FB_IN_DRAM, а оба флага теперь 0. С тех пор полоса
 * jpge в 16 строк (на QVGA 320×16×3 = 15 КБ, по одной на каждый из двух
 * кодировщиков) живёт в PSRAM, и сжатие кадра QVGA идёт 150–200 мс вместо
 * ожидаемых ~75 (41 мс на HQVGA, 20.08, когда порог стоял). Тем же доступом
 * вразнобой кодировщики забивают PSRAM, куда cam_task копирует половины кадра:
 * при такте сенсора ×1,5 копия не успевает до VSYNC — EV-VSYNC-OVF.
 * Свободно ~257 КБ внутренней памяти, две полосы — 30 КБ.
 */
#define ENC_BUF_INTERNAL 1

/*
 * КОДИРОВЩИК esp_new_jpeg (06.10): 1 — сжатие библиотекой Espressif esp_new_jpeg 1.0.2
 * (SDK/esp_new_jpeg-1.0.2, подключена в platformio.ini), 0 — fmt2jpg из esp32-camera.
 *
 * Зачем. Прогон 06.10 20:00 на 5 м: 5,3 к/с, 766 кбит/с — сжатие 149 мс на кадр QVGA
 * на сложной сцене, да ещё кодировщик на ядре 1 делит его с передачей по UART. По
 * таблице Espressif ESP32-S3 жмёт им 320x240 за ~22–33 мс (векторные команды S3).
 * Вход — RGB565 как отдаёт камера: старший байт первым (так же его читает fmt2jpg),
 * то есть JPEG_PIXEL_FORMAT_RGB565_BE; 4:2:0, как у fmt2jpg. Входной буфер на S3
 * должен быть выровнен по 16 байт — буфер камеры проверяем, при невыровненном
 * копируем в выровненный (печать «NEWJPEG:» один раз). У каждого кодировщика
 * (ядро 0 и ядро 1) свой экземпляр: состояние у библиотеки своё на каждый.
 */
#define NEW_JPEG 1

/*
 * ЩУП VSYNC (06.10): 1 — считать фронты на ножке VSYNC прерыванием GPIO и
 * печатать их в секунду (строка «VSYNC:»). Ничего не меняет в захвате: ножка
 * остаётся входом LCD_CAM, мы лишь вешаем на неё ещё и прерывание.
 *
 * Зачем. На ×1,5 драйвер печатал ~90 EV-VSYNC-OVF в секунду при ~12 кадрах
 * сенсора — по одному событию на кадр столько не набрать. Честный VSYNC —
 * два фронта на кадр (24/с на 84 мс). Намного больше — ножку дёргает помеха.
 */
/* 06.10 17:19–17:21, ИТОГ: на тёмной картинке ~1000 фронтов/с, как только в кадре
 * появилось изображение — ~196 000/с. Это наводка с линий данных шлейфа на линию
 * VSYNC; LCD_CAM её отфильтровывает (EV-*-OVF 0 за 150 с, поражено 0 %), а наш
 * обработчик на каждый фронт съедал до трети ядра. Выключен. */
#define VSYNC_PROBE 0

/*
 * ФИЛЬТР VSYNC В LCD_CAM (06.10): 0 — как настроил драйвер, 1..7 — порог фильтра
 * (поле cam_vsync_filter_thres, 3 бита) и фильтр включён.
 *
 * Зачем. Щуп показал на линии VSYNC до ~196 000 фронтов в секунду при живой
 * картинке — наводка с линий данных шлейфа. Сборка со щупом шла без единого
 * EV-VSYNC-OVF, а такая же без щупа (17:26, опыт pllab) — 20–60 в секунду с самой
 * загрузки, на обоих тактах сенсора. Версия: обработчик щупа нагружал ядро, и
 * прерывание VSYNC драйвера запаздывало — пачка помех сливалась в одно событие.
 * Без щупа каждая помеха, прошедшая фильтр драйвера (порог 4), — отдельное
 * событие в очередь на одно место. Порог 7 — самый длинный, что даёт железо.
 * Ставим после esp_camera_init; вступает в силу со следующего cam_update (начало
 * кадра в ll_cam_start).
 */
#define CAM_VSYNC_FILTER 7

/*
 * СИЛА ВЫХОДОВ СЕНСОРА (06.10): 0 — как ставит библиотека, 1..4 — ×1..×4
 * (OV5640, регистр 0x302C, биты 7:6).
 *
 * Зачем. Библиотека esp32-camera пишет 0x302C = 0xC3 — максимальный ток выходов,
 * ×4 (найдено в таблице регистров libesp32-camera.a, рядом с 0x4740 = 0x21).
 * Крутые фронты на шлейфе дают перекрёстную наводку: щуп VSYNC видел до
 * ~196 000 фронтов в секунду при живой картинке и ~1000 при тёмной. Та же
 * наводка на PCLK — лишний или потерянный байт, то есть слип. Кадр с потерянным
 * байтом не добирает последнюю половину DMA, и драйвер молча выбрасывает его
 * (FB-SIZE); кадр с лишним доходит с радугой. 480×320 на 5 м 06.10: сдвиг в 99 %
 * кадров и 1,4 к/с при 3 дБм на передаче; на столе со спокойной сценой — 0 % и
 * 7 к/с. PCLK у нас ~10 МГц, для него и ×1 хватает с запасом.
 */
/* 06.10 ночь, ЧЕКПОИНТ 2: ×1. Три опыта (drvab, drvq): при том же Q кадр на 13–18 %
 * легче (Q70: 19,3–20,3 КБ против 22,8–22,9), через тот же канал проходит на ~20 %
 * больше кадров; сенсор 8,8 к/с против 8,0. Все три зависания захвата за вечер — на ×4. */
#define CAM_DRIVE 1

/*
 * СЧЁТЧИК СИГНАЛОВ СЕНСОРА (06.10 ночь): 1 — считать фронты VSYNC и HREF блоком
 * PCNT (железо, ядро не грузит) и печатать раз в период статистики.
 *
 * Зачем. 06.10 в 21:22 и 22:18 на 480×320 камера вставала: ни одного кадра, и
 * перезапуск драйвера (с аппаратным сбросом сенсора по RESET) не помогал — только
 * снятие питания. Счётчик скажет, кто молчит: идут VSYNC и HREF — сенсор жив, стоит
 * захват ESP (LCD_CAM/GDMA); нули — молчит сам сенсор. Фильтр PCNT 12,5 мкс
 * отсекает иголки наводки (щуп VSYNC видел их до ~196 000 в секунду); настоящие
 * VSYNC и HREF длиннее (строка HREF при 480×320 ~96 мкс).
 */
#define CAM_SIG_COUNT 1

/*
 * ИЗМЕРЕНО ПОВТОРНО 18.08 на 230400: обрыв ровно там же, между 4 и 2 мс —
 * при 2 мс ap_crc_err пошёл с 9 до 62, ap_junk до 45 тысяч. Предсказание,
 * что на вдвое медленной линии запас будет вдвое больше, НЕ подтвердилось.
 * Значит порог держится не только временем на выгребание кольца.
 * 4 мс — максимум скорости, 8 — с запасом на дистанцию.
 */
/*
 * 4 мс, а не 8. Изменено 01.09.
 *
 * Кривая из замера 15.08 (автоперебор, tools/logs/..._gap-sweep.csv):
 *   15 мс — 165 кбит/с   10 — 197   6 — 203
 *   12 мс — 194           8 — 200   4 — 228
 * От 12 до 6 она почти плоская, весь выигрыш сидит на переходе к 4: +14%.
 * Промежуточные значения перепрошивки не стоят.
 *
 * Чем платим. У модуля кольцо 2048 байт и никакого управления потоком:
 * переполнилось — байты пропали молча. Пауза даёт кольцу опорожниться, и 2 мс
 * это уже обрыв, а не спад — 5.7 кбит/с и 115 ошибок CRC. То есть 4 мс держат
 * двойной отступ от порога вместо четырёхкратного.
 *
 * Почему сейчас можно. Прежнее значение 8 выбиралось «в поле радио выгребает
 * кольцо медленнее», то есть с запасом на неизвестность. Сегодня канал измерен
 * и работает на 4 МГц без единого обрыва за 44 минуты, так что запас на
 * неизвестность больше не нужен на стенде.
 *
 * ПРОВЕРЯТЬ ПОСЛЕ ИЗМЕНЕНИЯ: ap_crc_err и ap_junk в CSV. Если они перестали
 * быть нулевыми — кольцо переполняется, вернуть 8. Это ровно тот счётчик,
 * которым порог и был найден.
 *
 * Перед выездом на дистанцию вернуть 8: там время выгребания кольца зависит от
 * того, как быстро радио отдаёт кадры, а это уже не наша переменная.
 *
 * ═══ ПРОВЕРЕНО 01.09: ПАУЗА ЗАВИСИТ ОТ ПОЛОСЫ. ═══
 *
 * ТЕКУЩЕЕ ЗНАЧЕНИЕ 4 — только для опыта на 8 МГц. Для рабочей полосы 2 и
 * 4 МГц ставить 8, иначе стенд рассыпается, см. ниже.
 *
 * При 4 мс на полосе 2 МГц стенд рассыпался полностью:
 *
 *     поток 9.3 кбит/с (было 129), кадров целых 0 из 340,
 *     crc_err=2297, len_err=7, junk=1531255, обрывов 16
 *
 * А замер 15.08, на который я опирался, снимался на полосе 8 МГц — и там 4 мс
 * давали 228 кбит/с без единой ошибки. Разница не в пауз', а в том, **как
 * быстро радио выгребает кольцо**: на 2 МГц оно отдаёт кадр вчетверо дольше,
 * чем на 8, и того же запаса уже не хватает.
 *
 * Отсюда правило, которого раньше не было: **CHUNK_GAP_MS нельзя переносить
 * между полосами.** Кривая пауз, измеренная на одной ширине канала, к другой
 * неприменима. Сужая полосу ради надёжности, мы одновременно замедляем сток
 * кольца и обязаны паузу УВЕЛИЧИВАТЬ, а не уменьшать.
 *
 * Практический вывод: 8 мс работают на 2 МГц (129 кбит/с, нули по всем
 * счётчикам брака) и работали на 8 МГц. Трогать без повторного перебора на той
 * полосе, на которой собираешься работать, — нельзя.
 */
/* 6, а не 8: подтверждено ПЯТЬЮ независимыми переборами 16-17.09 — на 6 мс
 * брак нулевой во всех, на 4 мс обвал во всех. Порог не сдвинулся ни при смене
 * модуляции, ни при убавлении мощности, ни при вдвое меньшем PER, значит это
 * внутреннее свойство модуля, а не время выгребания кольца в эфир. Прежние 8
 * были взяты с запасом на другой конфигурации и стоили около 5% скорости. */
/* 25.09: 3, а не 6. Перебор на 3 Мбод с кольцом 8 КБ и выгребанием FIFO:
 * 8/6/5/4/3 мс — брак НОЛЬ, на 2 мс обвал (25.6% потерь чанков, 822 тыс.
 * байт мусора), на 1 мс — 99.6%. Прежние 6 мс были намерены 16-17.09 на
 * кольце 2 КБ и на приёме, где 89.5% байт приходили с переполнением FIFO;
 * то есть это был не порог модуля, а следствие двух уже снятых причин.
 * Стена на 2 мс — собственный таймер тишины модуля (250<<3 мкс). */
#define CHUNK_GAP_MS  3
/*
 * 29.09: ПАУЗА ОТ КОНЦА ПЕРЕДАЧИ, мкс. 0 — старая пауза CHUNK_GAP_MS.
 *
 * Модуль режет поток UART на эфирные кадры по таймеру тишины. В сборке
 * ..._sil400 он укорочен с 2000 до 400 мкс (movi r1,250 -> 50 в
 * uart_p2p_irq_hdl, см. SDK/builds). СТАВИТЬ ТОЛЬКО С ЭТОЙ СБОРКОЙ В ОБОИХ
 * МОДУЛЯХ: со старой 600 мкс склеят чанки в кадр больше 1500 Б, и модуль его
 * выбросит.
 *
 * Почему от конца передачи. Буфер передачи у SerialAT нулевой, write()
 * возвращается, когда в аппаратном FIFO ещё до 128 байт (~0,43 мс на 3 Мбод).
 * Старый delay(3) давал на проводе ~2,57 мс тишины, а delay(2) — ~1,57 мс,
 * меньше таймера: отсюда обвал на 2 мс 25.09. Теперь flush() ждёт, пока
 * последний байт уйдёт, и тишина равна ровно CHUNK_GAP_US.
 * Выигрыш: на чанк 1429 Б 4,76 + 0,6 = 5,4 мс вместо ~7,3.
 */
#define CHUNK_GAP_US  2000   /* 29.09: подбор 0,6/1,0/1,5/2,0 мс — на 2,0 ноль потерь на входе модуля, см. SDK/builds/SIL400_2026-09-29.txt */
/*
 * 0, а не 10. Перебор 17.09 (два полных круга, здоровое радио — одноадресный
 * режим, убавленная мощность, потолок MCS 4):
 *
 *     20 мс  168.3 кбит/с   15 мс  223.9   10 мс  211.5
 *      6 мс  236.8           4 мс  239.4    2 мс  246.3    0 мс  249.6
 *
 * Брак нулевой на всех ступенях кроме первой (38 байт на разгоне), а потеря
 * чанков на нуле оказалась НАИМЕНЬШЕЙ из всех — 0.37%. То есть пауза после
 * кадра не нужна вообще: она досталась по наследству от версии на AT+TXDATA,
 * где стояла 80 мс, и с тех пор ни разу не проверялась.
 *
 * ПЕРЕД ВЫЕЗДОМ НА ДИСТАНЦИЮ ПЕРЕМЕРИТЬ. Пауза между чанками, как выяснено
 * пятью переборами, от состояния эфира не зависит — но про паузу кадра этого
 * никто не проверял, а мерили её только вблизи.
 */
#define FRAME_GAP_MS  0    // 25.09: A/B против паузы 10 мс (708.4 кбит/с,
                           // потери ~0, стадия UART 41-46 мс).
                           //
                           // Улик против нуля нет: перебор 17.09 дал на нуле
                           // ЛУЧШИЙ поток и НАИМЕНЬШУЮ потерю чанков (0.37%),
                           // а провал 24.09 списан на шлейф — контрольный
                           // прогон на паузе 10 без касания железа был таким же
                           // плохим.
                           //
                           // Механика: модуль режет поток на эфирные пакеты по
                           // 2 мс тишины, а пауза между чанками у нас 3 мс —
                           // то есть таймер тишины срабатывает после каждого
                           // чанка и без паузы кадра. Граница кадра для модуля
                           // ничем не выделена, эта пауза просто добавлялась
                           // сверху. Наследство версии на AT+TXDATA.

/*
 * ПЕРЕБОР ПАУЗЫ КАДРА: 1 — скетч сам перебирает FRAME_GAP_MS и кладёт текущее
 * значение в то же поле, что и перебор паузы чанка.
 *
 * ЗАЧЕМ. Межчанковую паузу мы перебирали пять раз, а паузу КАДРА — ни разу, и
 * она досталась по наследству от версии на AT+TXDATA, где стояла 80 мс. При
 * девяти кадрах в секунду десять миллисекунд после каждого съедают 90 мс из
 * каждой секунды — около 9% провода, и порог её никто не мерил.
 *
 * Ноль в списке значений намеренно: надо выяснить, нужна ли она вообще. Если
 * брак не появится и на нуле, паузу кадра можно убрать совсем.
 *
 * ВКЛЮЧАТЬ ПО ОДНОМУ. Одновременно с GAP_SWEEP не имеет смысла: оба кладут своё
 * значение в одно поле, и разобрать, какое именно, будет нечем.
 */
#define FRAME_GAP_SWEEP  0
static const uint16_t frame_gaps[] = {20, 15, 10, 6, 4, 2, 0};

/*
 * ПОДБОР ПАУЗЫ: 1 — скетч сам перебирает значения и печатает таблицу.
 *
 * Пауза между чанками — компромисс: чем она меньше, тем больше кадров в
 * секунду, но тем выше риск переполнить кольцо модуля и потерять байты
 * (см. комментарий к CHUNK_GAP_MS выше). Рабочая точка — наименьшая пауза,
 * на которой брак по CRC ещё нулевой.
 *
 * Перебирать вручную значит перепрошивать плату под каждое значение. Вместо
 * этого держим каждое SWEEP_STEP_MS, считаем брак по отчётам приёмника и
 * печатаем строку итога. Первые SWEEP_SETTLE_MS каждого шага не считаем:
 * отчёт приходит раз в секунду и на границе шага относится ещё к прошлому.
 *
 * После прогона вписать найденное в CHUNK_GAP_MS и поставить сюда 0.
 */
#define GAP_SWEEP  0
#define SWEEP_STEP_MS   60000   /* 25.09: было 45 с; ступень удлинена,
                                   * чтобы медленные эффекты успевали
                                   * проявиться — на коротких ступенях
                                   * мы уже обжигались 24.09 */
#define SWEEP_SETTLE_MS 4000

/*
 * РАЗМЕР ЧАНКА.
 *
 * 1400 байт — рабочее значение вблизи, и оно же стоит по умолчанию в
 * собственной измерительной утилите вендора (AT+UDPTEST: data_len 1400,
 * data_interval 10 мс — почти в точности наши 1400 и 8 мс, подобранные
 * перебором).
 *
 * НО для дальней связи руководство по мосту требует другого: «при
 * использовании MCS 2/1/0/10 необходимо установить MTU в 300 байт». На
 * дистанции модуль сползает на низкие MCS, длинный пакет дольше висит в
 * эфире и его чаще убивает замирание. Наши 1429 байт в поле дали 3,7%
 * потерь чанков и обрывы на десяти метрах.
 *
 * 270 = 300 минус наши заголовки (7 потоковых + 22 прикладных).
 */
#define CHUNK_PAYLOAD 1400

/*
 * ПОДБОР РАЗМЕРА ЧАНКА: 1 — перебирать значения и складывать результат в CSV.
 *
 * Приёмнику знать размер не нужно: каждый чанк несёт свою длину, а кадр —
 * общее число чанков. Поэтому размер можно менять на ходу, ничего не
 * перепрошивая на той стороне.
 *
 * Действующее значение едет в поле rssi заголовка (делённое на 20, чтобы
 * влезть в знаковый байт) и попадает в CSV в столбец sta_rssi. Умножь на 20
 * и получишь байты: 70 -> 1400, 35 -> 700, 23 -> 460, 13 -> 260.
 */
#define PAYLOAD_SWEEP    0
#define PSWEEP_STEP_MS   20000
#define PSWEEP_SETTLE_MS 5000

#define STATS_PERIOD_MS 2000
#define LINK_TIMEOUT_MS 5000   // нет 'S' от приёмника дольше — считаем связь потерянной

/*
 * НЕ ВЕЩАТЬ ВСЛЕПУЮ: ждать первого 'S' от приёмника, прежде чем начать поток.
 *
 * До 27.08 камера начинала лить видео сразу после стартового окна, независимо
 * от того, есть связь или нет (комментарий «курица и яйцо» в captureFrame).
 * Курицы с яйцом здесь на самом деле нет: приёмник шлёт свой отчёт 'S' раз в
 * секунду безусловно, ему для этого ничего от нас не нужно. А получить этот
 * отчёт камера может только будучи ассоциированной — значит первый 'S' и есть
 * доказательство связи, причём единственное доступное на прозрачной прошивке.
 *
 * Зачем это нужно. Пока связи нет, поток всё равно никуда не доезжает, зато
 * модуль камеры занят: 18 КБ/с в UART, разбор, попытки отправки. Молчащий
 * модуль имеет заметно больше шансов спокойно отсканировать эфир и пройти
 * ассоциацию. Заодно исчезает целый класс вопросов «мешает ли наш поток
 * подключению» — теперь не мешает по построению.
 *
 * Побочная польза для диагностики: строка «жду отчёта приёмника, N с» в
 * консоли прямо говорит, что ассоциация не состоялась. Раньше на её месте были
 * бодрые fps, за которыми не стояло ни одного доехавшего байта.
 *
 * HELLO_WAIT_MAX_MS = 0 — ждать бесконечно (так и надо на отладочном стенде:
 * молчание камеры и есть результат замера). Ненулевое значение — аварийный
 * клапан: столько миллисекунд подождать и начать вещать вслепую, как раньше.
 */
#define WAIT_FOR_HELLO     1
#define HELLO_WAIT_MAX_MS  0

/*
 * Период маячка, пока ждём первого отчёта. 0 — не слать вовсе (то поведение,
 * которое 01.09 дало вечное ожидание).
 *
 * ИСПРАВЛЕНИЕ К КОММЕНТАРИЮ ВЫШЕ. Там сказано, что курицы с яйцом нет, потому
 * что приёмник шлёт отчёт безусловно. Это верно только про приёмник. Про
 * камеру — нет: в прозрачном режиме её модуль формирует пакеты из того, что
 * пришло в UART, и без данных ассоциацию не форсирует.
 *
 * Измерено: камера молчала 240 с, приёмник всё это время показывал RSSI 0 и
 * sta_cnt 0 при пустой очереди — то есть не слышал её ни разу. Связь не
 * вставала, потому что нечему было её начать.
 *
 * Секунда выбрана как заведомо достаточная и заведомо дешёвая: 11 байт на
 * пакет против 19 КБ/с потока — влияние на занятость эфира пренебрежимое,
 * ровно то, ради чего гейт и вводился.
 */
#define HELLO_PROBE_MS     1000

/*
 * Прекращать ли поток, если отчёты приёмника пропали.
 *
 * По умолчанию 0, и это осознанно. Обратный канал глохнет, пока передатчик
 * занимает эфир: 15.08 замерено, что доходило около 10% отчётов. При периоде
 * 1 с это значит «в среднем один отчёт в десять секунд», и короткий таймаут
 * загонит скетч в качели «пошёл поток — отчёт потерялся — встал — пришёл
 * отчёт — пошёл». Поэтому гейт работает только на СТАРТ: важно не вещать до
 * ассоциации, а обрыв уже установленной связи ловится по link_up и виден в
 * логе. Включать только вместе с заведомо большим HELLO_LOST_MS.
 */
#define RESTREAM_ON_HELLO_LOSS 0
#define HELLO_LOST_MS          30000

/*
 * ДИАГНОСТИКА: 1 — снять один кадр при старте и слать его по кругу.
 *
 * Нужно, чтобы отделить порчу картинки в камере от порчи в передаче. Байты на
 * входе передатчика перестают меняться, и картинка на экране отвечает сама:
 *   полосы на одних и тех же местах  -> испорчен исходный JPEG, виновата камера
 *   полосы каждый раз новые          -> портит наш путь (UART/радио/сборка)
 *   картинка чистая                  -> камера портит кадры по-разному
 *
 * В рабочем режиме держать 0.
 */
#define TEST_PATTERN 0

/*
 * СИНТЕТИЧЕСКИЙ ИСТОЧНИК (28.09): 1 — снять один кадр при старте и гонять его
 * копии через обычный конвейер с окном FC_WINDOW. Камера и кодер в замере не
 * участвуют, поэтому упираемся в канал: UART с паузами между чанками, модуль,
 * эфир, приёмник, подтверждения. Отличие от TEST_PATTERN: тот шлёт в обход
 * окна и конвейера и меряет порчу, а этот — потолок канала в рабочем тракте.
 *
 * Зачем. С окном W=3 канал на столе простаивал: окно закрыто 3 % времени,
 * упор в сжатие (~20 к/с по 3,4 КБ = 0,54 Мбит/с). Расчёт в журнале (раздел 8)
 * даёт потолок провода 1,45 Мбит/с при паузе 3 мс — это и проверяем.
 *
 * В рабочем режиме держать 0.
 */
#define SYNTH_SOURCE 0   /* 29.09: живая камера, два кодировщика */

/*
 * СИНТЕТИКА БЕЗ КАМЕРЫ (30.09): 1 — камера не запускается вовсе, кадр для
 * синтетики — SYNTH_NOCAM_LEN байт из памяти (FF D8 ... FF D9, внутри шум).
 * Видео нет, меряется только радио. Зачем: 29.09 при перестановке плат на
 * плате Б сенсор отдавал пустые кадры («шершавость 0.00»), драйвер сыпал
 * EV-VSYNC-OVF сотнями в секунду и душил ESP32 — стартовое окно модуля не
 * открылось (0 ответов OK), пакеты рвались посреди чанка.
 */
#define SYNTH_NOCAM     0
#define SYNTH_NOCAM_LEN 8400

/*
 * ОПЫТ ПО ВРЕМЕНИ (29.09): 1 — после подъёма связи камера сама проходит этапы
 * exp_steps и в конце каждого печатает строку «ОПЫТ ИТОГ». Всё за одно
 * включение питания: камера стоит в 5 м, ходить к ней не нужно.
 *
 *   Q60/Q80/Q90 — качество JPEG на живом видео. В 5 м канал берёт ~960
 *     кбит/с, а камера отдаёт ~435: сенсор на 320x240 даёт кадр раз в
 *     126 мс, fps не поднять, значит поток растёт только размером кадра.
 *   СИНТ сенсор вкл/ВЫКЛ — синтетика (один кадр по кругу), такт XCLK
 *     сенсора остановлен или идёт. Повторы — это неуслышанные подтверждения
 *     (to(frm) при нуле промахов CTS), а фон у камеры около −60 дБм против
 *     −87 у приёмника: плата шумит. Затихнет шлейф — станет ли меньше повторов?
 *   СИНТ кусок 700/350 — зависят ли повторы от длины пакета в эфире.
 *
 * Первые EXP_WARM_MS каждого этапа не считаются (переходный процесс). После
 * последнего — живое видео с настройками по умолчанию. RTS меняется только в
 * стартовом окне — он в VAR_SWEEP, по включениям питания.
 *
 * 29.09 вечер: этапы — окно W и пауза после пакета на синтетике, потом живое
 * видео с автокачеством (AUTO_Q). Поля win/gap_us/autoq в exp_step_t.
 */
#define EXP_PROGRAM   0   /* 29.09 вечер: рабочая прошивка — опыты выключены, см. журнал */
#define EXP_SETTLE_MS 20000   /* от подъёма связи до первого этапа: регулятор мощности */
#define EXP_WARM_MS   10000   /* начало этапа, которое не считаем */
typedef struct {
    const char *name;
    uint8_t     synth;      /* 1 — синтетика */
    uint8_t     xclk_off;   /* 1 — такт сенсора остановлен (только с синтетикой) */
    uint16_t    chunk;      /* байт полезной нагрузки в пакете */
    uint8_t     q;          /* качество JPEG (с autoq — стартовое) */
    uint16_t    secs;
    uint8_t     win;        /* окно кадров в полёте */
    uint16_t    gap_us;     /* пауза после пакета, мкс */
    uint8_t     autoq;      /* 1 — качество подбирает AUTO_Q */
    uint8_t     pll;        /* 1 — такт сенсора CAM_PLL_MUL, 0 — как у драйвера (06.10) */
    uint8_t     drv;        /* 1..4 — сила выходов сенсора ×1..×4, 0 — не трогать (06.10) */
    uint8_t     gate;       /* паузы передачи: 0 — как GATE_FORCE, 1 — выкл, 2 — вкл (06.10) */
} exp_step_t;
static volatile bool synth_on = SYNTH_NOCAM;         /* синтетика включена опытом */
static uint8_t  jpeg_q_rt = JPEG_QUALITY_SW;   /* качество JPEG сейчас */

/*
 * АВТОКАЧЕСТВО JPEG (29.09): 1 — камера сама подбирает качество под канал.
 *
 * Зачем. Канал в одной и той же точке гулял от 250 до 987 кбит/с. С
 * постоянным качеством на плохом канале видео встаёт (Q90 при включённом
 * RTS: 1,5 к/с, RTT 1,5 с), а на хорошем качество недобирает.
 *
 * Как. Раз в секунду по подтверждениям: средний RTT, списанные по таймауту,
 * сколько окно было закрыто при готовом кадре (канал не успевает за камерой).
 *   таймаут, RTT > AUTOQ_RTT_BAD или ни одной квитанции при кадрах в пути
 *                                          -> на две ступени вниз;
 *   RTT > AUTOQ_RTT_HI или окно закрыто > AUTOQ_BLOCK_HI мс из 1000
 *                                          -> на ступень вниз;
 *   три секунды подряд RTT < AUTOQ_RTT_LO и окно почти не закрыто
 *                                          -> на ступень вверх.
 * Ступени autoq_ladder. Вниз быстро, вверх медленно — чтобы не качало. С
 * паузами съёмки (GATED_CAPTURE) окно не считаем: кадров меньше из-за пауз,
 * а не из-за канала. В синтетике выключено.
 *
 * 2 (05.10, для ROLE_SWAP) — без штрафа за одиночный списанный кадр. Камера-точка
 * теряет ~10 % квитанций (приёмник-клиент шлёт их адресно, с повторами), и правило
 * «таймаут — две ступени вниз» роняло качество каждые несколько секунд: за 6 мин
 * 128 смен, скорость гуляла 300–750 кбит/с вслед за Q. Теперь списанные кадры —
 * ступень вниз, только если их два и больше за секунду; остальное как в 1.
 *
 * 3 (06.10, для ROLE_SWAP) — квитанции только мерка очереди модуля, их потеря не
 * штраф. Ночью 05.10 Q падал с 70 до 37–53 не от канала: видео доходило (кусков
 * пропадало 3–4 %), а квитанций 63–74 %. Разбор 379 шагов вниз: половина — RTT
 * 350–600 (среднее за секунду тянут вверх запоздалые квитанции), остальное —
 * окно, закрытое потерянными квитанциями, и «ни одной квитанции за секунду».
 * Правила 3:
 *   RTT — МЕДИАНА за секунду и без запоздалых квитанций (последний кусок пропал,
 *         приёмник ответил по первому куску следующего кадра — по chunk_mask);
 *   медиана > AUTOQ_RTT_BAD -> на две вниз, > AUTOQ_RTT_HI -> на одну;
 *   окно закрыто > AUTOQ_BLOCK_HI — на одну, только если и медиана > AUTOQ_RTT_LO
 *         (окно держит медленная очередь, а не потерянные квитанции);
 *   ни одной квитанции две секунды подряд — на одну (было: одна секунда — на две);
 *   списанные кадры не в счёт вовсе; вверх — три секунды медиана < AUTOQ_RTT_LO;
 *   кадр без квитанции окно списывает через FC_ACK_TIMEOUT3_MS, а не 1,5 с.
 *
 * 4 (06.10, для ROLE_SWAP) — как 3, но одиночный всплеск задержки не в счёт. Прогон
 * swap4: RTT от Q не зависит (медиана 141–208 мс при Q 30…90, всплески > 350 мс в
 * 10–18 % секунд при ЛЮБОМ Q) — канал не забит, всплески приходят не из радио, а
 * правило «медиана > 350 — вниз» дало 50 из 67 шагов вниз; Q в среднем ~50,
 * ~450 кбит/с против 783 ночью на том же месте. АК3 против АК2 — только +4 %.
 * Правила 4:
 *   медиана > AUTOQ_RTT_HI три секунды подряд — на одну вниз (очередь правда растёт);
 *   медиана > AUTOQ_RTT_BAD две секунды подряд — на две;
 *   ни одной квитанции две секунды подряд — на одну, как в 3;
 *   окно не в счёт (закрывают его потерянные квитанции); вверх — как в 3.
 */
#define AUTO_Q          (ROLE_SWAP ? 4 : 1)
/* 06.10 вечер (выбор пользователя): мягкие пороги — вниз только при задержке больше
 * 600 мс. Было 200/350/600: Q падал от всплесков задержки квитанций, а не от канала. */
#define AUTOQ_RTT_LO    300    /* мс */
#define AUTOQ_RTT_HI    600
#define AUTOQ_RTT_BAD   1000
#define AUTOQ_BLOCK_LO  150    /* мс из 1000 */
#define AUTOQ_BLOCK_HI  400
static volatile uint8_t autoq_on = AUTO_Q;   /* 0 — выкл, 1 / 2 / 3 — правила, см. AUTO_Q */
/* 06.10, правила 3: RTT квитанций за секунду — для медианы. Запоздалые сюда не
 * попадают, их считает aq_late. Наполняет lat_on_ack, опустошает autoq_tick. */
#define AQ_RTT_MAX 24
static uint16_t aq_rtt_buf[AQ_RTT_MAX];
static uint8_t  aq_rtt_n = 0;
static uint32_t aq_late = 0;
/* Шаги вниз по причинам (все правила): RTT>BAD, нет квитанций, RTT>HI, окно, списания,
 * мало кадров (07.10, AQ_FPS_MIN). */
static uint32_t aq_why[6] = { 0, 0, 0, 0, 0, 0 };
/*
 * НИЖНИЙ ПРЕДЕЛ КАДРОВ В СЕКУНДУ (07.10). Правила 3 и 4 смотрят только на задержку
 * квитанций. На чистом канале она мала, и Q уходил к 90–95: на 480×320 это кадр
 * 45–60 КБ и 1,7 к/с (чекпоинт 2 на 14 дБм, 06.10 22:59, Q90 57 % времени). Теперь
 * вверх — только если камера отдаёт не меньше AQ_FPS_UP к/с, а меньше AQ_FPS_MIN три
 * секунды подряд — ступень вниз. Не ниже AQ_FPS_Q_FLOOR: если кадров мало не из-за
 * размера (паузы передачи, сенсор), опускать дальше незачем — это дело правил задержки.
 */
#define AQ_FPS_MIN      4
#define AQ_FPS_UP       5
#define AQ_FPS_Q_FLOOR  50
static uint32_t aq_fr0 = 0, aq_last_fps10 = 0;
static uint32_t exp_tx0_kb = 0;                /* счётчик эфира модуля (tx0 data=), КБ */
static uint32_t exp_air_sum = 0, exp_per_sum = 0, exp_mcs_sum = 0, exp_mod_n = 0;

/*
 * ДИАГНОСТИКА: 1 — проверять, не меняется ли буфер кадра во время сжатия.
 *
 * Считаем CRC буфера до frame2jpg и сразу после. Кадр наш на всё это время:
 * мы держим его до esp_camera_fb_return. Если CRC разошлась — значит DMA
 * камеры продолжает писать в буфер, который драйвер уже отдал нам, и JPEG
 * кодируется с полудописанного кадра. Это и есть радужные полосы.
 *
 * ВНИМАНИЕ, чего эта проверка НЕ ловит: если драйвер отдал уже недописанный
 * кадр, а DMA ушёл писать в другой буфер, содержимое неподвижно и при этом
 * битое — CRC до и после совпадут. Для этого случая есть CHECK_ENCODER ниже.
 *
 * Стоит около 25 мс на кадр, в рабочем режиме держать 0.
 */
#define CHECK_FB 0

/*
 * ДИАГНОСТИКА: 1 — сжать один и тот же кадр дважды и сравнить результаты.
 *
 * Кодировщик детерминирован: из одинакового входа обязан выйти побайтно
 * одинаковый JPEG. Расхождение означает, что портит сам frame2jpg. Совпадение
 * при битой картинке означает обратное — кадр пришёл к нам уже рваным, и
 * виноват драйвер камеры.
 *
 * Стоит ещё одно сжатие на кадр, в рабочем режиме держать 0.
 */
#define CHECK_ENCODER 0

/*
 * ДИАГНОСТИКА: 1 — проверять, не менялся ли кадр во время копирования в SRAM.
 *
 * От гонки за PSRAM осталось одно окно: пока мы читаем 84 КБ, DMA камеры пишет
 * очередной кадр в соседний буфер. Окно короткое — единицы миллисекунд против
 * шестидесяти у кодировщика, — но если полосы вернутся, надо знать, оно ли.
 *
 * Считаем CRC исходного буфера ПОСЛЕ копирования и CRC копии. Разошлись —
 * значит в буфер писали, пока мы его читали, и окно ещё живо. Совпали — окно
 * ни при чём, искать надо дальше.
 *
 * Стоит два прохода по 84 КБ на кадр, в рабочем режиме держать 0.
 *
 * 15.09 ВКЛЮЧЕНО. К этому моменту провод оправдан полностью: просмотрщик
 * сверяет CRC собранного кадра (14.09), и за прогон 647 кадров frame_crc_err
 * остался нулём при ap_crc_err 0. Значит до экрана доезжает ПОБАЙТНО тот JPEG,
 * который здесь сжался, — радуга рождается на этой плате, до передачи.
 * На плате два подозреваемых: копия 84 КБ из PSRAM в SRAM (эта проверка) и сам
 * frame2jpg (CHECK_ENCODER). Начинаем с копии: она дешевле и её исход виден в
 * той же периодической печати, без отдельного инструмента.
 *
 * 15.09 ОТВЕТ ПОЛУЧЕН, ВЕРСИЯ ЗАКРЫТА. Прогон с радугой на экране:
 *     КОПИЯ В SRAM: проверено 71, оригинал менялся во время копирования 0
 * Ни одного расхождения при заведомо битой картинке. Окно в 2 мс чистое,
 * возвращаем 0 — два прохода по 84 КБ на кадр больше не нужны.
 *
 * Чего это НЕ доказывает: если драйвер отдал уже рваный, но неподвижный буфер,
 * обе суммы сойдутся. Именно этот случай и разбирает DUMP_RAW ниже.
 */
#define CHECK_COPY 0

/*
 * ДИАГНОСТИКА: 1 — выгружать сырые кадры RGB565 в USB для разбора на ПК.
 *
 * Всё, что мы видим в просмотрщике, прошло через сжатие, радио и сборку. Сырой
 * кадр — это ровно те байты, которые камера положила в память. Если они битые,
 * то РИСУНОК порчи называет механизм:
 *   мусор подряд с какой-то строки до конца  -> оборвался DMA
 *   битая каждая вторая / через равный шаг    -> сбой тактирования (PCLK)
 *   отдельные пиксели вразброс                -> помеха на шине, шлейф
 *   кусок в середине, дальше снова нормально  -> буфер перезаписали чужим кадром
 *
 * Выгрузка идёт ПОВЕРХ обычной работы: видео продолжает передаваться, кадр
 * дублируется в USB каждый DUMP_EVERY-й раз. Это важно — порча может возникать
 * только под нагрузкой, когда камера, кодировщик и UART делят PSRAM. Снимок в
 * тепличных условиях ничего не докажет.
 *
 * Разбирает tools/raw_grab.py. Кадр 84 КБ, по USB уходит быстро.
 *
 * 15.09 ВКЛЮЧЕНО. К этому моменту оправданы поимённо: провод (frame_crc_err 0
 * при живой радуге — до экрана доезжает побайтно то, что сжала камера),
 * копия в SRAM (CHECK_COPY: 0 расхождений на 71 кадре) и конвейер (выброшено
 * кадров 0). Остались двое: драйвер камеры, отдающий рваный буфер, и сам
 * frame2jpg. Пара «сырой RGB565 + сделанный из него JPEG» (DUMP_JPEG ниже уже
 * 1) разводит их окончательно: BMP рваный — виноват драйвер, BMP чистый при
 * рваном JPEG — виноват кодировщик.
 *
 * 15.09, тем же вечером — ВЫКЛЮЧЕНО, своё отработал. Он и назвал механизм:
 * радуга видна уже в сыром RGB565, а сдвиг хвоста на один байт делает кадр
 * чистым (кадр 06: грубость 14.34 -> 2.99).
 *
 * Держать его включённым нельзя. Выгрузка идёт синхронно в USB, 84 КБ на
 * каждый DUMP_EVERY-й кадр. Пока на другом конце сидит raw_grab.py и читает —
 * нормально; как только он отваливается (а на этом USB-тракте он отваливается
 * регулярно), запись упирается в непрочитанный буфер, задача захвата замирает
 * в ней до таймаута, и поток рвётся до долей кадра в секунду. Сегодня это
 * трижды выглядело как отказ связи и один раз как намертво вставшая плата.
 */
#define DUMP_RAW   0
#define DUMP_EVERY 16     // каждый N-й кадр; чаще — заметно роняет fps

/*
 * ДИАГНОСТИКА: 1 — выгружать вместе с сырым кадром сделанный из него JPEG.
 *
 * 15.08 проверены и оказались чистыми все звенья: камера (сырой кадр с
 * совпавшей CRC), радио (crc_err 0), USB приёмник->ПК (usb_crc_err 0). Про
 * кодировщик доказано только то, что он ДЕТЕРМИНИРОВАН — из одного входа
 * дважды выходит одно и то же. Что выходит ПРАВИЛЬНОЕ, не доказано ничем.
 *
 * Пара «сырой кадр + JPEG из него» это и решает: если BMP чистый, а JPEG из
 * того же самого кадра рваный, виноват frame2jpg.
 */
#define DUMP_JPEG  1

// -------------------------------------------------------------------

static uint8_t pkt[HALOW_P2P_PKT_BUF_LEN];
static halow_p2p_rx_t rx;

/*
 * ДИАГНОСТИКА ЗАГРУЗКИ. RTC_NOINIT_ATTR — память, которую не трогает ни
 * перезагрузка, ни загрузчик; очищается только снятием питания. Пишем сюда
 * номер пройденного шага, счётчик загрузок и причину прошлого сброса, а потом
 * вычитываем esptool-ом прямо из мёртвой платы. USB-консоль для этого не нужна
 * — что и требуется, раз плата умирает молча.
 */
RTC_NOINIT_ATTR volatile uint32_t dbg_magic;
RTC_NOINIT_ATTR volatile uint32_t dbg_stage;   // до какого шага дошли
RTC_NOINIT_ATTR volatile uint32_t dbg_boots;   // сколько раз стартовали
RTC_NOINIT_ATTR volatile uint32_t dbg_reason;  // esp_reset_reason() прошлого сброса
RTC_NOINIT_ATTR volatile uint32_t dbg_maxstage;// самый дальний шаг за все попытки

static bool camera_ok = false;
static char cam_info[64] = "не инициализирована";

#if ENCODE_FROM_SRAM
// Внутренний буфер под копию кадра: из него читает кодировщик, а PSRAM
// остаётся камере одной. Выделяется один раз в setup() и живёт до сброса.
static uint8_t *sram_frame = NULL;
static size_t   sram_frame_cap = 0;
static uint32_t enc_from_psram = 0;   // кадров, сжатых прямо из PSRAM (буфера не было)
#endif

#if ENC_WORKERS > 1
static SemaphoreHandle_t cap_mutex = NULL;   /* захват — по одному, см. ENC_WORKERS */
static portMUX_TYPE enc_stat_mux = portMUX_INITIALIZER_UNLOCKED;
#endif
static volatile uint32_t cap_seq = 0;        /* номер захваченного кадра */
static uint32_t last_sent_seq = 0;           /* номер последнего отправленного */
static uint32_t enc_reordered = 0;           /* выброшено: сжался позже нового */

static bool     link_up = false;
static uint32_t last_stat_ms = 0;      // когда последний раз пришёл 'S'
static halow_p2p_stat_t peer;          // последний отчёт приёмника

// Действующая пауза между чанками. Обычно равна CHUNK_GAP_MS, при GAP_SWEEP
// её меняет перебор.
static uint16_t chunk_gap_ms = CHUNK_GAP_MS;
static uint16_t chunk_gap_us = CHUNK_GAP_US;   /* может поменять VAR_SWEEP */
// Действующая пауза после кадра. Обычно равна FRAME_GAP_MS, при FRAME_GAP_SWEEP
// перебирается.
static uint16_t frame_gap_ms = FRAME_GAP_MS;

// Действующий размер полезной нагрузки в чанке.
static uint16_t chunk_payload = CHUNK_PAYLOAD;

#if PAYLOAD_SWEEP
// От большого к малому: 1400 — как вблизи, 260 — как требует вендор для
// низких MCS (MTU 300 минус наши заголовки).
static const uint16_t sweep_payloads[] = {1400, 700, 460, 260};
static uint8_t  psweep_idx = 0;
static uint32_t psweep_step_start = 0;
static bool     psweep_settled = false;
static uint32_t psweep_ok0 = 0, psweep_crc0 = 0;
static uint32_t psweep_frames0 = 0, psweep_bytes0 = 0;
static uint32_t psweep_t0 = 0;
#endif

#if GAP_SWEEP
// От большего к меньшему: начинаем с заведомо безопасного и идём вниз до
// первого брака.
/* 25.09: пересматриваем низ. Прежний порог 6 мс намерен 16-17.09 на кольце
 * модуля в 2 КБ и на приёме, который захлёбывался (89.5% байт приходили с
 * переполнением FIFO). Обе причины устранены: кольцо 8 КБ, выгребание FIFO.
 * Внутри модуля таймер тишины стоит на 2 мс, так что ниже 2 смысла нет —
 * 1 оставлен, чтобы увидеть, где именно упрёмся. */
static const uint16_t sweep_gaps[] = {8, 6, 5, 4, 3, 2, 1};
static uint8_t  sweep_idx = 0;
static uint32_t sweep_step_start = 0;
static bool     sweep_settled = false;
static uint32_t sweep_ok0 = 0, sweep_crc0 = 0;   // счётчики приёмника на начало замера
static uint32_t sweep_frames0 = 0, sweep_bytes0 = 0;
static uint32_t sweep_t0 = 0;
#endif

#if DUMP_RAW || CHECK_FB || CHECK_COPY
/*
 * Контрольная сумма буфера произвольной длины. halow_crc16 берёт длину 16 бит,
 * а кадр 84 КБ, поэтому идём кусками по 32 КБ и мешаем результаты (сдвиг —
 * чтобы куски не сокращали друг друга). Одна на все диагностики: выгрузку
 * сырых кадров, проверку буфера камеры и проверку копии в SRAM.
 */
static uint16_t big_crc(const uint8_t *p, size_t len)
{
    const size_t step = 32768;
    uint16_t acc = 0;
    size_t off = 0;

    while (off < len) {
        size_t n = len - off;
        if (n > step) {
            n = step;
        }
        acc = (uint16_t)(acc ^ halow_crc16(p + off, (uint16_t)n));
        acc = (uint16_t)((acc << 1) | (acc >> 15));
        off += n;
    }
    return acc;
}
#endif

#if DUMP_RAW
static uint32_t dump_counter = 0;

/*
 * Формат записи в USB:
 *   [0xA5][0x5A]['R'][w16][h16][len32][данные][crc16]
 * Маркер тот же, что у остальных наших потоков, чтобы разборщик на ПК мог
 * пересинхронизироваться после текстовых строк лога.
 */
static void dumpRawFrame(const camera_fb_t *fb)
{
    uint8_t hdr[11];
    uint16_t crc = big_crc(fb->buf, fb->len);

    hdr[0] = HALOW_P2P_SYNC0;
    hdr[1] = HALOW_P2P_SYNC1;
    hdr[2] = 'R';
    hdr[3] = (uint8_t)(fb->width & 0xff);
    hdr[4] = (uint8_t)(fb->width >> 8);
    hdr[5] = (uint8_t)(fb->height & 0xff);
    hdr[6] = (uint8_t)(fb->height >> 8);
    hdr[7] = (uint8_t)(fb->len & 0xff);
    hdr[8] = (uint8_t)((fb->len >> 8) & 0xff);
    hdr[9] = (uint8_t)((fb->len >> 16) & 0xff);
    hdr[10] = (uint8_t)((fb->len >> 24) & 0xff);

    SerialMon.write(hdr, sizeof(hdr));
    SerialMon.write(fb->buf, fb->len);
    uint8_t tail[2] = {(uint8_t)(crc & 0xff), (uint8_t)(crc >> 8)};
    SerialMon.write(tail, sizeof(tail));
}

#if DUMP_JPEG
/*
 * Тот же формат, но тип 'J' и в полях ширины/высоты нули: размер берётся из
 * самого JPEG. Идёт сразу за сырым кадром, то есть это ровно тот JPEG, который
 * сделан из только что выгруженных байт.
 */
static void dumpJpegFrame(const uint8_t *jpg, size_t len)
{
    uint8_t hdr[11];
    uint16_t crc = big_crc(jpg, len);

    hdr[0] = HALOW_P2P_SYNC0;
    hdr[1] = HALOW_P2P_SYNC1;
    hdr[2] = 'J';
    hdr[3] = 0; hdr[4] = 0;
    hdr[5] = 0; hdr[6] = 0;
    hdr[7] = (uint8_t)(len & 0xff);
    hdr[8] = (uint8_t)((len >> 8) & 0xff);
    hdr[9] = (uint8_t)((len >> 16) & 0xff);
    hdr[10] = (uint8_t)((len >> 24) & 0xff);

    SerialMon.write(hdr, sizeof(hdr));
    SerialMon.write(jpg, len);
    uint8_t tail[2] = {(uint8_t)(crc & 0xff), (uint8_t)(crc >> 8)};
    SerialMon.write(tail, sizeof(tail));
}
#endif
#endif

static uint32_t frame_id = 0;
static uint32_t frames_sent = 0;
static uint32_t bytes_sent = 0;
// Те же счётчики, но без сброса каждые STATS_PERIOD_MS — нужны перебору пауз.
static uint32_t frames_total = 0;
static uint32_t bytes_total = 0;
static uint32_t stats_tick = 0;
static bool     streaming = false;     // окно закончилось, порт переключён на P2P_BAUD
/*
 * Разрешение передавать. Отделено от streaming нарочно: streaming — про UART
 * (окно закрылось, скорость поднята, разборщик сброшен), tx_enabled — про
 * эфир (приёмник отозвался, значит ассоциация есть). Между ними может пройти
 * сколько угодно времени, и всё это время камера обязана молчать.
 */
static bool     tx_enabled = false;
static uint32_t hello_wait_tick = 0;   // когда последний раз печатали «жду»
static uint32_t hello_since_ms = 0;    // с какого момента ждём первый 'S'

/*
 * ЗАМЕР ЗАДЕРЖКИ ПО ПОДТВЕРЖДЕНИЯМ (28.09, шаг 1 из плана в журнале).
 *
 * Приёмник подтверждает каждый кадр в момент прихода последнего чанка
 * (halow_p2p_ack_t). Здесь это только измерение — как шлём, не меняется:
 *   RTT     — от конца записи кадра в UART до подтверждения. Включает очередь
 *             в модуле, эфир, разбор на приёмнике и обратный путь короткого
 *             пакета. Это верхняя оценка задержки доставки последнего чанка.
 *   возраст — от начала съёмки кадра (fb->timestamp, «первый DMA-буфер
 *             кадра») до подтверждения. Задержка «сенсор -> приёмник» без USB
 *             до ПК и без показа.
 * Кольцо на LAT_RING кадров: подтверждение ищет свой кадр по номеру; не нашёл
 * (кадр старше кольца) — считается в lat_unmatched.
 */
#define LAT_RING      64
#define LAT_HIST_MS   100          /* шаг гистограммы возраста */
#define LAT_HIST_BINS 31           /* 0..3 с по 100 мс, последний — всё дольше */
typedef struct {
    uint32_t id;
    uint32_t cap_ms;
    uint32_t sent_ms;
} lat_slot_t;
static lat_slot_t lat_ring[LAT_RING];
static uint32_t   lat_next_cap_ms = 0;   /* съёмка кадра, который сейчас уйдёт */
static uint32_t   lat_acks = 0, lat_incomplete = 0, lat_unmatched = 0;
static uint64_t   lat_rtt_sum = 0, lat_age_sum = 0;
static uint32_t   lat_rtt_max = 0, lat_age_max = 0;       /* за период статистики */
static uint32_t   lat_rtt_min = 0xFFFFFFFFu;               /* за период статистики */
static uint32_t   lat_hist[LAT_HIST_BINS];
static uint32_t   lat_hist_print = 0;
/* 05.10: куски по квитанциям. Квитанция несёт chunks_got/chunk_cnt, новый
 * приёмник — ещё и список пришедших (chunk_mask), по нему видно, какой именно
 * пропал: первый, средний или последний. Кадры без квитанции вовсе сюда не
 * входят — они в списанных. */
static uint32_t   ck_sent = 0, ck_got = 0;        /* кусков в кадрах с квитанцией / дошло */
static uint32_t   ck_lost_pos[3] = { 0, 0, 0 };   /* пропало: первый, средние, последний */
static uint32_t   ck_mask_acks = 0;               /* квитанций со списком кусков */

/*
 * ОКНО КАДРОВ В ПОЛЁТЕ (28.09, шаг 2 из плана в журнале).
 *
 * Зачем. Подача по UART не знает скорости эфира: при ~20 к/с по 3,3 КБ это
 * ~520 кбит/с, а эфир отдаёт ~490 — очередь модуля то копится до 2–3 с, то
 * сходит. Окно ограничивает число отправленных, но ещё не подтверждённых
 * кадров: следующий уходит, только когда приёмник подтвердил предыдущий.
 * Подача сама подстраивается под эфир («тактирование подтверждениями», как в
 * TCP), и в модуле никогда не лежит больше FC_WINDOW кадров — это и есть
 * потолок задержки.
 *
 * Потерянный кадр подтверждения не получит никогда (пропал последний чанк),
 * поэтому самый старый неподтверждённый списывается через FC_ACK_TIMEOUT_MS.
 * Подтверждение накопительное: пришло на кадр N — всё до N тоже закрыто.
 *
 * Пока окно закрыто, конвейер не должен копить старьё: лишние кадры в
 * очереди выбрасываются, в эфир уходит самый свежий (счётчик fc_skipped).
 *
 * 0 — окна нет, шлём, как раньше, всё, что успела снять камера.
 */
/*
 * 29.09, 320x240: кадр ~7,8 КБ (6 чанков), RTT вырос до 0,9 с в среднем и 3 с
 * в худшем. При таймауте 600 мс камера списала 802 кадра, которые ещё лежали
 * в очереди модуля, и слала новые: окно перестало сдерживать поток, очередь
 * модуля переполнялась, у приёмника пропало 23 % чанков (35 % кадров). Окно
 * держим в кадрах вдвое меньше (кадры вдвое крупнее), ждём дольше RTT.
 */
/* 05.10: в ROLE_SWAP — 4. Повторов в эфире нет, очередь модуля не раздувается, а
 * квитанции от приёмника-клиента теряются (~10 %) и опаздывают: при W=2 окно стояло
 * закрытым 57–75 % времени на синтетике. Потерянную квитанцию закрывает следующая. */
#define FC_WINDOW          (ROLE_SWAP ? 4 : 2)   /* 29.09: было 4; кадры 320x240 вдвое крупнее */
#define FC_ACK_TIMEOUT_MS  1500   /* 29.09: было 600, меньше RTT на 320x240 */
/* 06.10: с правилами автокачества 3 (ROLE_SWAP). Видео идёт всем без повторов:
 * кадр либо дошёл за обычный RTT (медиана ~150 мс, 99 % до ~650), либо не дойдёт
 * никогда — ждать 1,5 с значит держать окно закрытым из-за потерянной квитанции. */
#define FC_ACK_TIMEOUT3_MS 800

/*
 * СЪЁМКА В ПАУЗАХ ПЕРЕДАЧИ (29.09): 1 — в эфир уходят только кадры, снятые
 * целиком, пока модуль камеры молчал.
 *
 * Зачем. Слип и радуга — наводка собственного передатчика на шлейф камеры
 * (26.09; «шторка» 28.09: сдвиг только пока модуль излучает). На 320x240 при
 * 10 дБм битых 40–60 % кадров, при 12 дБм почти все, а потолок мощности режет
 * дальность.
 *
 * Как. Цикл из двух фаз:
 *   передача — шлём до GATE_FRAMES готовых кадров (в пределах FC_WINDOW) и
 *              ждём подтверждения на все: тогда очередь модуля пуста;
 *   тишина   — в модуль не пишем ничего, ни видео, ни лог по воздуху; ждём,
 *              пока камера снимет GATE_FRAMES кадров, целиком уложившихся в
 *              тишину, и пока в очереди есть сжатый кадр прошлой тишины.
 * Кадр чистый, если [начало, начало + длительность кадра] лежит внутри одной
 * тишины: начало — fb->timestamp, длительность — наименьший шаг между кадрами
 * сенсора. Грязные кадры возвращаются драйверу сразу, не сжимаясь. Кадры этой
 * тишины сжимаются во время следующей передачи.
 * Остаток риска: и в тишине модуль камеры коротко отвечает MAC-ACK на пакеты
 * приёмника (подтверждения кадров, отчёт раз в секунду).
 */
#define GATED_CAPTURE     1
#define GATE_FRAMES       2      /* чистых кадров за тишину = кадров за передачу */
#define GATE_MARGIN_MS    5      /* тишина считается через столько после подтверждения */
#define GATE_QUIET_MAX_MS 500    /* дольше не молчим: нет чистых — шлём, что готово */
/*
 * Паузы только при большой мощности (29.09, прогон gated2 на 5 м): паузы
 * убрали радугу (0 из 561), но вдвое срезали скорость — 3,5 к/с и 225 кбит/с
 * против 6,4 к/с и 450 кбит/с без них. А регулятор PWRCTL держал модуль на
 * 2–5 дБм, где радуги и без пауз ~6 %. Наводка растёт с мощностью, поэтому
 * паузы включаются, только когда модуль сам поднял мощность. Мощность берём
 * из его строки «PWRCTL snr=... pwr=N», она приходит раз в несколько секунд.
 */
#define GATE_PWR_ON       8      /* дБм: от стольких паузы включаются */
#define GATE_PWR_OFF      5      /* дБм: до стольких выключаются (гистерезис) */
/*
 * 06.10 ночь: -1 — паузы по мощности (как выше), 0 — выключены всегда, 1 — включены
 * всегда. Опыт меняет на ходу (exp_step_t.gate). Зачем: чекпоинт 2 на 14 дБм шёл
 * 1,7–1,9 к/с — паузы включились сами (мощность ≥ 8) и выбросили 1899 кадров из
 * 2446, а радуги при токе сенсора ×1 было всего 1,2 %. Нужны ли паузы с ×1 —
 * вопрос опыта gate14.
 */
#define GATE_FORCE        (-1)
/*
 * Сколько ждать квитанцию на кадр перед тишиной. В gated2 квитанций не дошло
 * 23 на 551 кадр (приёмник потерял только 5), и каждая стоила 1,5 с простоя
 * (FC_ACK_TIMEOUT_MS) — ~35 с из 4 минут. Задержка квитанции там не больше
 * 226 мс, так что 500 мс с запасом.
 */
#define GATE_ACK_TIMEOUT_MS 500

#if GATED_CAPTURE
#define GATE_RING 8
static portMUX_TYPE gate_mux = portMUX_INITIALIZER_UNLOCKED;
static uint32_t gate_q_start[GATE_RING];
static uint32_t gate_q_end[GATE_RING];         /* 0 — тишина ещё идёт */
static uint32_t gate_q_n = 0;                  /* сколько тишин было */
static volatile bool     gate_quiet = false;
static uint32_t          gate_quiet_t0 = 0;
static volatile uint32_t gate_clean_cur = 0;   /* чистых кадров в текущей тишине */
static volatile uint32_t gate_frame_ms = 100;  /* длительность кадра сенсора, оценка */
static uint32_t gate_sent_busy = 0;            /* кадров ушло в текущей передаче */
static uint32_t gate_cycles = 0, gate_forced = 0, gate_quiet_ms_sum = 0;
static volatile int8_t mod_pwr_dbm = PWRCTL_MAX;   /* мощность модуля, из строки PWRCTL */
static volatile uint32_t mod_pwr_seen = 0;         /* сколько таких строк разобрано */
static volatile bool gate_on = true;               /* паузы сейчас включены */
static int8_t gate_force = GATE_FORCE;             /* см. GATE_FORCE */
static uint32_t gate_switches = 0;                 /* переключений вкл/выкл */
static uint32_t gate_on_ms = 0, gate_off_ms = 0;   /* время в каждом режиме */
static uint32_t gate_mode_t = 0;
static volatile uint32_t gate_clean = 0, gate_dirty = 0;

static void gate_begin_quiet(uint32_t now)
{
    portENTER_CRITICAL(&gate_mux);
    uint32_t i = gate_q_n % GATE_RING;
    gate_q_end[i] = 0;
    gate_q_start[i] = now + GATE_MARGIN_MS;
    gate_q_n++;
    gate_clean_cur = 0;
    gate_quiet = true;
    portEXIT_CRITICAL(&gate_mux);
    gate_quiet_t0 = now;
}

static void gate_end_quiet(uint32_t now)
{
    portENTER_CRITICAL(&gate_mux);
    if (gate_q_n) {
        gate_q_end[(gate_q_n - 1) % GATE_RING] = now;
    }
    gate_quiet = false;
    portEXIT_CRITICAL(&gate_mux);
    gate_quiet_ms_sum += now - gate_quiet_t0;
    gate_cycles++;
}

/* Из главного цикла: включить или выключить паузы по мощности модуля. */
static void gate_mode_update(uint32_t now)
{
    if (gate_mode_t) {
        if (gate_on) {
            gate_on_ms += now - gate_mode_t;
        } else {
            gate_off_ms += now - gate_mode_t;
        }
    }
    gate_mode_t = now;
    int p = synth_on ? 0 : mod_pwr_dbm;       /* в синтетике картинка не важна */
    bool want_off = gate_force >= 0 ? gate_force == 0 : p <= GATE_PWR_OFF;
    bool want_on  = gate_force >= 0 ? gate_force == 1 : p >= GATE_PWR_ON;
    if (gate_on && want_off) {
        if (gate_quiet) {
            gate_end_quiet(now);
        }
        gate_on = false;
        gate_switches++;
    } else if (!gate_on && want_on) {
        gate_on = true;
        gate_sent_busy = GATE_FRAMES;   /* сперва дождаться подтверждений и замолчать */
        gate_switches++;
    }
}

/* Из захвата (под cap_mutex): кадр целиком в одной тишине? Заодно оценка
 * длительности кадра — наименьший шаг между началами за 32 кадра. */
static bool gate_frame_clean(uint32_t start)
{
    static uint32_t prev = 0, min_d = 1000, cnt = 0;
    uint32_t d = start - prev;
    prev = start;
    if (d >= 15 && d < min_d) {
        min_d = d;
    }
    if (++cnt >= 32) {
        gate_frame_ms = min_d;
        min_d = 1000;
        cnt = 0;
    }

    if (!gate_on) {
        return true;
    }
    bool clean = false;
    uint32_t dur = gate_frame_ms;
    portENTER_CRITICAL(&gate_mux);
    uint32_t n = gate_q_n;
    for (uint32_t k = 0; k < GATE_RING && k < n; k++) {
        uint32_t i = (n - 1 - k) % GATE_RING;
        uint32_t s = gate_q_start[i], e = gate_q_end[i];
        if ((int32_t)(start - s) < 0) {
            continue;                          /* кадр начался раньше этой тишины */
        }
        if (e == 0) {                          /* тишина идёт, кадр уже дописан */
            clean = true;
            gate_clean_cur++;
        } else if ((int32_t)(e - (start + dur)) >= 0) {
            clean = true;                      /* уложился до конца тишины */
        }
        break;
    }
    portEXIT_CRITICAL(&gate_mux);
    if (clean) {
        gate_clean++;
    } else {
        gate_dirty++;
    }
    return clean;
}
#endif

static uint32_t fc_last_ack_id = 0;   /* старший подтверждённый (или списанный) кадр */
static uint32_t fc_timeouts = 0;      /* списано кадров без подтверждения */
static uint32_t fc_skipped = 0;       /* выброшено устаревших кадров из очереди */
static uint32_t fc_blocked_ms = 0;    /* сколько окно было закрыто при готовом кадре */
static uint8_t  fc_window = FC_WINDOW; /* окно сейчас; меняет опыт (EXP_PROGRAM) */

#if FC_WINDOW
static bool fc_can_send(void)
{
    if (frame_id - fc_last_ack_id < fc_window) {
        return true;
    }
    /* Окно полно. Самый старый неподтверждённый — следующий за подтверждённым. */
    uint32_t oldest = fc_last_ack_id + 1;
    lat_slot_t *s = &lat_ring[oldest % LAT_RING];
    /* 06.10: в ROLE_SWAP — всегда короткий (видео всем, повторов нет), чтобы этапы с
     * закреплённым Q и с автокачеством различались только автокачеством. */
    uint32_t tmo = (ROLE_SWAP || autoq_on >= 3) ? FC_ACK_TIMEOUT3_MS : FC_ACK_TIMEOUT_MS;
    if (s->id != oldest || !s->sent_ms || millis() - s->sent_ms > tmo) {
        /* Затёрт в кольце, уже подтверждён или ждёт слишком долго — списываем. */
        fc_last_ack_id = oldest;
        fc_timeouts++;
        return frame_id - fc_last_ack_id < fc_window;
    }
    return false;
}
#endif

static void lat_on_ack(const halow_p2p_ack_t *a, bool has_mask)
{
    uint32_t now = millis();
    /* Для окна — накопительно и до любых проверок: подтверждение на кадр N
     * закрывает и все до него. Номер из будущего не берём. */
    if ((int32_t)(a->frame_id - fc_last_ack_id) > 0 &&
        (int32_t)(frame_id - a->frame_id) >= 0) {
        fc_last_ack_id = a->frame_id;
    }
    lat_slot_t *s = &lat_ring[a->frame_id % LAT_RING];
    if (s->id != a->frame_id || !s->sent_ms) {
        lat_unmatched++;
        return;
    }
    uint32_t rtt = now - s->sent_ms;
    uint32_t age = now - s->cap_ms;
    s->sent_ms = 0;                      /* повторное подтверждение не считаем */
    lat_acks++;
    if (a->chunks_got < a->chunk_cnt) {
        lat_incomplete++;
    }
    ck_sent += a->chunk_cnt;
    ck_got += a->chunks_got < a->chunk_cnt ? a->chunks_got : a->chunk_cnt;
    if (has_mask) {
        ck_mask_acks++;
        for (uint16_t i = 0; i < a->chunk_cnt && i < 32; i++) {
            if (!(a->chunk_mask & (1u << i))) {
                ck_lost_pos[i == 0 ? 0 : (i + 1 == a->chunk_cnt ? 2 : 1)]++;
            }
        }
    }
    lat_rtt_sum += rtt;
    lat_age_sum += age;
    {
        /* 06.10, правила автокачества 3: запоздалая квитанция — последнего куска нет,
         * приёмник ответил по первому куску следующего кадра, RTT больше на кадр. */
        bool late = has_mask && a->chunk_cnt && a->chunk_cnt <= 32 &&
                    !(a->chunk_mask & (1u << (a->chunk_cnt - 1)));
        if (late) {
            aq_late++;
        } else if (aq_rtt_n < AQ_RTT_MAX) {
            aq_rtt_buf[aq_rtt_n++] = (uint16_t)(rtt > 65535 ? 65535 : rtt);
        }
    }
    if (rtt > lat_rtt_max) lat_rtt_max = rtt;
    if (rtt < lat_rtt_min) lat_rtt_min = rtt;
    if (age > lat_age_max) lat_age_max = age;
    uint32_t bin = age / LAT_HIST_MS;
    if (bin >= LAT_HIST_BINS) bin = LAT_HIST_BINS - 1;
    lat_hist[bin]++;
}

/* Время съёмки кадра в шкале millis(): и то и другое идёт от esp_timer. */
static uint32_t fb_start_ms(const camera_fb_t *fb)
{
    return (uint32_t)((uint64_t)fb->timestamp.tv_sec * 1000ULL +
                      (uint64_t)fb->timestamp.tv_usec / 1000ULL);
}

static uint32_t cam_ms_acc   = 0;
static uint32_t copy_ms_acc  = 0;
static uint32_t jpeg_ms_acc  = 0;
static uint32_t send_ms_acc  = 0;
static uint32_t stage_frames = 0;   // кадров ОТПРАВЛЕНО за период
static uint32_t cap_frames   = 0;   // кадров СНЯТО за период (их больше)
static uint32_t cap_all = 0, cam_ms_all = 0;   /* то же нарастающим итогом — для этапов опыта */

#if TEST_PATTERN
static uint8_t *tp_jpg = NULL;   // один и тот же кадр на все отправки
static size_t   tp_len = 0;
#endif

#if CHECK_FB
static uint32_t fb_checked = 0;  // сколько кадров проверено на «шевеление» буфера
static uint32_t fb_torn = 0;     // у скольких буфер изменился во время сжатия
// Сумма считается big_crc выше — по ВСЕМУ буферу, а не по первым 64 КБ:
// полосы вылезают как раз в нижней части кадра.
#endif

#if CHECK_COPY
static uint32_t copy_checked = 0; // сколько копий проверено
static uint32_t copy_torn = 0;    // у скольких оригинал менялся во время копирования
#endif

#if CHECK_ENCODER
static uint32_t enc_checked = 0; // сколько кадров сжато дважды
static uint32_t enc_diff = 0;    // у скольких два сжатия разошлись
#endif

//************************************[ ПОТОК ]******************************************

// Вычёрпывает UART и разбирает то, что прислал приёмник. Зовётся и между
// чанками тоже — иначе за время кадра приёмный буфер успеет переполниться.
#if LMAC_STATS
/*
 * Сбор текстовых строк, которые модуль печатает вперемешку с отчётами
 * приёмника. Кадрирование их всё равно отбрасывает, но нам они нужны.
 *
 * Отличаем текст от двоичного мусора по содержимому: печатаем только строки с
 * узнаваемыми метками статистики. Иначе в консоль полезли бы обрывки кадров.
 */
static char  lmac_line[256];   /* 06.10: было 160 — длинные строки модуля пропадали целиком */
static uint8_t lmac_len = 0;
#if LMAC_DBG_EVERY
static uint32_t lmac_tp_seen = 0;       /* строк смены лучшей (tp1=/tp2=) всего */
#endif

static void lmacTextByte(uint8_t c)
{
    if (c == '\n' || c == '\r') {
        lmac_line[lmac_len] = 0;
#if LMAC_DBG_EVERY
        /* Отчёт модуля целиком, см. LMAC_DBG_EVERY. */
        static uint8_t  dbg_blk = 0, dbg_left = 0;
        static uint32_t dbg_tp_ms = 0;
        bool dbg_pass = false;
        if (strstr(lmac_line, "LMAC STATUS")) {
            dbg_left = (++dbg_blk % LMAC_DBG_EVERY == 0) ? LMAC_DBG_LINES : 0;
        }
        if (dbg_left && lmac_len >= 4) {
            dbg_left--;
            dbg_pass = true;
        }
        if (strstr(lmac_line, "tp1=") || strstr(lmac_line, "tp2=")) {
            lmac_tp_seen++;
            uint32_t now = millis();
            if (now - dbg_tp_ms >= 250) {        /* не чаще 4 в секунду */
                dbg_tp_ms = now;
                dbg_pass = true;
            }
        }
#else
        const bool dbg_pass = false;
#endif
#if EXP_PROGRAM
        /* «tx0: mcs=*6 snr=34 data=478KB(248kbps) per=61» — эфир и повторы. */
        if (const char *t0 = strstr(lmac_line, "tx0:")) {
            const char *m = strstr(t0, "mcs=");
            const char *d = strstr(t0, "data=");
            const char *r = d ? strchr(d, '(') : NULL;
            const char *pp = strstr(t0, " per=");
            if (m && d && r && pp) {
                m += 4;
                if (*m == '*') {
                    m++;
                }
                exp_mcs_sum += (uint32_t)atoi(m);
                exp_tx0_kb = (uint32_t)atoi(d + 5);
                exp_air_sum += (uint32_t)atoi(r + 1);
                exp_per_sum += (uint32_t)atoi(pp + 5);
                exp_mod_n++;
            }
        }
#endif
#if GATED_CAPTURE
        /* «PWRCTL snr=... pwr=N ...» — текущая мощность модуля, см.
         * GATE_PWR_ON. Ответ на AT+PWRCTL («+PWRCTL:mode=...») не годится:
         * в нём pwr=0 до первой подстройки. */
        if (strstr(lmac_line, "PWRCTL snr=")) {
            const char *pp = strstr(lmac_line, " pwr=");
            if (pp) {
                mod_pwr_dbm = (int8_t)atoi(pp + 5);
                mod_pwr_seen++;
            }
        }
#endif
        /*
         * СТРОГИЙ ОТБОР ПО МЕТКАМ — не косметика, а вопрос скорости.
         *
         * 17.09 фильтр был ослаблен до «любая строка от 10 символов», чтобы
         * выяснить, говорит ли модуль хоть что-нибудь после старта прозрачного
         * режима. В таком виде он попал в прогоны 18-19.09 и ОБРЕЗАЛ ИХ ВДВОЕ:
         * 4.7 кадра в секунду вместо расчётных десяти, 107 кбит/с вместо 220.
         *
         * Механика: печать идёт из pumpRx, то есть из тракта передачи, а
         * запись в USB-CDC блокирует до 100 мс (см. halow_mon_settle и
         * setTxTimeoutMs). Модуль раз в период вываливает два десятка строк, а
         * ослабленный фильтр пропускал ещё и случайные печатные
         * последовательности из двоичного потока отчётов приёмника.
         *
         * Метки оставлены те, что реально нужны: per=, snr=, STA. Остальное
         * модуль печатает для отладки радио, и нам оно не нужно.
         */
        if (dbg_pass ||
            (lmac_len >= 6 &&
             (strstr(lmac_line, "per=") || strstr(lmac_line, "snr=") ||
              strstr(lmac_line, "STA")))) {
            SerialMon.printf("  МОДУЛЬ: %s\n", lmac_line);
        }
        lmac_len = 0;
        return;
    }
#if LMAC_DBG_EVERY
    if (c == '\t') {                 /* таблица может быть с табуляцией */
        c = ' ';
    }
#endif
    if (c < 0x20 || c > 0x7e) {      /* двоичный байт — строка не текстовая */
        lmac_len = 0;
        return;
    }
    if (lmac_len < sizeof(lmac_line) - 1) {
        lmac_line[lmac_len++] = (char)c;
    } else {
        lmac_len = 0;
    }
}
#endif

static void pumpRx(void)
{
    while (SerialAT.available()) {
        int c = SerialAT.read();
        if (c < 0) {
            break;
        }
#if LMAC_STATS
        lmacTextByte((uint8_t)c);
#endif
        if (!halow_p2p_rx_byte(&rx, (uint8_t)c)) {
            continue;
        }
        if (rx.type == HALOW_P2P_TYPE_STAT && rx.len >= sizeof(halow_p2p_stat_t)) {
            halow_p2p_stat_t s;
            memcpy(&s, rx.body, sizeof(s));
            if (s.magic[0] == 'H' && s.magic[1] == 'L' &&
                s.magic[2] == 'W' && s.magic[3] == 'S') {
                peer = s;
                last_stat_ms = millis();
                link_up = true;
            }
        } else if (rx.type == HALOW_P2P_TYPE_ACK && rx.len >= HALOW_P2P_ACK_LEN_V1) {
            /* 05.10: оба размера — старый приёмник шлёт без списка кусков. */
            halow_p2p_ack_t a;
            bool has_mask = rx.len >= sizeof(a);
            memset(&a, 0, sizeof(a));
            memcpy(&a, rx.body, has_mask ? sizeof(a) : HALOW_P2P_ACK_LEN_V1);
            if (a.magic[0] == 'H' && a.magic[1] == 'L' &&
                a.magic[2] == 'W' && a.magic[3] == 'A') {
                lat_on_ack(&a, has_mask);
            }
        }
    }
}

/* Разделитель после любого пакета в модуль: без него соседние пакеты
 * склеиваются в один эфирный кадр. См. CHUNK_GAP_US. */
static void p2pGap(void)
{
#if CHUNK_GAP_US
    SerialAT.flush();                  /* ждёт только передачу, приём не трогает */
    delayMicroseconds(chunk_gap_us);
#else
    if (chunk_gap_ms) {
        delay(chunk_gap_ms);
    }
#endif
}

static bool sendChunk(const uint8_t *payload, uint16_t len,
                      uint16_t idx, uint16_t cnt, uint32_t total_len,
                      uint16_t frame_crc)
{
    uint8_t body[HALOW_P2P_MAX_BODY];
    halow_app_hdr_t hdr;

    hdr.magic[0] = 'H';
    hdr.magic[1] = 'L';
    hdr.magic[2] = 'W';
    hdr.magic[3] = '2';
    hdr.frame_id = frame_id;
    hdr.frame_len = total_len;
    hdr.chunk_idx = idx;
    hdr.chunk_cnt = cnt;
    hdr.payload_len = len;
    hdr.frame_crc = frame_crc;   // одна на все чанки кадра
    /*
     * Поле rssi на прозрачной прошивке всегда было бы нулём: AT+RSSI недоступен,
     * спросить не у кого. Поэтому на время подбора паузы кладём в него саму
     * паузу в миллисекундах — так она доезжает до ПК тем же путём, что и видео,
     * и попадает в CSV логгера в столбец sta_rssi РЯДОМ со счётчиками брака
     * приёмника. Обратный канал для этого не годится: он глохнет, пока
     * передатчик занимает эфир, и отчёты теряются.
     */
#if PAYLOAD_SWEEP
    hdr.rssi = (int8_t)(chunk_payload / 20);   // 70 -> 1400 байт, 13 -> 260
#elif GAP_SWEEP
    hdr.rssi = (int8_t)chunk_gap_ms;
#elif FRAME_GAP_SWEEP
    /* +100, чтобы в логе нельзя было спутать с паузой чанка: 110 -> 10 мс. */
    hdr.rssi = (int8_t)(100 + frame_gap_ms);
#else
    hdr.rssi = 0;               // на прозрачной прошивке AT+RSSI недоступен
#endif
    hdr.flags = (idx + 1 == cnt) ? HALOW_FLAG_LAST : 0;

    memcpy(body, &hdr, HALOW_APP_HDR_LEN);
    memcpy(body + HALOW_APP_HDR_LEN, payload, len);

    int pkt_len = halow_p2p_build(pkt, HALOW_P2P_TYPE_VIDEO,
                                  body, (uint16_t)(HALOW_APP_HDR_LEN + len));
    if (pkt_len < 0) {
        return false;
    }

    // Записи никто не подтверждает: модуль просто отдаёт байты в эфир. Ответа
    // ждать не от кого и незачем — потери ловит CRC на приёмнике.
    SerialAT.write(pkt, pkt_len);
    bytes_sent += pkt_len;
    bytes_total += pkt_len;

    p2pGap();
    /*
     * 25.09: pumpRx() отсюда УБРАН, теперь он зовётся один раз на кадр в
     * sendFrame().
     *
     * Он стоял после КАЖДОГО чанка, то есть трижды на кадр, и каждый раз
     * побайтно разгребал весь накопившийся входящий текст: отчёты приёмника,
     * статистику LMAC, строки UARTSTAT. На 3 Мбод этого текста стало много, и
     * замер показал разрыв: стадия UART занимала 54-63 мс при расчётных 32.5
     * (провод 13.5 + три паузы по 3 + пауза кадра 10). Недостающие ~25 мс —
     * это и есть разбор обратного канала внутри тракта передачи.
     *
     * Тот же класс ошибки мы уже чинили дважды: печать в USB внутри pumpRx
     * (23.09, стоила половины скорости) и запись в USB внутри pumpStream на
     * приёмнике (24.09).
     *
     * Раз в кадр — это раз в ~50 мс, а приёмник шлёт отчёт раз в секунду, так
     * что обратный канал ничего не теряет. Приёмный буфер здесь 2 КБ
     * (setRxBufferSize ниже), за 50 мс на 3 Мбод в него натекает максимум
     * ~150 байт реального трафика — запас двенадцатикратный.
     */
    return true;
}

static void sendFrame(const uint8_t *buf, uint32_t total_len)
{
    uint16_t cnt = (uint16_t)((total_len + chunk_payload - 1) / chunk_payload);
    /*
     * Контрольная сумма ВСЕГО кадра, одна на все его чанки. Каждый чанк уже
     * прикрыт своей CRC на радиоучастке и на USB, но собранный кадр до сих
     * пор никто не проверял целиком. Просмотрщик сверит эту сумму после
     * склейки — и станет видно, показывает ли он ровно то, что уехало с
     * камеры. JPEG у нас единицы килобайт, в 16-битную длину влезает с
     * запасом (лимит 64 КБ).
     */
    uint16_t frame_crc = halow_crc16(buf, (uint16_t)total_len);

    frame_id++;
    for (uint16_t i = 0; i < cnt; i++) {
        uint32_t off = (uint32_t)i * chunk_payload;
        uint16_t len = (uint16_t)min((uint32_t)chunk_payload, total_len - off);

        if (!sendChunk(buf + off, len, i, cnt, total_len, frame_crc)) {
            return;
        }
    }
    /* Отметка для замера задержки — ДО pumpRx: подтверждение могут разобрать
     * прямо в нём. */
    {
        lat_slot_t *s = &lat_ring[frame_id % LAT_RING];
        s->id = frame_id;
        s->cap_ms = lat_next_cap_ms;
        s->sent_ms = millis();
        if (!s->sent_ms) s->sent_ms = 1;   /* ноль занят под «уже подтверждён» */
    }
    pumpRx();                  /* один раз на кадр, см. комментарий в sendChunk */
    frames_sent++;
    frames_total++;
    dbg_stage = 10;                    /* хотя бы один кадр ушёл целиком */
}

#if AIR_LOG
/* Отправка лога по воздуху, см. AIR_LOG. Зовётся из loop между кадрами —
 * в UART модуля пишет только этот поток, чанки видео и 'T' не перемешаются. */
static uint16_t airlog_seq = 0;
static uint32_t airlog_last_ms = 0;
static uint32_t airlog_pkts = 0;
static uint32_t airlog_bytes = 0;
static uint8_t  airlog_body[2 + AIRLOG_CHUNK];
static uint8_t  airlog_pkt[HALOW_P2P_HDR_LEN + 2 + AIRLOG_CHUNK];

static void airlog_pump(void)
{
    if (!tx_enabled || !link_up) {
        return;
    }
#if GATED_CAPTURE
    if (gate_quiet) {
        return;                /* тишина: в модуль ни байта, см. GATED_CAPTURE */
    }
#endif
    uint32_t now = millis();
    if (now - airlog_last_ms < AIRLOG_MIN_MS) {
        return;
    }
    uint32_t used = airlog_head - airlog_tail;
    if (!used || (used < AIRLOG_CHUNK && now - airlog_last_ms < AIRLOG_FLUSH_MS)) {
        return;
    }
    uint32_t n = used < AIRLOG_CHUNK ? used : AIRLOG_CHUNK;

    airlog_body[0] = (uint8_t)(airlog_seq & 0xff);
    airlog_body[1] = (uint8_t)(airlog_seq >> 8);
    portENTER_CRITICAL(&airlog_mux);
    uint32_t pos = airlog_tail % AIRLOG_RING;
    uint32_t first = AIRLOG_RING - pos;
    if (first > n) first = n;
    memcpy(airlog_body + 2, airlog_ring + pos, first);
    memcpy(airlog_body + 2 + first, airlog_ring, n - first);
    airlog_tail += n;
    portEXIT_CRITICAL(&airlog_mux);

    int k = halow_p2p_build(airlog_pkt, HALOW_P2P_TYPE_LOG, airlog_body, (uint16_t)(2 + n));
    if (k > 0) {
        SerialAT.write(airlog_pkt, k);
        p2pGap();          /* иначе склеится со следующим чанком видео */
        airlog_pkts++;
        airlog_bytes += (uint32_t)k;
    }
    airlog_seq++;
    airlog_last_ms = now;
}
#endif

#if PAYLOAD_SWEEP
/*
 * Перебор размеров чанка. Устроен так же, как перебор пауз.
 *
 * Печатаемые здесь цифры приблизительны: они опираются на отчёты приёмника по
 * обратному каналу, а он глохнет, пока передатчик занимает эфир. Настоящие
 * числа берутся из CSV логгера — там счётчики приходят по USB и не теряются.
 * Эта строка нужна только чтобы видеть в мониторе, какой шаг сейчас идёт.
 */
static void psweep_tick(void)
{
    const uint8_t n = (uint8_t)(sizeof(sweep_payloads) / sizeof(sweep_payloads[0]));
    uint32_t now = millis();

    if (psweep_step_start == 0) {
        psweep_step_start = now;
        chunk_payload = sweep_payloads[0];
        SerialMon.printf("ПОДБОР ЧАНКА: %u значений по %u с, начинаю с %u байт\n",
                         n, (unsigned)(PSWEEP_STEP_MS / 1000), sweep_payloads[0]);
        return;
    }

    if (!psweep_settled && now - psweep_step_start >= PSWEEP_SETTLE_MS) {
        psweep_settled = true;
        psweep_ok0 = peer.pkts_ok;
        psweep_crc0 = peer.pkts_crc_err;
        psweep_frames0 = frames_total;
        psweep_bytes0 = bytes_total;
        psweep_t0 = now;
        return;
    }

    if (now - psweep_step_start < PSWEEP_STEP_MS) {
        return;
    }

    uint32_t dt = now - psweep_t0;
    uint32_t d_ok = peer.pkts_ok - psweep_ok0;
    uint32_t d_crc = peer.pkts_crc_err - psweep_crc0;
    uint32_t d_fr = frames_total - psweep_frames0;
    uint32_t d_by = bytes_total - psweep_bytes0;
    uint32_t fps10 = dt ? d_fr * 10000u / dt : 0;
    uint32_t kbps = dt ? d_by * 8u / dt : 0;

    SerialMon.printf("ЧАНК %4u байт: %u.%u fps | %u кбит/с | принято %lu | брак %lu\n",
                     sweep_payloads[psweep_idx], fps10 / 10, fps10 % 10, kbps,
                     (unsigned long)d_ok, (unsigned long)d_crc);

    psweep_idx++;
    if (psweep_idx >= n) {
        psweep_idx = 0;
        SerialMon.println("--- круг пройден, повторяю ---");
    }
    chunk_payload = sweep_payloads[psweep_idx];
    psweep_step_start = now;
    psweep_settled = false;
}
#endif

#if GAP_SWEEP
/*
 * Перебор пауз. Каждое значение держим SWEEP_STEP_MS, первые SWEEP_SETTLE_MS
 * не считаем, потом печатаем строку итога и переходим к следующему.
 * Брак берём из отчётов приёмника (обратный канал), другого источника нет.
 */
static void sweep_tick(void)
{
    const uint8_t n = (uint8_t)(sizeof(sweep_gaps) / sizeof(sweep_gaps[0]));
    uint32_t now = millis();

    if (sweep_step_start == 0) {
        sweep_step_start = now;
        chunk_gap_ms = sweep_gaps[0];
        SerialMon.printf("ПОДБОР ПАУЗЫ: %u значений по %u с, начинаю с %u мс\n",
                         n, (unsigned)(SWEEP_STEP_MS / 1000), sweep_gaps[0]);
        return;
    }

    if (!sweep_settled && now - sweep_step_start >= SWEEP_SETTLE_MS) {
        sweep_settled = true;
        sweep_ok0 = peer.pkts_ok;
        sweep_crc0 = peer.pkts_crc_err;
        sweep_frames0 = frames_total;
        sweep_bytes0 = bytes_total;
        sweep_t0 = now;
        return;
    }

    if (now - sweep_step_start < SWEEP_STEP_MS) {
        return;
    }

    uint32_t dt = now - sweep_t0;
    uint32_t d_ok = peer.pkts_ok - sweep_ok0;
    uint32_t d_crc = peer.pkts_crc_err - sweep_crc0;
    uint32_t d_fr = frames_total - sweep_frames0;
    uint32_t d_by = bytes_total - sweep_bytes0;
    uint32_t fps10 = dt ? d_fr * 10000u / dt : 0;
    uint32_t kbps = dt ? d_by * 8u / dt : 0;          // байт*8/мс = кбит/с
    uint32_t bad10 = (d_ok + d_crc) ? d_crc * 1000u / (d_ok + d_crc) : 0;

    SerialMon.printf("ПАУЗА %2u мс: %u.%u fps | %u кбит/с | принято %lu | брак %lu (%u.%u%%)\n",
                     sweep_gaps[sweep_idx], fps10 / 10, fps10 % 10, kbps,
                     (unsigned long)d_ok, (unsigned long)d_crc, bad10 / 10, bad10 % 10);

    sweep_idx++;
    if (sweep_idx >= n) {
        sweep_idx = 0;
        SerialMon.println("--- круг пройден, повторяю ---");
    }
    chunk_gap_ms = sweep_gaps[sweep_idx];
    sweep_step_start = now;
    sweep_settled = false;
}
#endif

#if FRAME_GAP_SWEEP
/*
 * Перебор паузы КАДРА. Устроен так же, как перебор паузы чанка: держим каждое
 * значение SWEEP_STEP_MS, первые SWEEP_SETTLE_MS не считаем (отчёт приёмника
 * приходит раз в секунду и на границе шага относится ещё к прошлому шагу).
 *
 * Считать надо по CSV логгера, а не по этой печати: она опирается на обратный
 * канал, который глохнет, пока передатчик занимает эфир.
 */
static uint8_t  fsweep_idx = 0;
static uint32_t fsweep_step_start = 0;
static bool     fsweep_settled = false;
static uint32_t fsweep_ok0 = 0, fsweep_crc0 = 0;
static uint32_t fsweep_frames0 = 0, fsweep_bytes0 = 0;
static uint32_t fsweep_t0 = 0;

static void fsweep_tick(void)
{
    const uint8_t n = (uint8_t)(sizeof(frame_gaps) / sizeof(frame_gaps[0]));
    uint32_t now = millis();

    if (fsweep_step_start == 0) {
        fsweep_step_start = now;
        frame_gap_ms = frame_gaps[0];
        SerialMon.printf("ПОДБОР ПАУЗЫ КАДРА: %u значений по %u с, начинаю с %u мс\n",
                         n, (unsigned)(SWEEP_STEP_MS / 1000), frame_gaps[0]);
        return;
    }
    if (!fsweep_settled && now - fsweep_step_start >= SWEEP_SETTLE_MS) {
        fsweep_settled = true;
        fsweep_ok0 = peer.pkts_ok;
        fsweep_crc0 = peer.pkts_crc_err;
        fsweep_frames0 = frames_total;
        fsweep_bytes0 = bytes_total;
        fsweep_t0 = now;
        return;
    }
    if (now - fsweep_step_start < SWEEP_STEP_MS) {
        return;
    }

    uint32_t dt = now - fsweep_t0;
    uint32_t d_ok = peer.pkts_ok - fsweep_ok0;
    uint32_t d_crc = peer.pkts_crc_err - fsweep_crc0;
    uint32_t d_fr = frames_total - fsweep_frames0;
    uint32_t d_by = bytes_total - fsweep_bytes0;
    uint32_t fps10 = dt ? d_fr * 10000u / dt : 0;
    uint32_t kbps = dt ? d_by * 8u / dt : 0;
    uint32_t bad10 = (d_ok + d_crc) ? d_crc * 1000u / (d_ok + d_crc) : 0;

    SerialMon.printf("ПАУЗА КАДРА %2u мс: %u.%u fps | %u кбит/с | принято %lu | брак %lu (%u.%u%%)\n",
                     frame_gaps[fsweep_idx], fps10 / 10, fps10 % 10, kbps,
                     (unsigned long)d_ok, (unsigned long)d_crc, bad10 / 10, bad10 % 10);

    fsweep_idx++;
    if (fsweep_idx >= n) {
        fsweep_idx = 0;
        SerialMon.println("--- круг пройден, повторяю ---");
    }
    frame_gap_ms = frame_gaps[fsweep_idx];
    fsweep_step_start = now;
    fsweep_settled = false;
}
#endif

//************************************[ СТАРТОВОЕ ОКНО ]*********************************

// Пока прозрачный режим не стартовал, модуль ещё понимает AT. Пользуемся этим
// ровно один раз — чтобы заткнуть периодическую печать LMAC, которая иначе
// будет сыпаться в поток.

// Одна команда в стартовом окне: послать и показать ответ модуля.
// wait_ms — сколько ждать ответа. 300 мс хватает почти всем, но AT+SYSCFG
// вываливает два десятка строк, и на 300 мс его ответ обрезается посередине.
/* Возвращает ответ модуля: он нужен не только логу. Из AT+SYSCFG мы достаём
 * bssid, чтобы не зашивать MAC приёмника константой (см. P2P_UNICAST). */
/*
 * Сколько команд стартового окна получили ответ.
 *
 * ЗАЧЕМ СЧИТАТЬ. esptool перезагружает только ESP32; модуль TX-AH при этом
 * продолжает работать и, если с его включения прошло больше
 * UART_P2P_START_DELAY_MS, уже забрал UART себе. Тогда стартового окна нет:
 * все команды уходят в пустоту, модуль молча остаётся на настройках прошлой
 * загрузки, а скетч как ни в чём не бывало начинает поток.
 *
 * 16.09 на этом сгорела целая ночь измерений: три прогона подряд были
 * подписаны как широковещательные, а шли одноадресно, потому что P2PDEST
 * остался от прошлой загрузки. Снятие флага в скетче не меняет НИЧЕГО, когда
 * команду некому принять.
 *
 * Поэтому: если ни одна команда окна не получила ответа — кричать об этом в
 * лог, чтобы прогон не был засчитан.
 */
static uint8_t at_window_answers = 0;

static String atWindowCmdWait(const char *cmd, uint16_t wait_ms)
{
    while (SerialAT.available()) {
        SerialAT.read();
    }
    SerialAT.print(cmd);

    /* Вычёрпываем ВО ВРЕМЯ ожидания, а не после. Раньше здесь был delay() и
     * потом чтение: длинный ответ (AT+SYSCFG — два десятка строк) не помещался
     * в приёмный буфер драйвера и обрезался посередине, а обрезанным его не
     * прочитать. */
    String resp;
    uint32_t t0 = millis();
    while (millis() - t0 < wait_ms) {
        while (SerialAT.available()) {
            resp += (char)SerialAT.read();
        }
        delay(2);
    }
    resp.trim();
    /*
     * Засчитываем ТОЛЬКО ответ, содержащий "OK".
     *
     * Проверки «строка непустая» недостаточно: 16.09 она дала ложный пропуск.
     * Модуль сидел в прозрачном режиме, в UART шёл его поток данных, и куски
     * этого потока попадали в ответ — на AT+SYSCFG, который печатает два
     * десятка строк, пришёл одинокий знак вопроса. Четыре таких огрызка были
     * посчитаны за ответы, и прогон объявлен годным.
     *
     * "OK" модуль печатает в конце почти каждой команды окна (SYSDBG,
     * MCAST_BW, MCAST_MCS, P2PDEST, ENCRYPT, SSID, SET_BGRSSI). Случайно
     * собраться из видеопотока эти два байта подряд практически не могут.
     */
    if (resp.indexOf("OK") >= 0 && at_window_answers < 255) {
        at_window_answers++;
    }
    String echo(cmd);
    echo.trim();                 // без хвостового CRLF, иначе лог лесенкой
    if (!resp.length()) {
        SerialMon.printf("  %s -> (нет ответа)\n", echo.c_str());
    } else if (resp.indexOf('\n') < 0) {
        SerialMon.printf("  %s -> %s\n", echo.c_str(), resp.c_str());
    } else {
        /* Многострочный ответ печатаем как есть: складывать конфигурацию
         * модуля в одну строку — значит потом её не прочитать. */
        SerialMon.printf("  %s ->\n", echo.c_str());
        SerialMon.println(resp);
    }
    return resp;
}

static void atWindowCmd(const char *cmd)
{
    atWindowCmdWait(cmd, 300);
}

/* Определена ниже, в разделе камеры; замеру шума она нужна здесь. */
static bool camera_init(void);

static void useAtWindow(void)
{
#if USE_AT_WINDOW
#if AT_WINDOW_LOGCFG && QUIET_MODULE
    const char *cmds[] = {
#if LMAC_STATS
        /* Обратно включаем печать LMAC: ради неё всё и затевается. */
        "AT+SYSDBG=LMAC,1\r\n",
#else
        "AT+SYSDBG=LMAC,0\r\n",
#endif
        "AT+SYSDBG=WNB,0\r\n",
    };
#endif
#if AT_WINDOW_WRITE || CCA_MARGIN_DB || SET_MCAST || LMAC_STATS || P2P_UNICAST
    char buf[48];
#endif

#if CCA_MARGIN_DB
    snprintf(buf, sizeof(buf), "AT+BGRSSI_MARGIN=%d\r\n", CCA_MARGIN_DB);
    atWindowCmd(buf);
#endif

    SerialMon.printf("Стартовое окно (%u с): запись %s, чтение %s\n",
                     (unsigned)(P2P_WINDOW_MS / 1000),
                     AT_WINDOW_WRITE ? "ВКЛ" : "выкл",
                     AT_WINDOW_READ ? "вкл" : "выкл");

#if AT_WINDOW_LOGCFG && QUIET_MODULE
    /* Только многословность печати LMAC. Радио, ключи и флеш не трогает. */
#if LMAC_STATS
    snprintf(buf, sizeof(buf), "AT+PRINT_PERIOD=%d\r\n", (int)LMAC_STATS);
    atWindowCmd(buf);
    /*
     * Вернуть печать ПОСЛЕ старта прозрачного режима. Без этой команды всё
     * предыдущее бесполезно: uart_p2p_init() последним делом зовёт
     * disable_print(1), и статистика замолкает на 30-й секунде — ровно перед
     * тем, как пойдёт видео. AT+P2PLOG заводит в модуле периодический таймер,
     * который возвращает disable_print(0).
     *
     * Команды нет в заводской прошивке: она добавлена в project/atcmd.c и
     * собрана 17.09 (SDK/builds/APP_..._p2pdest_p2plog.bin). На старой прошивке
     * не ответит, и прогон просто пойдёт без статистики.
     *
     * ТОЛЬКО НА КАМЕРЕ. На приёмнике этим же UART идёт видео из эфира, и текст
     * его побьёт.
     */
    snprintf(buf, sizeof(buf), "AT+P2PLOG=%d\r\n", (int)LMAC_STATS);
    atWindowCmd(buf);
    snprintf(buf, sizeof(buf), "AT+UARTDRAIN=%d\r\n", (int)UART_DRAIN);
    atWindowCmd(buf);
#endif
    for (unsigned i = 0; i < sizeof(cmds) / sizeof(cmds[0]); i++) {
        atWindowCmd(cmds[i]);
    }
#endif

#if SET_MCAST
    /* Широковещательный тракт — им идёт видео. Ставим каждый раз:
     * эти параметры, судя по всему, не переживают перезагрузку.
     *
     * ОСТОРОЖНО: на приёмнике этот же блок отключён (SET_MCAST 0) с 20.08,
     * потому что MCAST_MCS бьёт по маякам и по самой возможности подключиться.
     * Асимметрия «на камере ставим, на приёмнике нет» держалась неделю и никем
     * не была замечена — ещё одна причина не писать конфигурацию из скетча. */
    snprintf(buf, sizeof(buf), "AT+MCAST_BW=%d\r\n", MCAST_BW);
    atWindowCmd(buf);
    snprintf(buf, sizeof(buf), "AT+MCAST_MCS=%d\r\n", MCAST_MCS);
    atWindowCmd(buf);
#endif

#if AT_WINDOW_READ
    /* Паспорт прогона со стороны модуля: конфигурация целиком, одной командой.
     * Ловится в консольный лог и подшивается к прогону
     * (tools/run_passport.py). Ничего не меняет. */
    String syscfg = atWindowCmdWait("AT+SYSCFG\r\n", 2000);
#if P2P_UNICAST
    /*
     * Кому слать видео. bssid станции — это MAC точки доступа; берём его из
     * ответа выше, а не из константы.
     *
     * Формат строки: "  mac:c6:e8:35:92:6e:18, bssid:c6:e8:35:70:7a:68".
     * Ищем именно "bssid:", а не "mac:" — иначе подставили бы собственный
     * адрес и отправляли бы кадры сами себе.
     */
    {
        int at = syscfg.indexOf("bssid:");
        if (at < 0) {
            SerialMon.println("  P2PDEST: bssid в AT+SYSCFG не найден, "
                              "остаёмся широковещательными");
        } else {
            String bssid = syscfg.substring(at + 6, at + 6 + 17);
            bssid.trim();
            if (bssid.length() != 17) {
                SerialMon.printf("  P2PDEST: bssid непохож на MAC (%s)\n",
                                 bssid.c_str());
            } else if (bssid.startsWith("00:00:00:00:00:00")) {
                /* Станция ещё не ассоциирована, точка доступа неизвестна.
                 * Слать нулевой адрес нельзя — модуль его и сам отвергнет. */
                SerialMon.println("  P2PDEST: bssid нулевой, точка доступа ещё "
                                  "не выбрана — остаёмся широковещательными");
            } else {
#if P2P_DEST_TEST
                /* Отладка: шлём в никуда, чтобы убедиться, что адрес вообще
                 * управляет эфиром. Видео должно пропасть. */
                SerialMon.printf("  P2PDEST: ПРОВЕРКА ЛОЖНЫМ АДРЕСОМ, настоящий "
                                 "%s подменяю на %s%s",
                                 bssid.c_str(), P2P_DEST_TEST_MAC, "\n");
                bssid = P2P_DEST_TEST_MAC;
#endif
                snprintf(buf, sizeof(buf), "AT+P2PDEST=%s\r\n", bssid.c_str());
                atWindowCmd(buf);
            }
        }
    }
#endif
#if TX_PWR_AUTO >= 0
    snprintf(buf, sizeof(buf), "AT+TX_PWR_AUTO=%d\r\n", (int)TX_PWR_AUTO);
    atWindowCmd(buf);
    atWindowCmd("AT+TX_PWR_AUTO=?\r\n");
#endif
#if TX_POWER_DBM >= 1
    snprintf(buf, sizeof(buf), "AT+TXPOWER=%d\r\n", (int)TX_POWER_DBM);
    atWindowCmd(buf);
    atWindowCmd("AT+TXPOWER=?\r\n");
#endif
#if RTS_SET_SYM > 0
    snprintf(buf, sizeof(buf), "AT+SET_RTS=%d\r\n", (int)RTS_SET_SYM);
    atWindowCmd(buf);
#endif
#if PWRCTL_MODE >= 0
    /* После AT+TXPOWER: регулятор берёт её как стартовую мощность. */
    snprintf(buf, sizeof(buf), "AT+PWRCTL=%d,%d,%d,%d\r\n",
             (int)PWRCTL_MODE, (int)PWRCTL_LO, (int)PWRCTL_HI, (int)PWRCTL_MAX);
    atWindowCmd(buf);
#endif
#if ROLE_SWAP && MCSCTL_MODE >= 0
    /* После AT+MCAST_MCS (блок SET_MCAST выше): с неё подстройка и стартует. */
#if MCSCTL_ALT_S > 0
    snprintf(buf, sizeof(buf), "AT+MCSCTL=%d,0,0,6,%d\r\n", (int)MCSCTL_MODE, (int)MCSCTL_ALT_S);
#else
    snprintf(buf, sizeof(buf), "AT+MCSCTL=%d\r\n", (int)MCSCTL_MODE);
#endif
    atWindowCmd(buf);
#endif
#if TX_MCS_MAX_CAP >= 0
    /* 128 — бит «ограничение задано», без него значение игнорируется. */
    snprintf(buf, sizeof(buf), "AT+TX_MCS_MAX=%d\r\n",
             128 + (int)TX_MCS_MAX_CAP);
    atWindowCmd(buf);
#endif
#if MCS_SWEEP
    {
        static const int8_t lst[] = MCS_SWEEP_LIST;
        const uint8_t n = sizeof(lst) / sizeof(lst[0]);
        Preferences pr;
        pr.begin(MCS_SWEEP_NS, false);
        uint8_t i = pr.getUChar("i", 0);
        int8_t v = lst[i % n];
        bool ok = at_window_answers >= 3;
        if (v >= 0) {
            snprintf(buf, sizeof(buf), "AT+TX_MCS=%d\r\n", (int)v);
            ok = (atWindowCmdWait(buf, 300).indexOf("OK") >= 0) && ok;
        }
        char vs[16];           /* «авто» в UTF-8 — 8 байт плюс ноль */
        if (v >= 0) snprintf(vs, sizeof(vs), "%d", (int)v);
        else        snprintf(vs, sizeof(vs), "авто");
        SerialMon.printf("MCS-ПЕРЕБОР: шаг %u из %u, MCS %s%s\n",
                         (unsigned)(i % n + 1), (unsigned)n, vs,
                         ok ? "" : " — ОКНО/КОМАНДА НЕ ПРОШЛИ, шаг не засчитан");
        if (ok) {
            pr.putUChar("i", (uint8_t)(i + 1));
        }
        pr.end();
    }
#elif TX_MCS_FIX >= 0
    snprintf(buf, sizeof(buf), "AT+TX_MCS=%d\r\n", (int)TX_MCS_FIX);
    atWindowCmd(buf);
#endif
    bool chan_written = false;
#if BSS_BW_SET > 0 || CHAN_SET > 0
    {
        /* Ответы: "+BSS_BW:4", "+CHAN_LIST:8660". Пишем, только если прочли. */
        String r = atWindowCmdWait("AT+BSS_BW=?\r\n", 300);
        int k = r.indexOf("+BSS_BW:");
        int bw = k >= 0 ? r.substring(k + 8).toInt() : -1;
        r = atWindowCmdWait("AT+CHAN_LIST=?\r\n", 300);
        k = r.indexOf("+CHAN_LIST:");
        int ch = k >= 0 ? r.substring(k + 11).toInt() : -1;
        if (BSS_BW_SET > 0 && bw > 0 && bw != BSS_BW_SET) {
            snprintf(buf, sizeof(buf), "AT+BSS_BW=%d\r\n", (int)BSS_BW_SET);
            atWindowCmd(buf);
            chan_written = true;
        }
        if (CHAN_SET > 0 && ch > 0 && ch != CHAN_SET) {
            snprintf(buf, sizeof(buf), "AT+CHAN_LIST=%d\r\n", (int)CHAN_SET);
            atWindowCmd(buf);
            chan_written = true;
        }
        SerialMon.printf("КАНАЛ: в модуле %d МГц на %d.%d МГц%s\n", bw, ch / 10, ch % 10,
                         chan_written ? " — ЗАПИСАН НОВЫЙ, действует со следующего включения питания"
                                      : (bw > 0 ? " — как задано" : " — не прочитан"));
    }
#endif
#if VAR_SWEEP
    {
        const uint8_t n = sizeof(var_sweep) / sizeof(var_sweep[0]);
        Preferences pr;
        pr.begin(VAR_SWEEP_NS, false);
        uint8_t i = pr.getUChar("i", 0);
        const var_step_t *v = &var_sweep[i % n];
        if (v->gap_us) {
            chunk_gap_us = v->gap_us;   /* и в незасчитанном шаге: так он и работает */
        }
        bool ok = at_window_answers >= 3 && !chan_written;
        /* 30.09: ответ на команду варианта на счёт шага не влияет — у ручек из
         * отладочной таблицы модуля (RC_NEW, LMAC_DBGSEL) формат ответа не
         * проверен, и без «OK» перебор застрял бы на одном шаге. Принята ли
         * команда — видно по её ответу строкой выше и по чтению после неё. */
        bool cmd_ok = true;
        for (uint8_t c = 0; c < 2; c++) {
            if (v->cmd[c]) {
                cmd_ok = (atWindowCmdWait(v->cmd[c], 300).indexOf("OK") >= 0) && cmd_ok;
            }
        }
        SerialMon.printf("ВАРИАНТ: шаг %u из %u, %s%s%s\n",
                         (unsigned)(i % n + 1), (unsigned)n, v->name,
                         ok ? "" : chan_written ? " — канал только что записан, шаг не засчитан"
                                                : " — ОКНО НЕ ОТКРЫЛОСЬ, шаг не засчитан",
                         cmd_ok ? "" : " — на команду варианта нет «OK», см. ответ выше");
        if (ok) {
            pr.putUChar("i", (uint8_t)(i + 1));
        }
        pr.end();
    }
    /* Что реально стоит после варианта: склейка, ожидание ACK, повторы, RTS. */
    atWindowCmd("AT+TX_MAX_AGG=?\r\n");
    atWindowCmd("AT+TX_AGG_AUTO=?\r\n");
    atWindowCmd("AT+ACK_TO=?\r\n");
    atWindowCmd("AT+TX_CNT_MAX=?\r\n");
    atWindowCmd("AT+SET_RTS=?\r\n");
#endif
    /* Читаем ПОСЛЕ возможной записи: в лог попадает то, что реально стоит. */
    atWindowCmd("AT+TX_MCS=?\r\n");
    atWindowCmd("AT+TX_MCS_MAX=?\r\n");
    atWindowCmd("AT+TX_MCS_MIN=?\r\n");
    atWindowCmd("AT+TX_RATE_FIXED=?\r\n");
    atWindowCmd("AT+ENCRYPT=?\r\n");
    atWindowCmd("AT+SSID=?\r\n");
    /* Измеренный фоновый уровень. Он не настройка, а показание, и по нему
     * видно, не уехал ли шум платы — см. комментарий к CCA_MARGIN_DB. */
    atWindowCmd("AT+SET_BGRSSI=?\r\n");
#endif

#if NOISE_PROBE
    /*
     * Три замера фона: с сенсором, без него и снова с ним. Проверяем, глушит
     * ли камера собственный приёмник — см. комментарий к NOISE_PROBE.
     *
     * Конвейер в это время стоит: camera_task ждёт tx_enabled, а он ещё ложен.
     * Значит deinit безопасен, кадры никто не запрашивает.
     */
    SerialMon.println("ЗАМЕР ШУМА: A — сенсор работает");
    atWindowCmd("AT+SET_BGRSSI=?\r\n");

    if (camera_ok) {
        esp_camera_deinit();
        SerialMon.printf("  сенсор выключен, жду %u мс на усреднение\n",
                         (unsigned)NOISE_SETTLE_MS);
        halow_mon_settle();
        delay(NOISE_SETTLE_MS);
        SerialMon.println("ЗАМЕР ШУМА: B — сенсор выключен");
        atWindowCmd("AT+SET_BGRSSI=?\r\n");

        camera_ok = camera_init();
        SerialMon.printf("  сенсор включён обратно: %s, жду %u мс\n",
                         camera_ok ? "OK" : "ОШИБКА", (unsigned)NOISE_SETTLE_MS);
        halow_mon_settle();
        delay(NOISE_SETTLE_MS);
        SerialMon.println("ЗАМЕР ШУМА: C — сенсор снова работает");
        atWindowCmd("AT+SET_BGRSSI=?\r\n");
    } else {
        SerialMon.println("  камера не поднялась, замер B/C пропущен");
    }
    halow_mon_settle();
#endif

#if AT_WINDOW_WRITE && LINK_DIAG
    /*
     * ШИФРОВАНИЕ ВЫКЛЮЧАЕМ.
     *
     * 20.08: платы перестали сходиться. Приёмник станцию видит и номер ей
     * выдаёт (add_STA, aid=1), а дальше рукопожатие WPA умирает на первом же
     * сообщении: "WPA: sending 1/4 msg of 4-Way Handshake" -> "EAPOL-Key
     * timeout". В логе модуля при этом мелькает "lmac error!!! ccmp_err ...
     * keylen= 0(0)" — ключи ставятся криво.
     *
     * Без шифрования рукопожатия нет вовсе, а значит нет и места, где мы
     * спотыкаемся. Документация проекта и так описывает стенд без шифрования;
     * это приводит железо в соответствие с ней. Ключ в модуле остаётся, вернуть
     * можно командой AT+ENCRYPT=1.
     *
     * ВАЖНО: ставить на ОБЕИХ платах, иначе не сойдутся тем более.
     */
    /*
     * ШИФРОВАНИЕ УЖЕ ВЫКЛЮЧЕНО И СОХРАНЕНО ВО ФЛЕШ (24.08), поэтому команду
     * AT+ENCRYPT=0 здесь больше не шлём — только читаем.
     *
     * 25.08: выяснилось, что она не безобидна. На точке доступа она пересобирает
     * ключи и дёргает интерфейс (в логе: AP set KEYMGMT=4, del gtk,
     * WPA_COMPLETED -> WPA_INTERFACE_DISABLED -> WPA_COMPLETED), да ещё и пишет
     * во флеш при каждой загрузке. Всё это происходит на второй секунде жизни
     * модуля — ровно тогда, когда камера пытается ассоциироваться.
     */
    /*
     * 26.08: ВРЕМЕННО возвращена запись ENCRYPT=0.
     *
     * Днём включил шифрование командой AT+ENCRYPT=1, проверяя версию про ключи,
     * и не вернул обратно. Итог виден в логе точки доступа: камера
     * ассоциируется на третьей секунде (add_STA, aid=1, sta_cnt=1), дальше идёт
     * "WPA: start authentication" — и к десятой секунде станции уже нет.
     * Рукопожатие не проходит, ровно как ловили раньше по EAPOL-Key timeout.
     *
     * Пишется во флеш, хватит одной загрузки. После подтверждения строку убрать:
     * на живой точке доступа команда дёргает интерфейс и пересобирает ключи.
     */
    /*
     * 27.08: убрана из штатного прогона (AT_WINDOW_WRITE=0). Шифрование теперь
     * задаётся один раз с терминала и читается выше через AT+ENCRYPT=?.
     * После AT+LOADDEF обе платы получают одинаковые заводские ключи
     * (KEYMGMT=2, CCMP, пароль 12345678), так что и выключать ничего не нужно.
     */
    atWindowCmd("AT+ENCRYPT=0\r\n");
#endif

#if AT_WINDOW_WRITE && TX_POWER
    snprintf(buf, sizeof(buf), "AT+TXPOWER=%d\r\n", TX_POWER);
    atWindowCmd(buf);
#endif
#endif
}

//************************************[ CAMERA ]*****************************************

static const char *fs_name(framesize_t fs)
{
    switch (fs) {
        case FRAMESIZE_96X96: return "96x96";
        case FRAMESIZE_QQVGA: return "160x120";
        case FRAMESIZE_HQVGA: return "240x176";
        case FRAMESIZE_QVGA:  return "320x240";
        case FRAMESIZE_HVGA:  return "480x320";
        case FRAMESIZE_VGA:   return "640x480";
        case FRAMESIZE_SVGA:  return "800x600";
        default:              return "?";
    }
}

/*
 * Шершавость кадра RGB565: средняя разница между соседними пикселями по
 * горизонтали, усреднённая по трём каналам. RGB565 разбираем в 8 бит на
 * канал, чтобы число было в той же шкале, что и у tools/frame_check.py.
 */
static float cam_roughness(const camera_fb_t *fb)
{
    if (!fb || fb->format != PIXFORMAT_RGB565 || fb->width < 2 || !fb->buf) {
        return 0.0f;
    }
    /* СТАРШИЙ БАЙТ ПЕРВЫЙ — как кладёт камера и как читает cam_rough_at().
     *
     * Здесь было `(const uint16_t *)fb->buf`, то есть порядок платформы —
     * младшим вперёд. Пока эта функция только мерила, расхождение было
     * безвредным: метрика со спутанными полями всё равно отличает гладкое
     * от рябого. Но с 25.09 она служит ВТОРЫМ УСЛОВИЕМ ОТКАТА, а там это
     * смертельно: в съехавшем хвосте пары байт сдвинуты, и чтение младшим
     * вперёд попадает там «в такт», а ПОСЛЕ верной вставки — выпадает. Две
     * функции оказались анти-коррелированы, и откат срабатывал на КАЖДОЙ
     * верной починке. На плате это дало «вылечено 388 из 3083».
     *
     * Побочное следствие правки: шкала сдвинулась, и старый порог 8.0 к ней
     * больше не привязан. Это не страшно: правка на порог не опирается вовсе,
     * а строка статистики теперь сравнима с числами лаборатории. */
    const uint8_t *bp = fb->buf;
    uint32_t acc = 0, n = 0;
    for (size_t y = 0; y < fb->height; y += CAM_CHECK_ROW_STEP) {
        const uint8_t *row = bp + y * fb->width * 2;
        for (size_t x = 1; x < fb->width; x++) {
            uint16_t a = (uint16_t)((row[(x - 1) * 2] << 8) | row[(x - 1) * 2 + 1]);
            uint16_t b = (uint16_t)((row[x * 2] << 8) | row[x * 2 + 1]);
            int dr = (int)((a >> 11) & 0x1f) - (int)((b >> 11) & 0x1f);
            int dg = (int)((a >>  5) & 0x3f) - (int)((b >>  5) & 0x3f);
            int db = (int)( a        & 0x1f) - (int)( b        & 0x1f);
            /* 5 и 6 бит -> 8, чтобы шкала совпала с разбором на ПК */
            acc += (uint32_t)(abs(dr) << 3) + (uint32_t)(abs(dg) << 2)
                 + (uint32_t)(abs(db) << 3);
            n += 3;
        }
    }
    return n ? (float)acc / (float)n : 0.0f;
}

#if CAM_XCLK_HZ == 16000000
#include "esp32s3/rom/cache.h"   // Cache_Invalidate_Addr / Cache_WriteBack_Addr
#endif

#if CAM_VSYNC_FILTER
#include "soc/lcd_cam_struct.h"   // LCD_CAM.cam_ctrl / cam_ctrl1 — фильтр VSYNC
#endif

#if VSYNC_PROBE
/* Щуп VSYNC — см. VSYNC_PROBE. Прерывание GPIO на любой фронт. */
static volatile uint32_t vs_edges = 0;
static void IRAM_ATTR vs_probe_isr(void *arg)
{
    (void)arg;
    vs_edges++;
}

static void vs_probe_attach(void)
{
    const gpio_num_t pin = (gpio_num_t)CAMERA_PIN_VSYNC;
    gpio_install_isr_service(0);        /* уже стоит — вернёт ошибку, это нормально */
    gpio_isr_handler_remove(pin);       /* после перезапуска драйвера — не дважды */
    gpio_set_intr_type(pin, GPIO_INTR_ANYEDGE);
    esp_err_t rc = gpio_isr_handler_add(pin, vs_probe_isr, NULL);
    gpio_intr_enable(pin);
    SerialMon.printf("VSYNC: щуп на GPIO %d — %s\n", (int)pin, rc == ESP_OK ? "стоит" : "НЕ ВСТАЛ");
}
#endif

/*
 * КЭШ И КАДР (06.10). При XCLK 16 МГц драйвер пишет кадр DMA прямо в PSRAM, мимо
 * кэша процессора (см. CAM_XCLK_HZ), а сама библиотека кэш не трогает — в
 * libesp32-camera.a нет ни одного вызова Cache_*. Тогда в кэше могут остаться
 * строки ПРОШЛОГО кадра из того же буфера, и процессор прочтёт их вместо новых.
 * Хуже того, правка слипа пишет в буфер на месте: грязная строка, вытесненная из
 * кэша уже после DMA, затёрла бы новый кадр старыми байтами.
 * Поэтому: взяли кадр — выбросили из кэша его строки (только целые, по 32 Б, чтобы
 * не задеть соседей по куче); отдаём — сначала выписали грязные в PSRAM.
 * При 20 МГц драйвер копирует кадр в PSRAM сам, через кэш, и обе функции пустые.
 */
static inline void cam_cache_fresh(camera_fb_t *fb)
{
#if CAM_XCLK_HZ == 16000000
    uint32_t a = ((uint32_t)fb->buf + 31u) & ~31u;
    uint32_t e = ((uint32_t)fb->buf + fb->len) & ~31u;
    if (e > a) {
        Cache_Invalidate_Addr(a, e - a);
    }
#else
    (void)fb;
#endif
}

static inline void cam_fb_give(camera_fb_t *fb)
{
#if CAM_XCLK_HZ == 16000000
    Cache_WriteBack_Addr((uint32_t)fb->buf, fb->len);
#endif
    esp_camera_fb_return(fb);
}

/* Сила выходов сенсора — см. CAM_DRIVE. force — записать, даже если уже стоит:
 * после перезапуска драйвера сенсор снова на ×4 из таблицы библиотеки. */
static uint8_t cam_drv_now = 0;     /* 0 — не трогали (у библиотеки ×4), 1..4 — ×1..×4 */

static void cam_drv_apply(uint8_t drv, bool force)
{
    if (drv < 1 || drv > 4 || (drv == cam_drv_now && !force)) {
        return;
    }
    sensor_t *sn = esp_camera_sensor_get();
    if (!sn || !sn->set_reg || !sn->get_reg || sn->id.PID != OV5640_PID) {
        return;
    }
    int was = sn->get_reg(sn, 0x302C, 0xFF);
    int rc = sn->set_reg(sn, 0x302C, 0xC0, (drv - 1) << 6);
    int now = sn->get_reg(sn, 0x302C, 0xFF);
    cam_drv_now = drv;
    SerialMon.printf("ТОК ВЫХОДОВ: 0x302C было 0x%02x, стало 0x%02x — x%u (set_reg=%d)\n",
                     was & 0xFF, now & 0xFF, (unsigned)drv, rc);
}

#if CAM_SIG_COUNT
#include "driver/pcnt.h"
#include "driver/gpio.h"
#include "esp_system.h"
/* Счётчик сигналов сенсора — см. CAM_SIG_COUNT. Блок 0 — VSYNC, блок 1 — HREF, по
 * переднему фронту. -1 — за прошлый период не считали (счётчик не встал). */
static bool    sig_ok = false;
static int16_t sig_vs_last = -1, sig_hr_last = -1;

/* Тип блока — int, а не pcnt_unit_t: Arduino выносит прототипы функций в начало
 * скетча, выше #include "driver/pcnt.h", и там этого типа ещё нет. */
static bool sig_unit(int unit, int gpio)
{
    const pcnt_unit_t u = (pcnt_unit_t)unit;
    pcnt_config_t c;
    memset(&c, 0, sizeof(c));
    c.pulse_gpio_num = gpio;
    c.ctrl_gpio_num = PCNT_PIN_NOT_USED;
    c.lctrl_mode = PCNT_MODE_KEEP;
    c.hctrl_mode = PCNT_MODE_KEEP;
    c.pos_mode = PCNT_COUNT_INC;
    c.neg_mode = PCNT_COUNT_DIS;
    c.counter_h_lim = 32767;
    c.counter_l_lim = -32768;
    c.unit = u;
    c.channel = PCNT_CHANNEL_0;
    if (pcnt_unit_config(&c) != ESP_OK) {
        return false;
    }
    pcnt_set_filter_value(u, 1000);     /* 1000 тактов APB 80 МГц = 12,5 мкс */
    pcnt_filter_enable(u);
    /* pcnt_unit_config включает подтяжку вверх; драйвер камеры оставил вывод
     * плавающим — возвращаем как было, электрически линию не трогаем. */
    gpio_set_pull_mode((gpio_num_t)gpio, GPIO_FLOATING);
    pcnt_counter_pause(u);
    pcnt_counter_clear(u);
    pcnt_counter_resume(u);
    return true;
}

/* Один раз, после первого подъёма камеры: выводы уже настроены её драйвером, PCNT
 * только подключается к тем же выводам через матрицу GPIO, захвату не мешает. */
static void sig_init(void)
{
    static bool tried = false;
    if (tried) {
        return;
    }
    tried = true;
    sig_ok = sig_unit(PCNT_UNIT_0, CAMERA_PIN_VSYNC) && sig_unit(PCNT_UNIT_1, CAMERA_PIN_HREF);
    SerialMon.printf("СИГНАЛЫ: счётчик VSYNC (GPIO %d) и HREF (GPIO %d) %s\n",
                     (int)CAMERA_PIN_VSYNC, (int)CAMERA_PIN_HREF, sig_ok ? "стоит" : "НЕ ВСТАЛ");
}
#endif

/* Медиана шершавости по нескольким кадрам: один сбойный кадр не решает. */
static float cam_sample_roughness(void)
{
    for (int i = 0; i < CAM_CHECK_SKIP; i++) {
        camera_fb_t *w = esp_camera_fb_get();
        if (w) esp_camera_fb_return(w);
    }
    float v[CAM_CHECK_FRAMES];
    int got = 0;
    for (int i = 0; i < CAM_CHECK_FRAMES; i++) {
        camera_fb_t *fb = esp_camera_fb_get();
        if (!fb) continue;
        cam_cache_fresh(fb);
        v[got++] = cam_roughness(fb);
        cam_fb_give(fb);
    }
    if (!got) return 0.0f;
    for (int i = 1; i < got; i++) {          /* вставками, got <= 5 */
        float k = v[i]; int q = i - 1;
        while (q >= 0 && v[q] > k) { v[q + 1] = v[q]; q--; }
        v[q + 1] = k;
    }
    return v[got / 2];
}

/*
 * ИСПРАВЛЕНИЕ БАЙТОВОГО СЛИПА В СЫРОМ КАДРЕ. ВЕРСИЯ 3 (25.09).
 *
 * Механизм (разобран 15.09): в сыром RGB565 с некоторого смещения k теряется
 * один байт. Дальше до конца кадра старший и младший байты меняются ролями,
 * пиксельная сетка съезжает — отсюда «радуга». Строки при этом целы и разрывов
 * нет, поэтому все проверки на рвань ничего не находили. Починка — вставить
 * один байт обратно на позицию k; какое у него значение, неважно — это один
 * пиксель.
 *
 * Версии 1 и 2 кадры ПОРТИЛИ, и обе по одной причине — абсолютный порог
 * шершавости. Контрастный сюжет превышает его безо всякого слипа, и байт
 * выбрасывался из здорового кадра. Версия 1 раздула кадр с 4 до 25 КБ (потери
 * чанков 47.6%), версия 2 до 15 КБ (потери 28.5%).
 *
 * Здесь порога нет вовсе. Мера порчи — сколько строк УВЕРЕННО читаются со
 * сдвигом на байт: для строки считаются две шершавости, обычная и сдвинутая,
 * и сравниваются друг с другом. Контраст поднимает обе разом и решения не
 * меняет. Вставка принимается, только если таких строк стало МЕНЬШЕ и кадр в
 * целом не стал грубее; иначе — откат.
 *
 * Откат стоит один байт, а не копию кадра в 84 КБ: сдвиг вправо выталкивает
 * из буфера последний байт, и если его сохранить, обратный сдвиг восстановит
 * кадр побайтно. Поэтому неудачная попытка здесь ничего не стоит.
 *
 * ПРОВЕРЕНО НА СОХРАНЁННЫХ КАДРАХ, а не на живом потоке — tools/slip_lab.py,
 * 30 кадров с прошлых прогонов: 16 целых не тронуты ни одним байтом, 11
 * починены полностью, 3 многократно побитых улучшены, испорченных нет.
 * Независимая метрика (вертикальная гладкость, её алгоритм не оптимизирует)
 * улучшилась на всех 14 изменённых кадрах. Оттуда же взяты все константы.
 */
/* 26.09: контрольный прогон без правки дал кадр 6750 Б против 5032 и 46.1%
 * поражённых против 8.9% на том же сюжете. Правка окупается и по времени:
 * сжатие +9 мс, зато UART -9 мс, мелкий кадр быстрее уходит в провод. */
#define CAM_REPAIR        1
#define CAM_REPAIR_ROW    2      /* шаг по строкам при подсчёте съехавших */
#define CAM_REPAIR_PIX    2      /* шаг по пикселям: вчетверо дешевле, вывод тот же */
#define CAM_REPAIR_MAX    4      /* сколько вставок пробовать на одном кадре */
#define CAM_REPAIR_MARGIN 0.75f  /* насколько уверенно сдвиг должен выигрывать */
#define CAM_REPAIR_FINE   24     /* окно мелкого добора, пикселей */

static uint32_t cam_fix_try = 0, cam_fix_ok = 0;   /* поражённых кадров и вылеченных */
static uint32_t cam_fix_left = 0;                  /* остались со съехавшими строками */
static uint32_t cam_fix_us = 0;                    /* суммарная цена правки, мкс */
static uint32_t cam_votes_sum = 0;                 /* съехавших строк на поражённых, сумма */

/*
 * Шершавость участка, начиная с ПРОИЗВОЛЬНОГО байтового смещения. Смещение
 * может быть нечётным — в этом и смысл: так проверяется гипотеза «а если бы
 * сюда был вставлен байт», ничего не меняя в данных. Читаем побайтно: по
 * нечётному адресу uint16 брать нельзя.
 */
static float cam_rough_at(const uint8_t *p, int npix, int step)
{
    if (npix < 2 || step < 1) {
        return 0.0f;
    }
    uint32_t acc = 0, n = 0;
    /* СТАРШИЙ БАЙТ ПЕРВЫЙ. Камера кладёт RGB565 именно так, и это не
     * мелочь: при обратном порядке «съехавшими» выглядят 29 кадров из 30,
     * включая заведомо целые, и правка начинает вставлять байты в здоровые.
     * Именно это случилось в первом прогоне v3: 491 «поражённый» кадр из
     * 493, кадр раздулся до 11 КБ, потери чанков 31%. Сдвинутая картинка
     * остаётся гладкой по горизонтали, поэтому шершавость порчи не видела. */
    uint16_t prev = (uint16_t)((p[0] << 8) | p[1]);
    for (int x = step; x < npix; x += step) {
        const uint8_t *q = p + (size_t)x * 2;
        uint16_t cur = (uint16_t)((q[0] << 8) | q[1]);
        int dr = (int)((prev >> 11) & 0x1f) - (int)((cur >> 11) & 0x1f);
        int dg = (int)((prev >>  5) & 0x3f) - (int)((cur >>  5) & 0x3f);
        int db = (int)( prev        & 0x1f) - (int)( cur        & 0x1f);
        acc += (uint32_t)(abs(dr) << 3) + (uint32_t)(abs(dg) << 2)
             + (uint32_t)(abs(db) << 3);
        n += 3;
        prev = cur;
    }
    return n ? (float)acc / (float)n : 0.0f;
}

/*
 * Уверенно ли сдвинутое чтение ровнее обычного. Больше нуля — участок съехал.
 * Запас нужен затем, что на контрастном сюжете обе величины большие и
 * близкие, и сравнение «хоть на сколько-нибудь» вырождается в подбрасывание
 * монеты.
 */
static float cam_shift_gain(const uint8_t *p, int npix, int step, float margin)
{
    float a = cam_rough_at(p, npix, step);
    if (a <= 0.0f) {
        return -1.0f;
    }
    return a * margin - cam_rough_at(p + 1, npix, step);
}

/* Сколько строк уверенно читаются со сдвигом. Это и есть мера порчи кадра. */
static int cam_shift_votes(const camera_fb_t *fb)
{
    const int w = fb->width, h = fb->height;
    int votes = 0;

    for (int y = 0; y < h; y += CAM_REPAIR_ROW) {
        size_t off = (size_t)y * w * 2;
        if (off + (size_t)w * 2 + 2 > fb->len) {
            break;
        }
        if (cam_shift_gain(fb->buf + off, w - 2, CAM_REPAIR_PIX,
                           CAM_REPAIR_MARGIN) > 0.0f) {
            votes++;
        }
    }
    return votes;
}

/* Первая строка, с которой начинается съезд; -1 — таких нет. */
static int cam_transition_row(const camera_fb_t *fb)
{
    const int w = fb->width, h = fb->height;

    for (int y = 0; y < h; y += CAM_REPAIR_ROW) {
        size_t off = (size_t)y * w * 2;
        if (off + (size_t)w * 2 + 2 > fb->len) {
            break;
        }
        if (cam_shift_gain(fb->buf + off, w - 2, CAM_REPAIR_PIX,
                           CAM_REPAIR_MARGIN) <= 0.0f) {
            continue;
        }
        /* Подтверждаем следующей строкой: одиночный выброс не в счёт. */
        int ny = y + CAM_REPAIR_ROW;
        if (ny < h) {
            size_t noff = (size_t)ny * w * 2;
            if (noff + (size_t)w * 2 + 2 <= fb->len &&
                cam_shift_gain(fb->buf + noff, w - 2, CAM_REPAIR_PIX,
                               CAM_REPAIR_MARGIN) <= 0.0f) {
                continue;
            }
        }
        return y;
    }
    return -1;
}

/*
 * Точное смещение потерянного байта: наименьшее НЕЧЁТНОЕ p, с которого
 * сдвинутое чтение начинает выигрывать. Предикат монотонен — до места потери
 * сдвинутое чтение портит участок [p, k) и проигрывает, после k выигрывает,
 * — поэтому годится деление пополам.
 *
 * Широкое окно устойчиво, но у самой границы размывается, и дальше идёт
 * короткий добор мелким окном: промах на сотню байт оставит в кадре полоску
 * неверных пикселей, которая никуда не денется и раздует JPEG. У границы
 * важна точность, а не уверенность, поэтому запас здесь 1.0.
 */
static long cam_find_k(const camera_fb_t *fb, long lo, long hi)
{
    const int w = fb->width;
    const uint8_t *buf = fb->buf;
    long guard = (long)fb->len - (long)w * 2 - 4;

    if (guard < 2) {
        return -1;
    }
    lo |= 1;
    hi |= 1;
    if (hi > guard) {
        hi = guard | 1;
    }
    if (hi <= lo) {
        return -1;
    }
    if (cam_shift_gain(buf + hi, w, 1, 1.0f) >= 0.0f) {
        return -1;                       /* выше по кадру чище не становится */
    }

    long a = lo, b = hi;
    while (a + 2 < b) {
        long m = ((a + b) / 2) | 1;
        if (m <= a) {
            break;
        }
        if (cam_shift_gain(buf + m, w, 1, 1.0f) < 0.0f) {
            b = m;
        } else {
            a = m + 2;
        }
    }

    long start = b - (long)CAM_REPAIR_FINE * 8;
    if (start < lo) {
        start = lo;
    }
    start |= 1;
    for (long q = start; q <= b; q += 2) {
        if (cam_shift_gain(buf + q, CAM_REPAIR_FINE, 1, 1.0f) < 0.0f) {
            return q;
        }
    }
    return b;
}

/*
 * Чинит кадр на месте. Возвращает шершавость после правки.
 *
 * Критерий приёмки структурный: считается не «сколько шершавости», а «сколько
 * строк лежит не на своей сетке». Такая мера не зависит ни от сюжета, ни от
 * освещения — именно поэтому здесь нет ни одного абсолютного порога.
 */
static float cam_repair_slip(camera_fb_t *fb, float before)
{
    if (!fb || fb->format != PIXFORMAT_RGB565 || fb->width < 8 || !fb->buf) {
        return before;
    }
    const int w = fb->width;
    uint8_t *buf = fb->buf;

    int votes = cam_shift_votes(fb);
    if (votes == 0) {
        return before;                   /* кадр цел, не трогаем вовсе */
    }
    cam_fix_try++;
    cam_votes_sum += (uint32_t)votes;
    uint32_t t_fix0 = micros();

    for (int pass = 0; pass < CAM_REPAIR_MAX; pass++) {
        int r = cam_transition_row(fb);
        if (r < 0) {
            break;
        }
        long lo = (long)(r - 2) * w * 2;
        if (lo < 0) {
            lo = 0;
        }
        long k = cam_find_k(fb, lo, (long)(r + 3) * w * 2);
        if (k < 0 || (size_t)k + 1 >= fb->len) {
            break;
        }

        float rough_before = cam_roughness(fb);
        uint8_t lost   = buf[fb->len - 1];
        uint8_t filler = buf[k];
        memmove(buf + k + 1, buf + k, fb->len - (size_t)k - 1);
        buf[k] = filler;

        int   nv          = cam_shift_votes(fb);
        float rough_after = cam_roughness(fb);

        /* Оба условия относительные: съехавших строк стало меньше И кадр не
         * стал грубее. Второе страхует от «починки», которая переставляет
         * порчу с места на место. */
        if (nv >= votes || rough_after > rough_before * 1.1f + 0.5f) {
            memmove(buf + k, buf + k + 1, fb->len - (size_t)k - 1);
            buf[fb->len - 1] = lost;     /* откат точный, байт в байт */
            break;
        }
        votes = nv;
        if (votes == 0) {
            break;
        }
    }

    /* Считаем по тому же, чем чинили: ноль съехавших строк — кадр вылечен.
     * Никаких «стало меньше»: именно такой счётчик врал в версии 1, показывая
     * «408 удачных из 590» на кадрах, которые она портила. */
    if (votes == 0) {
        cam_fix_ok++;
    } else {
        cam_fix_left++;
    }
    cam_fix_us += micros() - t_fix0;
    return cam_roughness(fb);
}

/*
 * ДИАГНОСТИКА «ШТОРКА» (26.09). КОГДА РОЖДАЕТСЯ СЛИП?
 *
 * Известно: слип зависит от мощности передатчика. На 1 дБм 0 поражённых из
 * 720 кадров, на 20 дБм 44% — при прочих равных. Значит это наводка от
 * собственного радио на шлейф камеры. Железо не трогаем, лечить только кодом.
 *
 * Неизвестно: КОГДА она бьёт. Если во время считывания кадра с сенсора — то
 * кадр достаточно снимать, пока модуль молчит, и разнос захвата и передачи
 * во времени решит задачу. Если наводка портит сенсор как-то иначе (скажем,
 * его настройки по SCCB), тишина в эфире не поможет, и строить разнос незачем.
 *
 * Опыт: передача и тишина чередуются. В тишине кадры снимаются и сжимаются как
 * обычно — путь захвата тот же, — но в модуль не уходят. Слип считается по
 * съехавшим строкам ДО правки, раздельно по фазам. Начало каждой фазы не
 * считается: после остановки модуль ещё дошлёт кольцо и повторы, а драйвер
 * камеры держит в буферах кадры, снятые раньше.
 *
 * Связь в тишине не падает: RESTREAM_ON_HELLO_LOSS 0, а приёмник шлёт отчёт по
 * таймеру раз в секунду. Наш модуль на них отвечает только короткими ACK.
 *
 *   в тишине чисто, при передаче слип  -> строим разнос во времени;
 *   слип и в тишине                    -> механизм другой, разнос не поможет.
 */
#define SHUTTER_TEST      0   /* 28.09: ответ получен, см. журнал; шаг 1 — замер задержки */
#define SHUTTER_ON_MS     5000   /* фаза передачи целиком */
#define SHUTTER_OFF_MS    5000   /* фаза тишины целиком */
#define SHUTTER_SETTLE_MS 700    /* начало фазы не считается */

#if SHUTTER_TEST
enum { SH_ON_SETTLE = 0, SH_ON, SH_OFF_SETTLE, SH_OFF };
static volatile uint8_t  sh_state = SH_ON_SETTLE;
static uint32_t          sh_t0 = 0;
static bool              sh_started = false;
/* [0] — передача, [1] — тишина */
static volatile uint32_t sh_n[2]     = { 0, 0 };  /* кадров измерено */
static volatile uint32_t sh_bad[2]   = { 0, 0 };  /* из них со сдвигом */
static volatile uint32_t sh_votes[2] = { 0, 0 };  /* сумма съехавших строк */
static uint32_t          sh_cycles   = 0;
/* Гистограмма по времени внутри фазы: [фаза][интервал по SH_HIST_MS]. Фаза
 * отсчитывается от начала переходного участка, последний интервал копит всё
 * позже (фаза длится 5 с, запас на задержки опроса). */
#define SH_HIST_MS   500
#define SH_HIST_BINS 12
static volatile uint32_t sh_hn[2][SH_HIST_BINS];
static volatile uint32_t sh_hb[2][SH_HIST_BINS];
static uint32_t          sh_hist_print = 0;

static void shutter_tick(void)
{
    uint32_t now = millis();
    if (!sh_started) {
        sh_started = true;
        sh_t0 = now;
        sh_state = SH_ON_SETTLE;
        return;
    }
    uint32_t dt = now - sh_t0;
    switch (sh_state) {
        case SH_ON_SETTLE:
            if (dt >= SHUTTER_SETTLE_MS) sh_state = SH_ON;
            break;
        case SH_ON:
            if (dt >= SHUTTER_ON_MS) { sh_state = SH_OFF_SETTLE; sh_t0 = now; }
            break;
        case SH_OFF_SETTLE:
            if (dt >= SHUTTER_SETTLE_MS) sh_state = SH_OFF;
            break;
        default:
            if (dt >= SHUTTER_OFF_MS) { sh_state = SH_ON_SETTLE; sh_t0 = now; sh_cycles++; }
            break;
    }
}

/* Зовётся из захвата: кадр только что отдан драйвером, правка ещё не трогала. */
static void shutter_account(const camera_fb_t *fb)
{
    uint8_t st = sh_state;
    int v  = cam_shift_votes(fb);

    /* Гистограмма по времени от начала фазы, переходный участок включён.
     * Прогон 28.09 дал в тишине 30 % кадров со сдвигом при 84 % в передаче:
     * если сдвиг в тишине затухает к концу фазы — это хвост передачи, и разнос
     * во времени сработает при паузе длиннее хвоста; если ровный — источник
     * другой. */
    int hph = (st >= SH_OFF_SETTLE) ? 1 : 0;
    uint32_t bin = (millis() - sh_t0) / SH_HIST_MS;
    if (bin >= SH_HIST_BINS) bin = SH_HIST_BINS - 1;
    sh_hn[hph][bin]++;
    if (v > 0) sh_hb[hph][bin]++;

    if (st != SH_ON && st != SH_OFF) {
        return;                              /* переходный участок — не в счёт */
    }
    int ph = (st == SH_OFF) ? 1 : 0;
    sh_n[ph]++;
    sh_votes[ph] += (uint32_t)v;
    if (v > 0) {
        sh_bad[ph]++;
    }
}
#endif

/*
 * 25.09. САМОПРОВЕРКА ПРИ СТАРТЕ ВРЁТ — она мерит первые кадры сразу после
 * инициализации, а слип к этому моменту ещё держится и уходит позже. Живой
 * замер через tools/frame_check.py дал медиану 1.98 и 1.3% поражённых там, где
 * стартовая проверка кричала 17.04 и «ЗАХВАТ ИСПОРЧЕН». Из-за этого мы полночи
 * считали прогоны негодными, а они были хороши.
 *
 * Поэтому меряем ЕЩЁ И ПО ХОДУ, на тех самых кадрах, что уходят в эфир: каждый
 * CAM_LIVE_EVERY-й кадр считаем шершавость и копим долю поражённых. Числа идут
 * в строку статистики, то есть попадают в лог каждого прогона.
 */
#define CAM_LIVE_EVERY 8        /* считать каждый N-й кадр: замер дешёвый, но не даровой */

static uint32_t cam_live_n = 0, cam_live_bad = 0;
static float    cam_live_sum = 0.0f, cam_live_last = 0.0f;

/* Вердикт последней самопроверки — чтобы его было видно и снаружи. */
static float   cam_check_value = 0.0f;
static bool    cam_check_clean = true;
static uint8_t cam_check_tries = 0;

static bool camera_init(void)
{
    camera_config_t config;

    /*
     * Затыкаем лог драйвера камеры В РАНТАЙМЕ, а не флагом сборки.
     *
     * 14.08: CORE_DEBUG_LEVEL=0 на cam_hal не действует — он приходит готовой
     * скомпилированной библиотекой в составе фреймворка, и уровень в ней уже
     * зашит. А печатает он из cam_task, у которой маленький стек: первое же
     * сообщение EV-VSYNC-OVF валит плату по Stack canary watchpoint. То есть
     * не переполнение захвата само по себе роняет плату, а попытка о нём
     * сообщить. Гасим — и переполнение становится тем, чем должно быть:
     * потерянным кадром, а не перезагрузкой.
     */
    esp_log_level_set("cam_hal", ESP_LOG_NONE);
    esp_log_level_set("s3 ll_cam", ESP_LOG_NONE);

    memset(&config, 0, sizeof(config));
    config.ledc_channel = LEDC_CHANNEL_0;
    config.ledc_timer = LEDC_TIMER_0;
    config.pin_d0 = CAMERA_PIN_Y2;
    config.pin_d1 = CAMERA_PIN_Y3;
    config.pin_d2 = CAMERA_PIN_Y4;
    config.pin_d3 = CAMERA_PIN_Y5;
    config.pin_d4 = CAMERA_PIN_Y6;
    config.pin_d5 = CAMERA_PIN_Y7;
    config.pin_d6 = CAMERA_PIN_Y8;
    config.pin_d7 = CAMERA_PIN_Y9;
    config.pin_xclk = CAMERA_PIN_XCLK;
    config.pin_pclk = CAMERA_PIN_PCLK;
    config.pin_vsync = CAMERA_PIN_VSYNC;
    config.pin_href = CAMERA_PIN_HREF;
    config.pin_sccb_sda = CAMERA_PIN_SIOD;
    config.pin_sccb_scl = CAMERA_PIN_SIOC;
    config.pin_pwdn = CAMERA_PIN_PWDN;
    config.pin_reset = CAMERA_PIN_RESET;
    config.xclk_freq_hz = CAM_XCLK_HZ;
    config.pixel_format = PIXFORMAT_RGB565;
    config.frame_size = FRAME_SIZE;

    SerialMon.printf("PSRAM: %s\n", psramFound() ? "есть" : "нет");
    if (psramFound()) {
        // ТРИ буфера, а не два. Причина (13.08): при fb_count=2 и GRAB_LATEST,
        // пока мы держим один буфер на время frame2jpg, драйверу остаётся
        // ровно один — и он может отдать кадр, в который прямо сейчас пишет
        // DMA. На картинке это выглядит как полосы цветного мусора поперёк
        // кадра при полностью целом транспорте (crc_err=0, потери 0.5%).
        // Третий буфер даёт сенсору куда писать, пока два других заняты.
        // HQVGA RGB565 = 84 КБ на буфер, в PSRAM это ничто.
        /*
         * Три буфера.
         *
         * 26.08 поднимал до пяти, подозревая, что драйвер отдаёт кадр, в который
         * DMA ещё дописывает строки. Проверка сырых кадров эту версию закрыла:
         * выгрузили кадры по USB (DUMP_RAW) и разобрали на ПК — строки целы,
         * разрывов нет, CRC сырого кадра сходится, JPEG с платы совпадает с
         * картинкой, собранной на ПК из тех же байт. РВАНИ НЕТ ВООБЩЕ.
         *
         * То, что мы называли радугой, оказалось искажением ЦВЕТА, а не потерей
         * строк, и к буферам захвата отношения не имеет. Возвращаю три.
         */
        /*
         * 15.09: всё, что написано выше про три буфера, — про PSRAM, где
         * 84 КБ ничего не стоят. При CAM_FB_IN_DRAM буфер живёт во внутренней
         * памяти, каждый стоит дорого, и берём мы два: пока мы 36 мс сжимаем
         * кадр из одного, сенсор пишет следующий во второй.
         */
#if CAM_FB_IN_DRAM
        config.fb_count = 2;
        config.fb_location = CAMERA_FB_IN_DRAM;
#else
        /* 29.09: при двух кодировщиках четыре — два держат они, см. ENC_WORKERS. */
        config.fb_count = (ENC_WORKERS > 1) ? 4 : 3;
        config.fb_location = CAMERA_FB_IN_PSRAM;
#endif
        // GRAB_WHEN_EMPTY, а не GRAB_LATEST. 13.08: на LATEST картинка шла с
        // радужным мусором ниже некоторой строки при полностью целом
        // транспорте (crc_err=0). Радужный шум — это не искажение картинки, а
        // сырой мусор вместо пикселей: JPEG честно кодирует буфер, в который
        // DMA ещё не дописал кадр. LATEST отдаёт самый свежий буфер, не
        // дожидаясь конца записи; WHEN_EMPTY отдаёт только дописанные.
        // Плата за это — задержка: кадр будет чуть старее.
        config.grab_mode = CAMERA_GRAB_WHEN_EMPTY;
    } else {
        config.fb_count = 1;
        config.grab_mode = CAMERA_GRAB_WHEN_EMPTY;
        config.fb_location = CAMERA_FB_IN_DRAM;
        config.frame_size = FRAMESIZE_QQVGA;
    }

    esp_err_t err = esp_camera_init(&config);
#if CAM_FB_IN_DRAM
    /*
     * Два буфера по 84 КБ во внутренней памяти — это впритык, и сколько её
     * останется, зависит от того, что успел занять фреймворк. Не хватило —
     * переспрашиваем один, вместо того чтобы оставлять плату без камеры.
     * С одним буфером сенсору придётся ждать, пока мы отпустим кадр: кадров
     * станет меньше, но рвани не будет, потому что WHEN_EMPTY отдаёт только
     * дописанные кадры.
     */
    if (err == ESP_ERR_NO_MEM && config.fb_count > 1) {
        SerialMon.printf("Камера: на %d буфера во внутренней памяти не хватило, "
                         "беру один\n", config.fb_count);
        config.fb_count = 1;
        err = esp_camera_init(&config);
    }
#endif
    if (err != ESP_OK) {
        SerialMon.printf("Камера не поднялась, ошибка 0x%x\n", err);
        snprintf(cam_info, sizeof(cam_info), "НЕ НАЙДЕНА (0x%x)", err);
        return false;
    }

    sensor_t *s = esp_camera_sensor_get();
    camera_sensor_info_t *info = s ? esp_camera_sensor_get_info(&(s->id)) : NULL;
    const char *name = info ? info->name : "?";
    SerialMon.printf("Сенсор: %s (PID 0x%x)\n", name, s ? s->id.PID : 0);
    if (s && s->id.PID == OV5640_PID) {
        s->set_vflip(s, 1);
#if CAM_PCLK_DIV > 1
        /*
         * Системный делитель сенсора — см. CAM_PCLK_DIV. Поле четыре бита,
         * ноль в нём означает 16, поэтому разбираем его руками.
         *
         * 15.09, ценой одного цикла заливки. Указатели проверяем ЯВНО:
         * sensor_t — таблица функций, и у части драйверов часть ячеек пустая.
         * Вызов по нулю здесь стоил МОЛЧАЛИВОЙ платы, а не падения с трассой:
         * Serial это USB-Serial/JTAG, напечатанное лежит в кольце и
         * выгребается прерыванием, при панике кольцо не выгребается — весь лог
         * загрузки исчезает (то же, из-за чего ниже стоит halow_mon_settle).
         * Порт при этом остаётся в системе, потому что USB-Serial/JTAG живёт
         * в железе и программный сброс его не роняет. Снаружи это выглядит
         * как «плата залита, но молчит», и отличить от севшего питания нельзя.
         *
         * Поэтому кольцо выталкиваем ДО того, как трогать сенсор: если
         * следующая строка всё же уронит плату, всё предыдущее уже на экране.
         */
        halow_mon_settle();
        if (!s->get_reg || !s->set_reg) {
            SerialMon.printf("PCLK: драйвер сенсора не даёт доступа к регистрам, "
                             "делитель не тронут\n");
        } else {
            int reg_was = s->get_reg(s, 0x3035, 0xFF);
            if (reg_was < 0) {
                SerialMon.printf("PCLK: регистр 0x3035 не читается (%d), делитель не тронут\n",
                                 reg_was);
            } else {
                int div_was = (reg_was >> 4) & 0x0F;
                if (div_was == 0) {
                    div_was = 16;
                }
                int div_want = div_was * CAM_PCLK_DIV;
                if (div_want > 15) {
                    SerialMon.printf("PCLK: делитель уже %d, умножать на %d некуда (поле 4 бита)\n",
                                     div_was, CAM_PCLK_DIV);
                } else {
                    s->set_reg(s, 0x3035, 0xF0, (div_want & 0x0F) << 4);
                    int reg_now = s->get_reg(s, 0x3035, 0xFF);
                    SerialMon.printf("PCLK: 0x3035 было 0x%02x, стало 0x%02x, делитель %d -> %d\n",
                                     reg_was, reg_now, div_was, div_want);
                }
            }
        }
        halow_mon_settle();
#endif
#if CAM_PLL_MUL > 0
        /* Такт сенсора — см. CAM_PLL_MUL. Указатели проверяем явно, как выше. */
        halow_mon_settle();
        if (!s->set_pll || !s->get_reg) {
            SerialMon.println("PLL: драйвер сенсора не даёт set_pll/get_reg — такт не тронут");
        } else if (!cam_pll_fast) {
            SerialMon.println("PLL: опыт держит такт драйвера — не трогаю");
        } else {
            static const int pll_regs[] = { 0x3034, 0x3035, 0x3036, 0x3037, 0x3108, 0x3824, 0x460C };
            char was[48], now[48];
            int nw = 0, nn = 0;
            for (unsigned i = 0; i < sizeof(pll_regs) / sizeof(pll_regs[0]); i++) {
                nw += snprintf(was + nw, sizeof(was) - nw, " %02x", s->get_reg(s, pll_regs[i], 0xFF) & 0xFF);
            }
            /* bypass 0, множитель, sys_div 1, root_2x 0, pre_div 1, pclk_root_div 1,
             * ручной PCLK, делитель PCLK — как драйвер для кадров меньше QVGA. */
            int rc = s->set_pll(s, 0, CAM_PLL_MUL, 1, 0, 1, 1, 1, CAM_PLL_PCLK_DIV);
            for (unsigned i = 0; i < sizeof(pll_regs) / sizeof(pll_regs[0]); i++) {
                nn += snprintf(now + nn, sizeof(now) - nn, " %02x", s->get_reg(s, pll_regs[i], 0xFF) & 0xFF);
            }
            SerialMon.printf("PLL: 3034 3035 3036 3037 3108 3824 460C было%s, стало%s "
                             "(set_pll=%d, множитель %d, делитель PCLK %d)\n",
                             was, now, rc, (int)CAM_PLL_MUL, (int)CAM_PLL_PCLK_DIV);
        }
        halow_mon_settle();
#endif
    }

#if VSYNC_PROBE
    vs_probe_attach();
#endif
#if CAM_VSYNC_FILTER
    {
        unsigned thr0 = LCD_CAM.cam_ctrl.cam_vsync_filter_thres;
        unsigned en0 = LCD_CAM.cam_ctrl1.cam_vsync_filter_en;
        LCD_CAM.cam_ctrl.cam_vsync_filter_thres = CAM_VSYNC_FILTER;
        LCD_CAM.cam_ctrl1.cam_vsync_filter_en = 1;
        SerialMon.printf("VSYNC: фильтр LCD_CAM было порог %u вкл %u, стало порог %u вкл %u\n",
                         thr0, en0, (unsigned)LCD_CAM.cam_ctrl.cam_vsync_filter_thres,
                         (unsigned)LCD_CAM.cam_ctrl1.cam_vsync_filter_en);
    }
#endif
    /* Сила выходов — см. CAM_DRIVE. Перезапуск драйвера возвращает ×4, поэтому
     * ставим то, что стояло до него (опыт мог сменить). */
    {
        uint8_t d = cam_drv_now ? cam_drv_now : (uint8_t)CAM_DRIVE;
        if (d) {
            cam_drv_apply(d, true);
        }
    }
#if CAM_SIG_COUNT
    sig_init();
#endif
    SerialMon.printf("Буфер захвата: %s, %d шт\n",
#if CAM_FB_IN_DRAM
                     "внутренняя память",
#else
                     "PSRAM",
#endif
                     config.fb_count);

    snprintf(cam_info, sizeof(cam_info), "%s %s RGB565->JPEG",
             name, fs_name(config.frame_size));
    SerialMon.printf("Режим камеры: %s\n", cam_info);
#if CAM_CHECK_ON
    cam_check_value = cam_sample_roughness();
    cam_check_clean = (cam_check_value <= CAM_CHECK_THRESHOLD);
    SerialMon.printf("Самопроверка захвата: шершавость %.2f (порог %.1f) — %s\n",
                     cam_check_value, (double)CAM_CHECK_THRESHOLD,
                     cam_check_clean ? "ЧИСТО" : "БАЙТОВЫЙ СЛИП");
    if (!cam_check_clean) {
        if (cam_check_tries < CAM_CHECK_TRIES) {
            cam_check_tries++;
            SerialMon.printf("  переинициализация камеры, попытка %u из %u\n",
                             (unsigned)cam_check_tries, (unsigned)CAM_CHECK_TRIES);
            esp_camera_deinit();
            delay(200);
            return camera_init();       /* глубина ограничена cam_check_tries */
        }
        SerialMon.printf("!!!! ЗАХВАТ ИСПОРЧЕН, %u попыток исчерпано !!!!\n"
                         "Кадры раздуты примерно вдвое, картинка в цветных полосах.\n"
                         "ПРОГОН НЕПРИГОДЕН ДЛЯ СРАВНЕНИЯ С ДРУГИМИ.\n",
                         (unsigned)CAM_CHECK_TRIES);
    }
#endif
    return true;
}

//************************************[ ARDUINO ]****************************************

/*
 * СТОРОЖ КАМЕРЫ (30.09): 0 — нет, N — после N пустых esp_camera_fb_get подряд
 * (каждый ждёт кадр 4 с) перезапустить драйвер камеры.
 *
 * Зачем. 30.09 утром (перебор var0930rs) камера после загрузки отдала четыре
 * кадра, снятых ещё в стартовом окне (15–30 с назад), и больше ни одного —
 * все 5 минут опыта впустую, при живой связи и нормальном питании (3,27 В).
 * Похоже на известную беду драйвера на S3 в режиме GRAB_WHEN_EMPTY: пока
 * передача не началась, все буферы полны и захват стоит, а после их возврата
 * иногда так и не возобновляется. Раньше случалось изредка (29.09 14:01 —
 * тоже 0 к/с в первом включении). Для борта это вообще обязательно: камера,
 * молча вставшая в полёте, без сторожа не оживёт до посадки.
 */
#define CAM_WATCHDOG  2
/* 06.10 ночь: столько перезапусков драйвера подряд без единого кадра — и ESP
 * перезагружается целиком. 22:18 три перезапуска подряд не вернули ни кадра (сенсор
 * при каждом сбрасывался по RESET), а снятие питания вернуло. 0 — не перезагружать. */
#define CAM_REBOOT_AFTER 2
#if CAM_WATCHDOG
static uint32_t cam_null_streak = 0;   /* пустых захватов подряд (под cap_mutex) */
static uint32_t cam_reinits = 0;
static uint32_t cam_reinit_streak = 0;   /* перезапусков подряд без единого кадра */
#endif

/*
 * Снять кадр и сжать его. Вынесено из loop() отдельной функцией, потому что
 * при PIPELINE этим занимается своя задача на другом ядре.
 * Возвращает true и указатель на JPEG, который вызывающий обязан освободить.
 */
#if NEW_JPEG
/* Сжатие кадра RGB565 через esp_new_jpeg — см. NEW_JPEG. Результат — в malloc, как у
 * fmt2jpg: освобождает отправитель. Индекс экземпляра — ядро вызывающей задачи. */
#define NJ_OUT_CAP (96 * 1024)
static jpeg_enc_handle_t nj_enc[2] = { NULL, NULL };
static uint8_t  nj_q[2], *nj_out[2] = { NULL, NULL }, *nj_in[2] = { NULL, NULL };
static uint16_t nj_w[2], nj_h[2];
static size_t   nj_in_cap[2];
static uint32_t nj_fail = 0, nj_unaligned = 0;

static bool nj_encode(const uint8_t *src, size_t len, uint16_t w, uint16_t h, uint8_t q,
                      uint8_t **out, size_t *out_len)
{
    const int k = xPortGetCoreID() ? 1 : 0;
    if (nj_enc[k] && (nj_w[k] != w || nj_h[k] != h)) {
        jpeg_enc_close(nj_enc[k]);
        nj_enc[k] = NULL;
    }
    if (!nj_enc[k]) {
        jpeg_enc_config_t cfg = DEFAULT_JPEG_ENC_CONFIG();
        cfg.width = w;
        cfg.height = h;
        cfg.src_type = JPEG_PIXEL_FORMAT_RGB565_BE;
        cfg.subsampling = JPEG_SUBSAMPLE_420;
        cfg.quality = q;
        cfg.rotate = JPEG_ROTATE_0D;
        cfg.task_enable = false;
        jpeg_error_t rc = jpeg_enc_open(&cfg, &nj_enc[k]);
        if (rc != JPEG_ERR_OK || !nj_enc[k]) {
            nj_enc[k] = NULL;
            nj_fail++;
            SerialMon.printf("NEWJPEG: открыть кодировщик не вышло (%d)\n", (int)rc);
            return false;
        }
        nj_w[k] = w;
        nj_h[k] = h;
        nj_q[k] = q;
        SerialMon.printf("NEWJPEG: кодировщик на ядре %d открыт, %ux%u, Q%u, вход %s\n",
                         k, (unsigned)w, (unsigned)h, (unsigned)q,
                         ((uintptr_t)src & 15) ? "НЕ выровнен — копирую" : "выровнен");
    }
    if (nj_q[k] != q) {
        jpeg_enc_set_quality(nj_enc[k], q);
        nj_q[k] = q;
    }
    if ((uintptr_t)src & 15) {
        if (nj_in_cap[k] < len) {
            if (nj_in[k]) {
                jpeg_free_align(nj_in[k]);
            }
            nj_in[k] = (uint8_t *)jpeg_calloc_align(len, 16);
            nj_in_cap[k] = nj_in[k] ? len : 0;
        }
        if (!nj_in[k]) {
            nj_fail++;
            return false;
        }
        memcpy(nj_in[k], src, len);
        src = nj_in[k];
        nj_unaligned++;
    }
    if (!nj_out[k]) {
        nj_out[k] = (uint8_t *)heap_caps_malloc(NJ_OUT_CAP, MALLOC_CAP_SPIRAM | MALLOC_CAP_8BIT);
        if (!nj_out[k]) {
            nj_fail++;
            return false;
        }
    }
    int got = 0;
    jpeg_error_t rc = jpeg_enc_process(nj_enc[k], src, (int)len, nj_out[k], NJ_OUT_CAP, &got);
    if (rc != JPEG_ERR_OK || got <= 0) {
        nj_fail++;
        return false;
    }
    uint8_t *j = (uint8_t *)malloc((size_t)got);
    if (!j) {
        nj_fail++;
        return false;
    }
    memcpy(j, nj_out[k], (size_t)got);
    *out = j;
    *out_len = (size_t)got;
    return true;
}
#endif

static bool captureFrame(uint8_t **out_jpg, size_t *out_len, uint32_t *out_cap_ms,
                         uint32_t *out_seq = NULL)
{
    /*
     * 27.08: «курицы с яйцом» здесь нет, и прежний вывод отменён.
     *
     * Было: шлём независимо от link_up, потому что приёмнику якобы не о чем
     * отчитываться, пока поток не пошёл. Это неверно — приёмник шлёт свой 'S'
     * раз в секунду безусловно (HalowVideoP2P_AP, sendStat в loop), ему наш
     * поток для этого не нужен. Значит первый 'S' можно дождаться, ничего не
     * передавая, и он же будет доказательством ассоциации.
     *
     * Гейт стоит выше по течению: сюда управление не доходит, пока tx_enabled
     * ложно (WAIT_FOR_HELLO). Здесь остаётся только съёмка.
     */
#if ENC_WORKERS > 1
    if (cap_mutex) {
        xSemaphoreTake(cap_mutex, portMAX_DELAY);   /* захват по одному */
    }
#endif
    uint32_t t_cam0 = millis();
    camera_fb_t *fb = esp_camera_fb_get();
    uint32_t t_cam1 = millis();
    uint32_t t_copy1 = t_cam1;
#if CAM_WATCHDOG
    if (fb) {
        cam_null_streak = 0;
        cam_reinit_streak = 0;
    } else if (++cam_null_streak >= CAM_WATCHDOG) {
        /* Сенсор встал, см. CAM_WATCHDOG. Замок захвата у нас — второй
         * кодировщик ждёт его и камеру не тронет; буферов на руках нет:
         * кадров не было уже несколько секунд. */
        cam_null_streak = 0;
        cam_reinits++;
#if CAM_SIG_COUNT
        SerialMon.printf("КАМЕРА: сигналы сенсора за прошлый период — VSYNC %d, HREF %d\n",
                         (int)sig_vs_last, (int)sig_hr_last);
#endif
#if CAM_REBOOT_AFTER
        if (++cam_reinit_streak > CAM_REBOOT_AFTER) {
            SerialMon.printf("КАМЕРА: %u перезапуска драйвера подряд не вернули кадр — "
                             "ПЕРЕЗАГРУЗКА ESP\n", (unsigned)CAM_REBOOT_AFTER);
            delay(1500);               /* дать логу уйти по воздуху */
            esp_restart();
        }
#endif
        SerialMon.printf("КАМЕРА: %u раз подряд нет кадра (по 4 с) — перезапуск драйвера\n",
                         (unsigned)CAM_WATCHDOG);
        esp_camera_deinit();
        delay(200);
        camera_ok = camera_init();
        SerialMon.printf("КАМЕРА: перезапуск %s, всего %lu\n",
                         camera_ok ? "удался" : "НЕ УДАЛСЯ", (unsigned long)cam_reinits);
    }
#endif
    if (!fb) {
#if ENC_WORKERS > 1
        if (cap_mutex) {
            xSemaphoreGive(cap_mutex);
        }
#endif
        return false;
    }
    cam_cache_fresh(fb);               /* см. «КЭШ И КАДР» */
    *out_cap_ms = fb_start_ms(fb);     /* для замера задержки, см. lat_on_ack */
#if GATED_CAPTURE
    if (!gate_frame_clean(*out_cap_ms)) {
        /* Снят, пока модуль передавал, — назад драйверу, не сжимая. */
        cam_fb_give(fb);
#if ENC_WORKERS > 1
        if (cap_mutex) {
            xSemaphoreGive(cap_mutex);
        }
#endif
        return false;
    }
#endif
    {
        uint32_t seq = ++cap_seq;
        if (out_seq) {
            *out_seq = seq;
        }
    }

#if CAM_CHECK_ON
    /* Живой контроль захвата — на кадре, который сейчас уйдёт в эфир. */
    /* 25.09: проверяем и правим КАЖДЫЙ кадр, а не каждый CAM_LIVE_EVERY-й.
     * Иначе семь кадров из восьми уходили бы в эфир испорченными — для
     * статистики хватило бы выборки, а для картинки нет. Сам замер дёшев:
     * cam_roughness берёт каждую восьмую строку, это ~5 тыс. операций.
     * Дорогая часть — поиск и сдвиг — включается только на поражённых. */
    {
#if SHUTTER_TEST
        shutter_account(fb);
#endif
        cam_live_last = cam_roughness(fb);
#if CAM_REPAIR
        /* Снимаем слип ДО сжатия, чтобы в эфир ушла исправленная картинка, а
         * не исправленная копия. Решает сама правка: целый кадр она узнаёт по
         * нулю съехавших строк и не трогает. Порог здесь больше ни при чём —
         * на нём погорели версии 1 и 2. */
        cam_live_last = cam_repair_slip(fb, cam_live_last);
#endif
        cam_live_sum += cam_live_last;
        cam_live_n++;
        if (cam_live_last > CAM_CHECK_THRESHOLD) {
            cam_live_bad++;
        }
    }
#endif

    /* Всё, что понадобится кодировщику, снимаем с fb сразу: при работе из SRAM
     * буфер камеры возвращается ещё ДО сжатия. */
    const uint8_t *src     = fb->buf;
    size_t         src_len = fb->len;
    uint16_t       src_w   = (uint16_t)fb->width;
    uint16_t       src_h   = (uint16_t)fb->height;
#if ENC_WORKERS > 1
    /* Захват и правка слипа позади — сжимать можно параллельно. */
    if (cap_mutex) {
        xSemaphoreGive(cap_mutex);
    }
#endif

#if ENCODE_FROM_SRAM
    if (sram_frame && src_len <= sram_frame_cap) {
        // Одно чтение 84 КБ подряд вместо шестидесяти миллисекунд доступа
        // вразнобой — ровно ради этого всё и затевалось.
        memcpy(sram_frame, fb->buf, src_len);
        src = sram_frame;
        t_copy1 = millis();
#if CHECK_COPY
        if (big_crc(fb->buf, src_len) != big_crc(sram_frame, src_len)) {
            copy_torn++;        // в буфер писали, пока мы его читали
        }
        copy_checked++;
#endif
    } else {
        enc_from_psram++;       // буфера нет — сжимаем из PSRAM, как раньше
    }
#endif

#if CHECK_FB
    uint16_t crc_before = big_crc(fb->buf, fb->len);
#endif
#if DUMP_RAW
    bool dump_now = (++dump_counter % DUMP_EVERY == 0);
#endif

    /* Кадр камере больше не нужен — кодировщик работает с копией. Отдаём сразу,
     * чтобы у драйвера всегда был свободный буфер под следующий кадр.
     * Диагностикам ниже нужен исходный буфер, поэтому при них держим до конца,
     * как раньше. */
#if ENCODE_FROM_SRAM && !CHECK_FB && !CHECK_ENCODER && !DUMP_RAW
    if (src == sram_frame) {
        cam_fb_give(fb);
        fb = NULL;
    }
#endif

    uint8_t *jpg = NULL;
    size_t jpg_len = 0;
#if NEW_JPEG
    bool ok = nj_encode(src, src_len, src_w, src_h, jpeg_q_rt, &jpg, &jpg_len);
#else
    bool ok = fmt2jpg((uint8_t *)src, src_len, src_w, src_h, PIXFORMAT_RGB565,
                      jpeg_q_rt, &jpg, &jpg_len);
#endif
    uint32_t t_jpeg1 = millis();

#if DUMP_RAW
    /*
     * Выгружаем ПАРУ: сырой кадр и сделанный из него JPEG, подряд и до
     * возврата буфера камере. Раз это один и тот же кадр, сравнение картинок
     * на ПК даёт прямой ответ, портит ли кодировщик: BMP чистый при рваном
     * JPEG означает, что виноват frame2jpg, и больше некому.
     */
    if (dump_now) {
        dumpRawFrame(fb);
#if DUMP_JPEG
        if (ok) {
            dumpJpegFrame(jpg, jpg_len);
        }
#endif
    }
#endif
#if CHECK_FB
    uint16_t crc_after = big_crc(fb->buf, fb->len);
    if (crc_before != crc_after) {
        fb_torn++;
    }
    fb_checked++;
#endif
#if CHECK_ENCODER
    if (ok) {
        uint8_t *jpg2 = NULL;
        size_t jpg2_len = 0;
        if (fmt2jpg((uint8_t *)src, src_len, src_w, src_h, PIXFORMAT_RGB565,
                    jpeg_q_rt, &jpg2, &jpg2_len)) {
            bool same = (jpg2_len == jpg_len) &&
                        (halow_crc16(jpg, (uint16_t)min((size_t)60000, jpg_len)) ==
                         halow_crc16(jpg2, (uint16_t)min((size_t)60000, jpg2_len)));
            if (!same) {
                enc_diff++;
            }
            free(jpg2);
        }
        enc_checked++;
    }
#endif
    if (fb) {
        cam_fb_give(fb);
    }

    if (!ok) {
        return false;
    }

    *out_jpg = jpg;
    *out_len = jpg_len;
#if ENC_WORKERS > 1
    portENTER_CRITICAL(&enc_stat_mux);
#endif
    cam_ms_acc  += (t_cam1 - t_cam0);
    copy_ms_acc += (t_copy1 - t_cam1);
    jpeg_ms_acc += (t_jpeg1 - t_copy1);
    cap_frames++;
    cap_all++;
    cam_ms_all += (t_cam1 - t_cam0);
#if ENC_WORKERS > 1
    portEXIT_CRITICAL(&enc_stat_mux);
#endif
    return true;
}

#if PIPELINE
/*
 * КОНВЕЙЕР НА ДВУХ ЯДРАХ.
 *
 * Раньше всё шло по очереди в одном цикле: снять, сжать, передать, снова
 * снять. Пока идёт сжатие, UART простаивает; пока идёт передача, простаивает
 * процессор — он просто ждёт, когда провод пропустит байты. Половина времени
 * каждый узел бездельничал.
 *
 * Теперь захват со сжатием живут отдельной задачей на ядре 0, а передача
 * осталась в loop() на ядре 1. Между ними очередь на пару кадров. Цикл
 * становится не суммой времён, а максимумом из них.
 *
 * Очередь короткая нарочно. Длинная копила бы кадры и растила задержку — для
 * видео это хуже, чем выбросить лишнее. Если передача не успевает, свежий
 * кадр отбрасывается сразу (счётчик pipe_dropped), и на приёмник идёт то, что
 * снято только что, а не десять секунд назад.
 */
typedef struct {
    uint8_t *buf;
    size_t   len;
    uint32_t cap_ms;    /* начало съёмки, для замера задержки */
    uint32_t seq;       /* номер захвата, см. ENC_WORKERS */
} jpg_item_t;

static QueueHandle_t jpg_q = NULL;
static uint32_t pipe_dropped = 0;

static void camera_task(void *arg)
{
    for (;;) {
        /* tx_enabled, а не streaming: пока приёмник не отозвался, снимать и
         * сжимать не для кого. Камера и кодировщик простаивают вместе с
         * передатчиком, и модуль получает тихий UART на всё время ассоциации. */
        if (!camera_ok || !tx_enabled) {
            vTaskDelay(pdMS_TO_TICKS(20));
            continue;
        }
        /*
         * Снимаем ТОЛЬКО когда в очереди есть место. Раньше здесь был цикл без
         * пауз: снял, очередь полна, выбросил, тут же снимаешь следующий. Ядро
         * было занято на сто процентов впустую — кадры выбрасывались сотнями,
         * PSRAM молотила зря, а USB не получал времени даже на то, чтобы
         * принять команду сброса от загрузчика (плата переставала прошиваться).
         *
         * Ждём места, а не выбрасываем. Задержка от этого не растёт: очередь
         * всего на два кадра, значит снятое уедет в ближайшие сотни миллисекунд.
         */
        if (uxQueueSpacesAvailable(jpg_q) == 0) {
            vTaskDelay(pdMS_TO_TICKS(5));
            continue;
        }

#if SYNTH_SOURCE || EXP_PROGRAM
        if (SYNTH_SOURCE || synth_on) {
        if (arg) {
            vTaskDelay(pdMS_TO_TICKS(20));   /* второй кодировщик в синтетике молчит */
            continue;
        }
        /* Синтетический источник, см. SYNTH_SOURCE. Кадр в очереди держим
         * ровно один: канал выбирает его сразу, как только окно откроется, а
         * выбрасывать устаревшие здесь незачем — все кадры одинаковые. */
        {
            static uint8_t *synth_jpg = NULL;
            static size_t   synth_len = 0;
            if (!synth_jpg) {
#if SYNTH_NOCAM
                synth_len = SYNTH_NOCAM_LEN;
                synth_jpg = (uint8_t *)malloc(synth_len);
                if (!synth_jpg) {
                    vTaskDelay(pdMS_TO_TICKS(10));
                    continue;
                }
                uint32_t x = 0x12345678u;
                for (size_t k = 0; k < synth_len; k++) {
                    x = x * 1664525u + 1013904223u;
                    synth_jpg[k] = (uint8_t)(x >> 24);
                }
                synth_jpg[0] = 0xFF;
                synth_jpg[1] = 0xD8;
                synth_jpg[synth_len - 2] = 0xFF;
                synth_jpg[synth_len - 1] = 0xD9;
#else
                uint32_t cap0 = 0;
                if (!captureFrame(&synth_jpg, &synth_len, &cap0)) {
                    vTaskDelay(pdMS_TO_TICKS(10));
                    continue;
                }
#endif
                SerialMon.printf("СИНТЕТИКА: кадр %u Б гоняется по кругу, камера и кодер отключены\n",
                                 (unsigned)synth_len);
            }
            if (uxQueueMessagesWaiting(jpg_q) > 0) {
                vTaskDelay(1);
                continue;
            }
            uint8_t *copy = (uint8_t *)malloc(synth_len);
            if (!copy) {
                vTaskDelay(pdMS_TO_TICKS(5));
                continue;
            }
            memcpy(copy, synth_jpg, synth_len);
            jpg_item_t sit = { copy, synth_len, millis(), ++cap_seq };
            if (xQueueSend(jpg_q, &sit, 0) != pdTRUE) {
                free(copy);
            }
            cap_frames++;
            vTaskDelay(1);
            continue;
        }
        }
#endif

        uint8_t *jpg = NULL;
        size_t   len = 0;
        uint32_t cap_ms = 0;
        uint32_t seq = 0;
        if (!captureFrame(&jpg, &len, &cap_ms, &seq)) {
            vTaskDelay(pdMS_TO_TICKS(10));
            continue;
        }
        jpg_item_t it = { jpg, len, cap_ms, seq };
        if (xQueueSend(jpg_q, &it, 0) != pdTRUE) {
            free(jpg);          // место кончилось между проверкой и отправкой
            pipe_dropped++;
        }
        vTaskDelay(1);          // обязательная уступка: иначе задача не отдаёт ядро
    }
}
#endif

void setup()
{
    /* Первым делом, до инициализации чего бы то ни было. */
    if (dbg_magic != 0x48414C4FUL) {          /* "HALO" — первый запуск после питания */
        dbg_magic = 0x48414C4FUL;
        dbg_boots = 0;
        dbg_maxstage = 0;
    }
    dbg_boots++;
    dbg_reason = (uint32_t)esp_reset_reason();
    dbg_stage = 1;

#if AIR_LOG
    SerialMon.setTxBufferSize(8192);   /* до begin; с хостом — запас на всплески */
#endif
    SerialMon.begin(115200);
    /* Ограничиваем ожидание при записи в USB: нет читателя — запись
     * отбрасывается, но НЕ блокирует главный цикл. Ждать опустошения (flush)
     * нельзя вовсе, см. halow_mon_settle() в halow_stream.h. При AIR_LOG —
     * ноль: камера может жить вовсе без хоста, см. AIR_LOG. */
    SerialMon.setTxTimeoutMs(AIR_LOG ? 0 : 100);
    dbg_stage = 2;
    delay(2000);
    dbg_stage = 3;

    SerialMon.println();
    SerialMon.println("=== T-Halow: камера (STA), прозрачный режим ===");

    // Приёмный буфер побольше стандартных 256 байт: обратный канал редкий, но
    // модуль в стартовом окне вываливает загрузочный лог, и терять его начало
    // из-за переполнения не хочется.
    SerialAT.setRxBufferSize(2048);
    SerialAT.begin(AT_BAUD, SERIAL_8N1, SERIAL_AT_RXD, SERIAL_AT_TXD);
    SerialMon.printf("UART к модулю: %u бод (окно), %u бод (поток)\n",
                     (unsigned)AT_BAUD, (unsigned)P2P_BAUD);

    pinMode(BOARD_LED, OUTPUT);
    halow_p2p_rx_init(&rx);
    memset(&peer, 0, sizeof(peer));

#if SYNTH_NOCAM
    camera_ok = true;          /* дальше камеру не трогает никто, кроме синтетики */
    SerialMon.println("SYNTH_NOCAM: камера не запускается, кадр синтетики — из памяти");
#else
    camera_ok = camera_init();
#endif
    dbg_stage = 4;
    SerialMon.printf("Камера: %s\n", camera_ok ? "OK" : "ОШИБКА");

#if ENCODE_FROM_SRAM || CAM_FB_IN_DRAM || ENC_BUF_INTERNAL
    /*
     * Развязка по памяти — до первого сжатия.
     *
     * Порог malloc поднимаем, чтобы буферы кодировщика и готовый JPEG легли во
     * внутреннюю память. Размер буфера под копию берём из таблицы разрешений
     * драйвера, а не константой: так он не разойдётся с FRAME_SIZE, если
     * разрешение потом поправят.
     *
     * 15.09: условие расширено. Порог нужен и при CAM_FB_IN_DRAM, где копии в
     * SRAM уже нет. Иначе получилось бы наоборот: кадр мы из PSRAM убрали, а
     * буферы кодировщика (12 КБ) и готовый JPEG (7-9 КБ) туда вернули — и
     * PSRAM осталась бы в тракте, ровно там, откуда её и выгоняем.
     */
    heap_caps_malloc_extmem_enable(INTERNAL_MALLOC_LIMIT);
#if ENCODE_FROM_SRAM
    if (camera_ok) {
        sensor_t *s = esp_camera_sensor_get();
        framesize_t fs = s ? s->status.framesize : FRAME_SIZE;
        sram_frame_cap = (size_t)resolution[fs].width * resolution[fs].height * 2;
        sram_frame = (uint8_t *)heap_caps_malloc(sram_frame_cap,
                                                 MALLOC_CAP_INTERNAL | MALLOC_CAP_8BIT);
        if (!sram_frame) {
            sram_frame_cap = 0;
        }
    }
#endif
    SerialMon.printf("SRAM: свободно %u, наибольший кусок %u\n",
                     (unsigned)heap_caps_get_free_size(MALLOC_CAP_INTERNAL),
                     (unsigned)heap_caps_get_largest_free_block(MALLOC_CAP_INTERNAL));
#if ENCODE_FROM_SRAM
    if (sram_frame) {
        SerialMon.printf("Кодировщик работает из внутренней памяти, буфер %u байт\n",
                         (unsigned)sram_frame_cap);
    } else {
        SerialMon.println("ВНИМАНИЕ: внутреннего буфера нет, сжимаю прямо из PSRAM "
                          "— вернётся гонка с DMA камеры");
    }
#endif
#endif

    dbg_stage = 5;

#if PIPELINE
    /* Очередь на два кадра и задача захвата на ядре 0. loop() живёт на ядре 1,
     * так что сжатие и передача идут по-настоящему одновременно.
     *
     * Без развязки по памяти конвейер не поднимаем: 18.08 в такой конфигурации
     * он рвал картинку, и включать его снова, зная причину, незачем. */
#if ENCODE_FROM_SRAM
    if (!sram_frame) {
        SerialMon.println("Конвейер: НЕ включаю — нет внутреннего буфера, "
                          "работаю последовательно");
    } else
#endif
    {
#if ENC_WORKERS > 1 && (ENCODE_FROM_SRAM || CAM_FB_IN_DRAM)
#error "ENC_WORKERS 2 только с ENCODE_FROM_SRAM 0 и CAM_FB_IN_DRAM 0: там один общий буфер кадра"
#endif
#if ENC_WORKERS > 1
        cap_mutex = xSemaphoreCreateMutex();
#endif
        jpg_q = xQueueCreate(ENC_WORKERS + 1 + (GATED_CAPTURE ? GATE_FRAMES : 0),
                             sizeof(jpg_item_t));
        /*
         * Стек 8192, а не 4096. Путь сжатия сам по себе укладывается примерно в
         * 2 КБ (convert_image держит кадр в 1168 байт плюс вложенные вызовы
         * кодировщика), но 20.08 выяснилось, что с 4 КБ плата умирала молча ещё
         * до первой печати, а от добавления пары печатей с flush оживала — то
         * есть дело было в считанных байтах и миллисекундах, а не в логике.
         * Четыре лишних килобайта из 228 свободных — разумная цена за то, чтобы
         * этот вопрос больше не возникал.
         */
        /*
         * ЯДРО 1, А НЕ 0. Изменено 25.08.
         *
         * Драйвер камеры держит свою задачу на ядре 0 — это зашито в сборке
         * фреймворка (CONFIG_CAMERA_CORE0=y). Она обслуживает прерывания DMA и
         * переключает буферы ПО ХОДУ кадра, то есть обязана получать процессор
         * вовремя, иначе теряются строки — и кадр приходит рваным.
         *
         * Мы же посадили туда конвейер, который тридцать пять миллисекунд подряд
         * жмёт JPEG и уступает всего раз на кадр. Отсюда, судя по всему, и
         * радужный мусор: не конкуренция за шину PSRAM (копия кадра занимает 2 мс,
         * полтора процента времени), а голодание драйвера.
         *
         * Здесь ядро 1 — то же, где живёт loop() с передачей. Выигрыш конвейера
         * при этом почти не теряется: передача по UART большую часть времени
         * ждёт места в буфере и отдаёт процессор, так что сжатие успевает
         * работать в этих паузах. А ядро 0 остаётся драйверу целиком.
         */
        /*
         * 29.09: при двух кодировщиках приоритет 0, ниже loop() (1). С равным
         * приоритетом loop, проснувшись по «FIFO UART опустел», ждал конца
         * кванта кодировщика до 1 мс — в середине чанка выходила тишина дольше
         * таймера модуля (400 мкс, сборка sil400), чанк рвался на два эфирных
         * кадра, у модуля росли переполнения приёма (110 на МБ, 2 % битых).
         * С приоритетом 0 передача вытесняет сжатие сразу.
         */
        BaseType_t task_ok = jpg_q ? xTaskCreatePinnedToCore(camera_task, "camera",
                                                             8192, NULL,
                                                             (ENC_WORKERS > 1) ? 0 : 1,
                                                             NULL, 1)
                                   : pdFAIL;
#if ENC_WORKERS > 1 && !SYNTH_SOURCE
        /* Второй кодировщик — на ядре 0, приоритет 1: задача драйвера камеры
         * там же, но с приоритетом configMAX_PRIORITIES-2 вытесняет его сразу. */
        if (task_ok == pdPASS && cap_mutex) {
            BaseType_t t2 = xTaskCreatePinnedToCore(camera_task, "camera2",
                                                    8192, (void *)1, 1, NULL, 0);
            SerialMon.printf("Конвейер: второй кодировщик на ядре 0 — %s\n",
                             t2 == pdPASS ? "запущен" : "НЕ ЗАПУСТИЛСЯ");
        }
#endif
        if (task_ok == pdPASS) {
            SerialMon.println("Конвейер: кодировщик на ядре 1 вместе с передачей");
        } else {
            /* Очередь без задачи хуже, чем её отсутствие: loop() ждал бы кадры,
             * которые некому положить, и видео просто не пошло бы. */
            if (jpg_q) {
                vQueueDelete(jpg_q);
                jpg_q = NULL;
            }
            SerialMon.println("Конвейер: не поднялся, работаю последовательно");
        }
    }
#endif

#if TEST_PATTERN
    if (camera_ok) {
        // Первые кадры сенсор отдаёт с неустоявшейся экспозицией — выбрасываем.
        for (int i = 0; i < 5; i++) {
            camera_fb_t *warm = esp_camera_fb_get();
            if (warm) {
                esp_camera_fb_return(warm);
            }
            delay(100);
        }
        camera_fb_t *fb = esp_camera_fb_get();
        if (fb) {
            uint8_t *jpg = NULL;
            size_t jpg_len = 0;
            if (frame2jpg(fb, JPEG_QUALITY_SW, &jpg, &jpg_len)) {
                tp_jpg = jpg;      // намеренно не освобождаем: живёт всю сессию
                tp_len = jpg_len;
            }
            esp_camera_fb_return(fb);
        }
        if (tp_jpg) {
            SerialMon.printf("ТЕСТ-КАДР: %u байт, CRC16=%04X — шлю его по кругу\n",
                             (unsigned)tp_len, halow_crc16(tp_jpg, (uint16_t)tp_len));
        } else {
            SerialMon.println("ТЕСТ-КАДР: снять не удалось");
        }
    }
#endif

    dbg_stage = 6;

    useAtWindow();

    dbg_stage = 7;
    SerialMon.printf("Ждём окончания стартового окна (%u мс), поток начнётся после\n",
                     (unsigned)P2P_WINDOW_MS);
    /*
     * Принудительно выталкиваем всё, что напечатали.
     *
     * 20.08: Serial здесь — это USB-Serial/JTAG (ARDUINO_USB_MODE=1), и запись
     * в него только кладёт байты в кольцо, а выгребает их прерывание. Когда
     * следом стартует конвейер и занимает ядро 0, кольцо перестаёт выгребаться,
     * и весь лог загрузки пропадает молча — плата выглядит мёртвой, хотя
     * исправно шлёт кадры. Здесь ждём, пока кольцо опустеет, поэтому лог
     * загрузки доезжает всегда.
     */
    halow_mon_settle();
}

#if EXP_PROGRAM
/* 29.09 14:03–14:51 (var0929r): Q60/80/90, сенсор вкл/выкл, кусок
 * 1400/700/350 — см. журнал. Сейчас: на каждом шаге мощности (VAR_SWEEP)
 * потолок канала (синтетика, кадр Q60 как в прошлом опыте) и живое видео. */
/* 14:56–15:20 (var0929p): синтетика + Q80 на каждом шаге мощности.
 * 16:07–17:06 (var0929a): окно и пауза на синтетике, затем видео с
 * автокачеством. Сейчас (var0930rc): на каждой ручке выбора модуляции
 * (VAR_SWEEP) потолок канала на синтетике и живое видео с автокачеством,
 * рабочие W=2 и пауза 2,0 мс. Всего ~5,5 мин на включение. */
static const exp_step_t exp_steps[] = {
#if ROLE_SWAP
    /* 06.10 (swap5): Q закреплено на 80 без автокачества (потолок скорости на этом
     * месте) против автокачества 4 (одиночные всплески задержки не в счёт), W=4,
     * 8 этапов по 90 с. Приёмник — CCA 20 постоянно, квитанции адресно.
     * 06.10 (swap4) было: АК2 против АК3 × CCA 20/0 — АК3 +4 %, CCA 0 +4 % при 90 %
     * квитанций вместо 74 %, но кусков теряется больше и в фазе CCA 0 был обрыв. */
    /* 06.10 ночь (gate14): 14 дБм, ток ×1, Q70, W=4, по 50 с — паузы передачи выкл против
     * вкл (ABABAB). Нужны ли паузы, если ток сенсора ×1. drvq (Q и ток на 3 дБм) — в журнале. */
    { "ПАУЗЫ выкл (1)", 0, 0, 1400, 70, 50, 4, 2000, 0, 0, 1, 1 },
    { "ПАУЗЫ вкл (1)",  0, 0, 1400, 70, 50, 4, 2000, 0, 0, 1, 2 },
    { "ПАУЗЫ выкл (2)", 0, 0, 1400, 70, 50, 4, 2000, 0, 0, 1, 1 },
    { "ПАУЗЫ вкл (2)",  0, 0, 1400, 70, 50, 4, 2000, 0, 0, 1, 2 },
    { "ПАУЗЫ выкл (3)", 0, 0, 1400, 70, 50, 4, 2000, 0, 0, 1, 1 },
    { "ПАУЗЫ вкл (3)",  0, 0, 1400, 70, 50, 4, 2000, 0, 0, 1, 2 },
#else
    { "СИНТ W2 пауза 2,0", 1, 0, 1400, 60, 150, 2, 2000, 0, 1, 0 },
    { "ВИДЕО автокачество", 0, 0, 1400, 80, 150, 2, 2000, 1, 1, 0 },
#endif
};
static int8_t   exp_idx = -1;          /* -1 — не начат; = числу этапов — закончен */
static uint32_t exp_link_ms = 0, exp_t0 = 0, exp_m0 = 0;
static bool     exp_marked = false;
static uint32_t e_bytes0, e_fid0, e_acks0, e_to0, e_inc0, e_kb0, e_rxf0, e_rxok0, e_rxcrc0;
static uint32_t e_blk0, e_q_sum, e_q_n, e_q_t;
static uint32_t e_cks0, e_ckg0, e_ckm0, e_ckp0[3];
static uint64_t e_rtt0;
static uint32_t e_cap0, e_cwait0, e_fixt0, e_fixok0, e_fixus0, e_votes0, e_ln0, e_lb0, e_reinit0;
/* 06.10 ночь: итоги этапов — в таблицу, её повторяем после опыта: строки этапов
 * теряются в эфире вместе с кусками лога (22:13 пропал итог этапа ×4). */
#define EXP_RES_MAX 8
typedef struct {
    uint32_t fed_kbps, frame_b, sent, acks, inc, wo, rx10, lost_pm, rtt, cap10, slips, ln;
    uint8_t  drv, done;
} exp_res_t;
static exp_res_t exp_res[EXP_RES_MAX];
static uint32_t  exp_sum_t = 0;
#if LMAC_DBG_EVERY
static uint32_t e_tp0;
#endif
#if AUTO_Q
static int8_t   autoq_idx = -1;        /* ступень; -1 — взять ближайшую к jpeg_q_rt */
#endif

/* Такт XCLK сенсора: остановить — шлейф и сенсор замолкают. */
static void exp_xclk(bool on)
{
    if (on) {
        ledc_timer_resume(LEDC_LOW_SPEED_MODE, LEDC_TIMER_0);
    } else {
        ledc_timer_pause(LEDC_LOW_SPEED_MODE, LEDC_TIMER_0);
    }
}

/* Такт сенсора на ходу: 1 — CAM_PLL_MUL/CAM_PLL_PCLK_DIV, 0 — как ставит драйвер для
 * QVGA RGB565 (множитель 8, делитель PCLK 4). Кадр-другой на переходе может выйти битым. */
static void cam_pll_apply(uint8_t fast)
{
    if (fast == cam_pll_fast) {
        return;
    }
    sensor_t *sn = esp_camera_sensor_get();
    if (!sn || !sn->set_pll || sn->id.PID != OV5640_PID) {
        return;
    }
    int rc = fast ? sn->set_pll(sn, 0, CAM_PLL_MUL, 1, 0, 1, 1, 1, CAM_PLL_PCLK_DIV)
                  : sn->set_pll(sn, 0, 8, 1, 0, 1, 1, 1, 4);
    cam_pll_fast = fast;
    SerialMon.printf("PLL: такт сенсора %s (set_pll=%d)\n", fast ? "x1,5" : "x1", rc);
}

static void exp_apply(uint8_t synth, uint8_t xclk_off, uint16_t chunk, uint8_t q,
                      uint8_t win, uint16_t gap_us, uint8_t autoq, uint8_t pll, uint8_t drv,
                      uint8_t gate)
{
    cam_pll_apply(pll);
#if GATED_CAPTURE
    gate_force = gate == 1 ? 0 : gate == 2 ? 1 : (int8_t)GATE_FORCE;
#else
    (void)gate;
#endif
    cam_drv_apply(drv, false);         /* 0 — не трогать */
    jpeg_q_rt = q;
    chunk_payload = chunk;
    fc_window = win;
    chunk_gap_us = gap_us;
    exp_xclk(!xclk_off);
    synth_on = synth || SYNTH_NOCAM;
#if AUTO_Q
    autoq_on = autoq;
    autoq_idx = -1;                     /* начать с заданного q */
#endif
}

static void exp_mark(uint32_t now)
{
    e_bytes0 = bytes_total;
    e_fid0 = frame_id;
    e_acks0 = lat_acks;
    e_to0 = fc_timeouts;
    e_inc0 = lat_incomplete;
    e_rtt0 = lat_rtt_sum;
    e_cap0 = cap_all;
    e_cwait0 = cam_ms_all;
    e_fixt0 = cam_fix_try;
    e_fixok0 = cam_fix_ok;
    e_fixus0 = cam_fix_us;
    e_votes0 = cam_votes_sum;
    e_ln0 = cam_live_n;
    e_lb0 = cam_live_bad;
#if CAM_WATCHDOG
    e_reinit0 = cam_reinits;
#endif
    e_kb0 = exp_tx0_kb;
    e_rxf0 = peer.frames_done;
    e_rxok0 = peer.pkts_ok;
    e_rxcrc0 = peer.pkts_crc_err;
    e_blk0 = fc_blocked_ms;
    e_cks0 = ck_sent;
    e_ckg0 = ck_got;
    e_ckm0 = ck_mask_acks;
    memcpy(e_ckp0, ck_lost_pos, sizeof(e_ckp0));
#if LMAC_DBG_EVERY
    e_tp0 = lmac_tp_seen;
#endif
    e_q_sum = e_q_n = 0;
    e_q_t = now;
    exp_air_sum = exp_per_sum = exp_mcs_sum = exp_mod_n = 0;
    exp_m0 = now;
    exp_marked = true;
}

static void exp_report(int8_t idx, uint32_t now)
{
    const exp_step_t *s = &exp_steps[idx];
    uint32_t dt = now - exp_m0;
    uint32_t fed = bytes_total - e_bytes0;
    uint32_t sent = frame_id - e_fid0;
    uint32_t acks = lat_acks - e_acks0;
    uint32_t rxf = peer.frames_done - e_rxf0;
    uint32_t n = exp_mod_n ? exp_mod_n : 1;
    /* Эфир — средняя скорость из строк tx0 модуля; счётчик data= в них не
     * монотонный (29.09 разность уходила в минус), поэтому по скорости. */
    uint32_t fed_kbps = dt ? (uint32_t)((uint64_t)fed * 8u / dt) : 0;
    uint32_t ratio100 = fed_kbps ? exp_air_sum / n * 100u / fed_kbps : 0;
    SerialMon.printf("ОПЫТ ИТОГ | %s | %lu с | кадров отпр %lu, подтв %lu, неполных %lu, списано %lu | "
                     "приёмник: чанков %lu (%lu.%lu в с), пакетов %lu, битых %lu | "
                     "подача %lu кбит/с, кадр %lu Б | эфир %lu кбит/с, эфир/подача %lu.%02lu | "
                     "PER модуля %lu %%, MCS %lu.%lu (%lu замеров) | RTT %lu мс | мощность %d дБм | "
                     "W=%u, пауза %u мкс, окно закрыто %lu %%, качество ср %lu\n",
                     s->name, (unsigned long)(dt / 1000),
                     (unsigned long)sent, (unsigned long)acks,
                     (unsigned long)(lat_incomplete - e_inc0), (unsigned long)(fc_timeouts - e_to0),
                     (unsigned long)rxf,
                     (unsigned long)(dt ? rxf * 10000u / dt / 10 : 0),
                     (unsigned long)(dt ? rxf * 10000u / dt % 10 : 0),
                     (unsigned long)(peer.pkts_ok - e_rxok0),
                     (unsigned long)(peer.pkts_crc_err - e_rxcrc0),
                     (unsigned long)fed_kbps,
                     (unsigned long)(sent ? fed / sent : 0),
                     (unsigned long)(exp_air_sum / n),
                     (unsigned long)(ratio100 / 100), (unsigned long)(ratio100 % 100),
                     (unsigned long)(exp_per_sum / n),
                     (unsigned long)(exp_mcs_sum * 10 / n / 10), (unsigned long)(exp_mcs_sum * 10 / n % 10),
                     (unsigned long)exp_mod_n,
                     (unsigned long)(acks ? (uint32_t)((lat_rtt_sum - e_rtt0) / acks) : 0),
                     (int)mod_pwr_dbm,
                     (unsigned)fc_window, (unsigned)chunk_gap_us,
                     (unsigned long)(dt ? (fc_blocked_ms - e_blk0) * 100u / dt : 0),
                     (unsigned long)(e_q_n ? e_q_sum / e_q_n : jpeg_q_rt));
    /* 05.10: куски по квитанциям — отдельной строкой, чтобы не трогать разбор
     * «ОПЫТ ИТОГ» (tools/rc_sweep_report.py). Доля — в десятых процента. */
    {
        uint32_t cs = ck_sent - e_cks0, cg = ck_got - e_ckg0;
        uint32_t lost = cs - cg;
        uint32_t pm = cs ? (uint32_t)((uint64_t)lost * 1000u / cs) : 0;
        SerialMon.printf("ОПЫТ КУСКИ | %s | дошло %lu из %lu, пропало %lu (%lu.%lu %%) | "
                         "по месту: первый %lu, средние %lu, последний %lu | "
                         "квитанций %lu, со списком %lu\n",
                         s->name, (unsigned long)cg, (unsigned long)cs, (unsigned long)lost,
                         (unsigned long)(pm / 10), (unsigned long)(pm % 10),
                         (unsigned long)(ck_lost_pos[0] - e_ckp0[0]),
                         (unsigned long)(ck_lost_pos[1] - e_ckp0[1]),
                         (unsigned long)(ck_lost_pos[2] - e_ckp0[2]),
                         (unsigned long)acks, (unsigned long)(ck_mask_acks - e_ckm0));
    }
    /* 06.10 (drvab): захват по этапу — сдвиг байта и пропуски кадров драйвером
     * (их видно по ожиданию кадра: сенсор отдаёт кадр раз в 112–126 мс). */
    {
        uint32_t nc = cap_all - e_cap0;
        uint32_t ft = cam_fix_try - e_fixt0;
        uint32_t ln = cam_live_n - e_ln0, lb = cam_live_bad - e_lb0;
        uint32_t ft10 = ln ? ft * 1000u / ln : 0;
        uint32_t lb10 = ln ? lb * 1000u / ln : 0;
        uint32_t v10 = ft ? (cam_votes_sum - e_votes0) * 10u / ft : 0;
        uint32_t fps10 = dt ? nc * 10000u / dt : 0;
        uint32_t rn = 0;
#if CAM_WATCHDOG
        rn = cam_reinits - e_reinit0;
#endif
        SerialMon.printf("ОПЫТ КАМЕРА | %s | снято %lu (%lu.%lu к/с), ждали кадр ср %lu мс | "
                         "со сдвигом %lu из %lu (%lu.%lu %%), строк на такой кадр %lu.%lu, вылечено %lu | "
                         "шершавых %lu (%lu.%lu %%) | правка ср %lu мс | перезапусков драйвера %lu | ток x%u\n",
                         s->name, (unsigned long)nc, (unsigned long)(fps10 / 10), (unsigned long)(fps10 % 10),
                         (unsigned long)(nc ? (cam_ms_all - e_cwait0) / nc : 0),
                         (unsigned long)ft, (unsigned long)ln,
                         (unsigned long)(ft10 / 10), (unsigned long)(ft10 % 10),
                         (unsigned long)(v10 / 10), (unsigned long)(v10 % 10),
                         (unsigned long)(cam_fix_ok - e_fixok0),
                         (unsigned long)lb, (unsigned long)(lb10 / 10), (unsigned long)(lb10 % 10),
                         (unsigned long)(ft ? (cam_fix_us - e_fixus0) / ft / 1000u : 0),
                         (unsigned long)rn, (unsigned)cam_drv_now);
    }
    if (idx >= 0 && idx < EXP_RES_MAX) {
        exp_res_t *r = &exp_res[idx];
        uint32_t cs = ck_sent - e_cks0, cg = ck_got - e_ckg0;
        r->fed_kbps = fed_kbps;
        r->frame_b = sent ? fed / sent : 0;
        r->sent = sent;
        r->acks = acks;
        r->inc = lat_incomplete - e_inc0;
        r->wo = fc_timeouts - e_to0;
        r->rx10 = dt ? rxf * 10000u / dt : 0;
        r->lost_pm = cs ? (uint32_t)((uint64_t)(cs - cg) * 1000u / cs) : 0;
        r->rtt = acks ? (uint32_t)((lat_rtt_sum - e_rtt0) / acks) : 0;
        r->cap10 = dt ? (cap_all - e_cap0) * 10000u / dt : 0;
        r->slips = cam_fix_try - e_fixt0;
        r->ln = cam_live_n - e_ln0;
        r->drv = cam_drv_now;
        r->done = 1;
    }
#if LMAC_DBG_EVERY
    /* Сколько раз модуль печатал смену лучшей модуляции (tp1=/tp2=): частая
     * печать сама может тормозить модуль — сверять с R1 без таблицы. */
    SerialMon.printf("ОПЫТ ТАБЛИЦА | %s | смен лучшей за этап %lu\n", s->name,
                     (unsigned long)(lmac_tp_seen - e_tp0));
#endif
}

static void exp_tick(uint32_t now)
{
    const int8_t n = (int8_t)(sizeof(exp_steps) / sizeof(exp_steps[0]));
    if (exp_idx >= n) {
        /* Сводка — каждые 20 с, пока плата работает (см. exp_res). */
        if (now - exp_sum_t >= 20000u) {
            exp_sum_t = now;
            for (int8_t i = 0; i < n && i < EXP_RES_MAX; i++) {
                const exp_res_t *r = &exp_res[i];
                if (!r->done) {
                    continue;
                }
                SerialMon.printf("ОПЫТ СВОДКА | %s | подача %lu кбит/с, кадр %lu Б | отпр %lu, подтв %lu, "
                                 "неполных %lu, списано %lu | приёмник %lu.%lu чанка/с, кусков пропало %lu.%lu %% | "
                                 "RTT %lu мс | съёмка %lu.%lu к/с, сдвигов %lu из %lu | ток x%u\n",
                                 exp_steps[i].name, (unsigned long)r->fed_kbps, (unsigned long)r->frame_b,
                                 (unsigned long)r->sent, (unsigned long)r->acks, (unsigned long)r->inc,
                                 (unsigned long)r->wo, (unsigned long)(r->rx10 / 10), (unsigned long)(r->rx10 % 10),
                                 (unsigned long)(r->lost_pm / 10), (unsigned long)(r->lost_pm % 10),
                                 (unsigned long)r->rtt, (unsigned long)(r->cap10 / 10), (unsigned long)(r->cap10 % 10),
                                 (unsigned long)r->slips, (unsigned long)r->ln, (unsigned)r->drv);
            }
        }
        return;
    }
    if (exp_idx < 0) {
        if (!link_up) {
            return;
        }
        if (!exp_link_ms) {
            exp_link_ms = now;
        }
        if (now - exp_link_ms < EXP_SETTLE_MS) {
            return;
        }
    } else {
        const exp_step_t *s = &exp_steps[exp_idx];
        if (!exp_marked) {
            if (now - exp_t0 >= EXP_WARM_MS) {
                exp_mark(now);
            }
            return;
        }
        if (now - e_q_t >= 1000) {
            e_q_t = now;
            e_q_sum += jpeg_q_rt;
            e_q_n++;
        }
        if (now - exp_t0 < (uint32_t)s->secs * 1000u) {
            return;
        }
        exp_report(exp_idx, now);
    }
    exp_idx++;
    exp_marked = false;
    exp_t0 = now;
    if (exp_idx >= n) {
        exp_apply(0, 0, CHUNK_PAYLOAD, JPEG_QUALITY_SW, FC_WINDOW, CHUNK_GAP_US, AUTO_Q,
                  (CAM_PLL_MUL > 0) ? 1 : 0, CAM_DRIVE ? CAM_DRIVE : 4, 0);
        SerialMon.printf("ОПЫТ: закончен, дальше живое видео%s\n",
                         AUTO_Q ? " с автокачеством" : "");
        return;
    }
    const exp_step_t *s = &exp_steps[exp_idx];
    exp_apply(s->synth, s->xclk_off, s->chunk, s->q, s->win, s->gap_us, s->autoq, s->pll, s->drv,
              s->gate);
    SerialMon.printf("ОПЫТ: этап %d из %d — %s, %u с\n", (int)exp_idx + 1, (int)n,
                     s->name, (unsigned)s->secs);
}
#endif

#if AUTO_Q
#if !EXP_PROGRAM
static int8_t   autoq_idx = -1;
#endif
/* 29.09: ступень 30 — на канале ~250 кбит/с при Q40 было 3,3 к/с, ниже некуда. */
/* 06.10 вечер: +95 — поток растим размером кадра, раз сенсор держит не больше 7,9 к/с
 * (см. thalow-camera-fps-limits / CAM_PLL_MUL). Задержка сама опустит, если канал не тянет. */
/* 06.10 вечер (выбор пользователя): +98. */
static const uint8_t autoq_ladder[] = { 30, 40, 50, 60, 70, 80, 85, 90, 95, 98 };
static uint32_t aq_t = 0, aq_acks0 = 0, aq_to0 = 0, aq_blk0 = 0, aq_streak = 0;
static uint32_t aq_ups = 0, aq_downs = 0, aq_last_rtt = 0, aq_last_blk = 0;
static uint64_t aq_rtt0 = 0;

/* Раз в секунду: подобрать качество под канал, см. AUTO_Q. */
static void autoq_tick(uint32_t now)
{
    const int8_t n = (int8_t)sizeof(autoq_ladder);
    if (!autoq_on || synth_on || !link_up) {
        aq_t = 0;
        aq_rtt_n = 0;
        return;
    }
    if (autoq_idx < 0) {
        autoq_idx = 0;
        for (int8_t i = 0; i < n; i++) {
            if (autoq_ladder[i] <= jpeg_q_rt) {
                autoq_idx = i;
            }
        }
        jpeg_q_rt = autoq_ladder[autoq_idx];
        aq_t = 0;
    }
    if (!aq_t || now - aq_t >= 1000) {
        bool first = !aq_t;
        uint32_t dt = now - aq_t;
        uint32_t acks = lat_acks - aq_acks0;
        uint32_t to = fc_timeouts - aq_to0;
        uint32_t blk = dt ? (fc_blocked_ms - aq_blk0) * 1000u / dt : 0;
        uint32_t rtt = acks ? (uint32_t)((lat_rtt_sum - aq_rtt0) / acks) : 0;
        bool in_flight = (frame_id != fc_last_ack_id);
        /* 06.10, правила 3: медиана RTT без запоздалых квитанций (вставками —
         * элементов меньше двух десятков). */
        uint8_t rtt_n = aq_rtt_n;
        uint32_t rtt_med = 0;
        for (uint8_t i = 1; i < rtt_n; i++) {
            uint16_t v = aq_rtt_buf[i];
            int8_t j = (int8_t)i - 1;
            while (j >= 0 && aq_rtt_buf[j] > v) {
                aq_rtt_buf[j + 1] = aq_rtt_buf[j];
                j--;
            }
            aq_rtt_buf[j + 1] = v;
        }
        if (rtt_n) {
            rtt_med = aq_rtt_buf[rtt_n / 2];
        }
        aq_rtt_n = 0;
        aq_t = now;
        uint32_t fps10 = dt ? (frames_total - aq_fr0) * 10000u / dt : 0;
        aq_fr0 = frames_total;
        aq_acks0 = lat_acks;
        aq_to0 = fc_timeouts;
        aq_blk0 = fc_blocked_ms;
        aq_rtt0 = lat_rtt_sum;
        if (first) {
            return;
        }
        if (autoq_on >= 3) {
            rtt = rtt_med;
        }
        aq_last_rtt = rtt;
        aq_last_blk = blk;
        aq_last_fps10 = fps10;
#if GATED_CAPTURE
        bool gated = gate_on;
#else
        bool gated = false;
#endif
        int8_t d = 0;
        int8_t why = -1;                  /* причина шага вниз, см. aq_why */
        if (autoq_on >= 3) {
            /* 06.10: правила 3 и 4, см. AUTO_Q. Квитанции — мерка очереди, не штраф;
             * в 4 задержка роняет Q, только если держится несколько секунд подряд. */
            static uint8_t noack_run = 0, hi_run = 0, bad_run = 0, fps_run = 0;
            const uint8_t need_hi = autoq_on == 4 ? 3 : 1;
            const uint8_t need_bad = autoq_on == 4 ? 2 : 1;
            noack_run = (!acks && in_flight) ? (uint8_t)(noack_run + 1) : 0;
            fps_run = fps10 < AQ_FPS_MIN * 10u ? (uint8_t)(fps_run + 1) : 0;
            if (rtt_n) {                      /* без замеров — счёт не трогаем */
                hi_run = rtt > AUTOQ_RTT_HI ? (uint8_t)(hi_run + 1) : 0;
                bad_run = rtt > AUTOQ_RTT_BAD ? (uint8_t)(bad_run + 1) : 0;
            }
            if (bad_run >= need_bad) {
                d = -2;
                why = 0;
                bad_run = 0;
                hi_run = 0;
            } else if (noack_run >= 2) {
                d = -1;
                why = 1;
                noack_run = 0;
            } else if (hi_run >= need_hi) {
                d = -1;
                why = 2;
                hi_run = 0;
            } else if (autoq_on == 3 && !gated && blk > AUTOQ_BLOCK_HI && rtt_n &&
                       rtt > AUTOQ_RTT_LO) {
                d = -1;
                why = 3;
            } else if (fps_run >= 3 && jpeg_q_rt > AQ_FPS_Q_FLOOR) {
                d = -1;
                why = 5;
                fps_run = 0;
            } else if (rtt_n && rtt < AUTOQ_RTT_LO && fps10 >= AQ_FPS_UP * 10u) {
                if (++aq_streak >= 3) {
                    d = 1;
                }
            } else {
                aq_streak = 0;
            }
        } else {
            /* 05.10: правила 2 — одиночный списанный кадр не в счёт, см. AUTO_Q. */
            bool to_bad = autoq_on == 2 ? false : to > 0;
            bool to_hi  = autoq_on == 2 ? to >= 2 : false;
            if (to_bad || rtt > AUTOQ_RTT_BAD || (!acks && in_flight)) {
                d = -2;
                why = rtt > AUTOQ_RTT_BAD ? 0 : (!acks && in_flight) ? 1 : 4;
            } else if (rtt > AUTOQ_RTT_HI || (!gated && blk > AUTOQ_BLOCK_HI) || to_hi) {
                d = -1;
                why = rtt > AUTOQ_RTT_HI ? 2 : (!gated && blk > AUTOQ_BLOCK_HI) ? 3 : 4;
            } else if (acks && rtt < AUTOQ_RTT_LO && (gated || blk < AUTOQ_BLOCK_LO)) {
                if (++aq_streak >= 3) {
                    d = 1;
                }
            } else {
                aq_streak = 0;
            }
        }
        if (d < 0 && why >= 0 && autoq_idx > 0) {
            aq_why[why]++;
        }
        if (d) {
            aq_streak = 0;
            int8_t ni = autoq_idx + d;
            if (ni < 0) {
                ni = 0;
            }
            if (ni > n - 1) {
                ni = n - 1;
            }
            if (ni != autoq_idx) {
                autoq_idx = ni;
                jpeg_q_rt = autoq_ladder[ni];
                if (d > 0) {
                    aq_ups++;
                } else {
                    aq_downs++;
                }
            }
        }
    }
}
#endif

void loop()
{
    /*
     * Вычитываем и выбрасываем всё, что пришло из USB.
     *
     * Скетч оттуда ничего не ждёт, но НЕ читать нельзя: входной буфер USB
     * переполняется, и плата перестаёт принимать байты вообще. Тогда до неё не
     * достучаться даже загрузчиком — esptool упирается в "Write timeout" и
     * заливка не идёт, пока плату не обесточишь. 20.08 это случилось трижды за
     * день, каждый раз на приёмнике, и каждый раз лечилось выдёргиванием USB.
     */
    /* Пока окно открыто — строки "AT+..." с USB уходят модулю (смена полосы
     * без перепрошивки, см. halow_usb_at_console). После — выбрасываем, но
     * читать обязаны: иначе входной буфер USB переполнится и плата перестанет
     * прошиваться. */
    if (halow_usb_at_console(SerialMon, SerialAT, !streaming)) {
        delay(400);
        while (SerialAT.available()) {
            SerialMon.write((uint8_t)SerialAT.read());
        }
        SerialMon.println();
    }

    if (dbg_stage < 8) {
        dbg_stage = 8;                 /* дошли до основного цикла */
    }
    if (dbg_stage > dbg_maxstage) {
        dbg_maxstage = dbg_stage;
    }
    pumpRx();

    // Ждём, пока в модуле сработает отложенный uart_p2p_init. До этого момента
    // всё, что мы напишем, уйдёт не в эфир, а в разборщик AT-команд.
    if (!streaming) {
        if (millis() < P2P_WINDOW_MS) {
            delay(10);
            return;
        }
        streaming = true;
        /*
         * РЕШАЮЩАЯ ПРОБА. Окно закрылось — значит в прошивке шага 3 модуль уже
         * забрал UART себе, и AT-команда обязана остаться БЕЗ ОТВЕТА.
         * Спрашиваем на 115200, до переключения скорости.
         *
         * Ответил -> модуль в AT-режиме, прозрачный режим не стартовал. Тогда
         * всё, что мы пишем дальше, уходит не в эфир, а в разборщик AT-команд,
         * и на той стороне не появится ни байта — ровно то, что мы наблюдаем.
         */
#if LINK_DIAG
        SerialMon.println("ПРОБА: AT после окна — ответа быть НЕ должно");
        atWindowCmd("AT+VERSION\r\n");
#endif
        /*
         * Окно было настоящим? Если модуль не ответил НИ РАЗУ, значит он уже
         * сидел в прозрачном режиме с прошлой загрузки: наши настройки не
         * применены, и измерять на этом прогоне нечего.
         */
        /* Порог 3, а не 1: одиночное совпадение могло прийти из потока. */
        if (at_window_answers < 3) {
            SerialMon.println("");
            SerialMon.printf("!!!! СТАРТОВОЕ ОКНО НЕ ОТКРЫЛОСЬ !!!! (ответов с OK: %u)\n",
                             (unsigned)at_window_answers);
            SerialMon.println("Модуль почти не отвечает — значит он");
            SerialMon.println("уже в прозрачном режиме с ПРОШЛОЙ загрузки.");
            SerialMon.println("Настройки (MCAST_BW, MCAST_MCS, P2PDEST) НЕ применены,");
            SerialMon.println("модуль работает на том, что было задано раньше.");
            SerialMon.println("ПРОГОН НЕДЕЙСТВИТЕЛЕН. Снимите питание с платы");
            SerialMon.println("физически — перепрошивка ESP32 окна не открывает.");
            SerialMon.println("");
        } else {
            SerialMon.printf("Стартовое окно открыто: %u ответов с OK — "
                             "настройки применены\n",
                             (unsigned)at_window_answers);
        }
        dbg_stage = 9;                 /* стартовое окно закрылось, идём в поток */
        if (P2P_BAUD != AT_BAUD) {
            // Пригодится, когда поднимем UART_P2P_BAUDRATE: окно всегда идёт на
            // 115200, поток — на новой скорости, порт надо переоткрыть.
            SerialAT.updateBaudRate(P2P_BAUD);
        }
        halow_p2p_rx_init(&rx);   // выкидываем накопленный загрузочный лог модуля
        stats_tick = millis();
        hello_since_ms = hello_wait_tick = millis();
#if WAIT_FOR_HELLO
        SerialMon.println("Окно закрыто. Молчу и жду первого отчёта приёмника.");
#else
        tx_enabled = true;
        SerialMon.println("Окно закрыто, начинаю поток (гейт по отчёту выключен)");
#endif
    }

#if PAYLOAD_SWEEP
    psweep_tick();
#endif
#if GAP_SWEEP
    sweep_tick();
#endif
#if FRAME_GAP_SWEEP
    fsweep_tick();
#endif

    if (link_up && millis() - last_stat_ms > LINK_TIMEOUT_MS) {
        link_up = false;
    }

#if WAIT_FOR_HELLO
    /*
     * ГЕЙТ ПЕРЕДАЧИ. Первый 'S' от приёмника открывает поток; до него камера
     * не пишет в модуль ни байта. last_stat_ms ненулевой ровно тогда, когда
     * отчёт хоть раз доехал (pumpRx выставляет его вместе с link_up).
     */
    if (!tx_enabled && last_stat_ms) {
        tx_enabled = true;
        SerialMon.printf("ОТЧЁТ ПРИЁМНИКА ПОЛУЧЕН через %lu с — связь есть, "
                         "открываю поток\n",
                         (unsigned long)((millis() - hello_since_ms) / 1000));
        halow_mon_settle();
        /* Период статистики отсчитываем от этого момента, иначе первая строка
         * усреднит fps по всему времени ожидания и покажет ноль. */
        stats_tick = millis();
        frames_sent = bytes_sent = 0;
        cam_ms_acc = copy_ms_acc = jpeg_ms_acc = send_ms_acc = 0;
        stage_frames = cap_frames = 0;
    }
#if HELLO_WAIT_MAX_MS
    if (!tx_enabled && millis() - hello_since_ms > HELLO_WAIT_MAX_MS) {
        tx_enabled = true;
        SerialMon.println("ВНИМАНИЕ: отчёта так и нет, аварийный клапан открыл "
                          "поток вслепую (HELLO_WAIT_MAX_MS)");
        halow_mon_settle();
    }
#endif
#if RESTREAM_ON_HELLO_LOSS
    if (tx_enabled && last_stat_ms && millis() - last_stat_ms > HELLO_LOST_MS) {
        tx_enabled = false;
        last_stat_ms = 0;
        hello_since_ms = hello_wait_tick = millis();
        SerialMon.println("Отчёты пропали — закрываю поток и жду заново");
        halow_mon_settle();
    }
#endif
#if AIR_LOG
    airlog_pump();
#endif
    if (!tx_enabled) {
#if HELLO_PROBE_MS
        /* Маячок: дать модулю повод ассоциироваться. Без него он в прозрачном
         * режиме не выходит в эфир вовсе — см. HELLO_PROBE_MS. */
        static uint32_t probe_tick = 0;
        if (millis() - probe_tick >= HELLO_PROBE_MS) {
            probe_tick = millis();
            static const uint8_t body[4] = { 'H', 'L', 'W', 'P' };
            int n = halow_p2p_build(pkt, HALOW_P2P_TYPE_PING, body, sizeof(body));
            if (n > 0) {
                SerialAT.write(pkt, n);
                p2pGap();
            }
        }
#endif
        /* Молчание — это и есть результат замера: ассоциации нет. Печатаем
         * раз в пять секунд, чтобы в логе было видно, сколько она не встаёт. */
        if (millis() - hello_wait_tick > 5000) {
            hello_wait_tick = millis();
            SerialMon.printf("[нет связи] жду отчёта приёмника, %lu с | RAM %u\n",
                             (unsigned long)((millis() - hello_since_ms) / 1000),
                             (unsigned)ESP.getFreeHeap());
            halow_mon_settle();
        }
        digitalWrite(BOARD_LED, LOW);
        delay(10);
        return;
    }
#endif
    digitalWrite(BOARD_LED, link_up);
#if EXP_PROGRAM
    exp_tick(millis());
#endif
#if AUTO_Q
    autoq_tick(millis());
#endif

    if (millis() - stats_tick > STATS_PERIOD_MS) {
        uint32_t dt = millis() - stats_tick;
        stats_tick = millis();

        uint32_t fps10 = dt ? frames_sent * 10000u / dt : 0;
        uint32_t kbps10 = dt ? bytes_sent * 10000u / 1024u / dt : 0;
        SerialMon.printf("[%s] %u.%u fps | %u.%u КБ/с | камера: %s | RAM %u\n",
                         link_up ? "связь" : "нет связи",
                         fps10 / 10, fps10 % 10, kbps10 / 10, kbps10 % 10,
                         cam_info, (unsigned)ESP.getFreeHeap());
#if VSYNC_PROBE
        {
            static uint32_t vs_prev = 0, vs_t = 0;
            uint32_t now_ms = millis(), e = vs_edges;
            if (vs_t && now_ms != vs_t) {
                uint32_t r10 = (e - vs_prev) * 10000u / (now_ms - vs_t);
                SerialMon.printf("  VSYNC: фронтов %lu.%lu/с (честный VSYNC — два на кадр сенсора)\n",
                                 (unsigned long)(r10 / 10), (unsigned long)(r10 % 10));
            }
            vs_prev = e;
            vs_t = now_ms;
        }
#endif
#if CAM_SIG_COUNT
        if (sig_ok) {
            int16_t v = 0, h = 0;
            pcnt_get_counter_value(PCNT_UNIT_0, &v);
            pcnt_get_counter_value(PCNT_UNIT_1, &h);
            pcnt_counter_clear(PCNT_UNIT_0);
            pcnt_counter_clear(PCNT_UNIT_1);
            sig_vs_last = v;
            sig_hr_last = h;
            uint32_t vs10 = dt ? (uint32_t)(v < 0 ? 0 : v) * 10000u / dt : 0;
            uint32_t hr1 = dt ? (uint32_t)(h < 0 ? 0 : h) * 1000u / dt : 0;
            SerialMon.printf("  СИГНАЛЫ СЕНСОРА: кадров (VSYNC) %lu.%lu/с, строк (HREF) %lu/с\n",
                             (unsigned long)(vs10 / 10), (unsigned long)(vs10 % 10),
                             (unsigned long)hr1);
        }
#endif
#if CAM_CHECK_ON
        if (cam_live_n) {
            uint32_t avg100 = (uint32_t)(cam_live_sum * 100.0f / cam_live_n);
            uint32_t bad10  = cam_live_bad * 1000u / cam_live_n;
            SerialMon.printf("  ЗАХВАТ: шершавость сейчас %u.%02u, средняя %u.%02u, "
                             "поражено %u.%u%% (%lu из %lu, порог %u.0)\n",
                             (unsigned)(cam_live_last), (unsigned)((uint32_t)(cam_live_last*100)%100),
                             avg100 / 100, avg100 % 100, bad10 / 10, bad10 % 10,
                             (unsigned long)cam_live_bad, (unsigned long)cam_live_n,
                             (unsigned)CAM_CHECK_THRESHOLD);
#if CAM_REPAIR
            SerialMon.printf("  ПРАВКА СЛИПА: вылечено %lu из %lu поражённых, "
                             "осталось %lu, цена %lu мкс на кадр\n",
                             (unsigned long)cam_fix_ok, (unsigned long)cam_fix_try,
                             (unsigned long)cam_fix_left,
                             (unsigned long)(cam_fix_try ? cam_fix_us / cam_fix_try : 0));
#endif
#if SHUTTER_TEST
            {
                unsigned long n0 = sh_n[0], b0 = sh_bad[0], v0 = sh_votes[0];
                unsigned long n1 = sh_n[1], b1 = sh_bad[1], v1 = sh_votes[1];
                SerialMon.printf("  ШТОРКА (цикл %lu): ПЕРЕДАЧА %lu кадров, со сдвигом %lu = %lu.%lu%%, "
                                 "строк на кадр %lu.%lu | ТИШИНА %lu кадров, со сдвигом %lu = %lu.%lu%%, "
                                 "строк на кадр %lu.%lu\n",
                                 (unsigned long)sh_cycles,
                                 n0, b0, n0 ? b0 * 100 / n0 : 0, n0 ? (b0 * 1000 / n0) % 10 : 0,
                                 n0 ? v0 / n0 : 0, n0 ? (v0 * 10 / n0) % 10 : 0,
                                 n1, b1, n1 ? b1 * 100 / n1 : 0, n1 ? (b1 * 1000 / n1) % 10 : 0,
                                 n1 ? v1 / n1 : 0, n1 ? (v1 * 10 / n1) % 10 : 0);
                /* Гистограмма — раз в десять строк статистики, она длинная.
                 * Формат интервала: «сдвиг/всего», интервалы по SH_HIST_MS. */
                if (++sh_hist_print % 10 == 0) {
                    for (int ph = 0; ph < 2; ph++) {
                        SerialMon.printf("  ШТОРКА-ГИСТ %s:", ph ? "ТИШИНА  " : "ПЕРЕДАЧА");
                        for (int i = 0; i < SH_HIST_BINS; i++) {
                            SerialMon.printf(" %lu/%lu", (unsigned long)sh_hb[ph][i],
                                             (unsigned long)sh_hn[ph][i]);
                        }
                        SerialMon.printf("\n");
                    }
                }
            }
#endif
        }
#endif

        // Счётчики приёмника — единственный способ увидеть потери: у нас на
        // передаче никаких подтверждений нет.
        if (link_up) {
            SerialMon.printf("  ПРИЁМНИК ok=%lu crc_err=%lu кадров=%lu последний=%lu\n",
                             (unsigned long)peer.pkts_ok,
                             (unsigned long)peer.pkts_crc_err,
                             (unsigned long)peer.frames_done,
                             (unsigned long)peer.last_frame_id);
        }
        /* 05.10: свой приём камеры — где теряются квитанции (~10 % в ROLE_SWAP).
         * crc_err/len_err растут — пакеты бьются на UART модуля камеры; не растут —
         * квитанции пропадают раньше, в эфире или в модуле приёмника. junk — сюда
         * же текст отчётов модуля, он растёт всегда. */
        SerialMon.printf("  СВОЙ ПРИЁМ ok=%lu crc_err=%lu len_err=%lu junk=%lu\n",
                         (unsigned long)rx.n_ok, (unsigned long)rx.n_crc_err,
                         (unsigned long)rx.n_len_err, (unsigned long)rx.n_junk);

        /* Задержка по подтверждениям: средние — за весь прогон, мин/макс — за
         * период. Отправлено всего frames_total; разница с подтверждёнными —
         * кадры без последнего чанка или подтверждения, потерянные в пути. */
        SerialMon.printf("  ЗАДЕРЖКА: отправлено %lu, подтверждено %lu (неполных %lu, чужих %lu) | "
                         "RTT ср %lu мин %lu макс %lu мс | съёмка->подтверждение ср %lu макс %lu мс | t=%lu\n",
                         (unsigned long)frames_total, (unsigned long)lat_acks,
                         (unsigned long)lat_incomplete, (unsigned long)lat_unmatched,
                         (unsigned long)(lat_acks ? lat_rtt_sum / lat_acks : 0),
                         (unsigned long)(lat_rtt_min == 0xFFFFFFFFu ? 0 : lat_rtt_min),
                         (unsigned long)lat_rtt_max,
                         (unsigned long)(lat_acks ? lat_age_sum / lat_acks : 0),
                         (unsigned long)lat_age_max, (unsigned long)millis());
        if (ck_sent) {
            uint32_t pm = (uint32_t)((uint64_t)(ck_sent - ck_got) * 1000u / ck_sent);
            SerialMon.printf("  КУСКИ: дошло %lu из %lu (пропало %lu.%lu %%), по месту: первый %lu, "
                             "средние %lu, последний %lu, квитанций со списком %lu\n",
                             (unsigned long)ck_got, (unsigned long)ck_sent,
                             (unsigned long)(pm / 10), (unsigned long)(pm % 10),
                             (unsigned long)ck_lost_pos[0], (unsigned long)ck_lost_pos[1],
                             (unsigned long)ck_lost_pos[2], (unsigned long)ck_mask_acks);
        }
        lat_rtt_max = lat_age_max = 0;
        lat_rtt_min = 0xFFFFFFFFu;
#if FC_WINDOW
        SerialMon.printf("  ОКНО: W=%u, в полёте %lu, списано по таймауту %lu, выброшено "
                         "устаревших %lu, окно закрыто при готовом кадре %lu мс\n",
                         (unsigned)fc_window, (unsigned long)(frame_id - fc_last_ack_id),
                         (unsigned long)fc_timeouts, (unsigned long)fc_skipped,
                         (unsigned long)fc_blocked_ms);
#endif
#if GATED_CAPTURE
        SerialMon.printf("  ПАУЗЫ: циклов %lu, тишина ср %lu мс, без %u чистых %lu, "
                         "кадров чистых %lu, грязных %lu, кадр сенсора %lu мс\n",
                         (unsigned long)gate_cycles,
                         (unsigned long)(gate_cycles ? gate_quiet_ms_sum / gate_cycles : 0),
                         (unsigned)GATE_FRAMES, (unsigned long)gate_forced,
                         (unsigned long)gate_clean, (unsigned long)gate_dirty,
                         (unsigned long)gate_frame_ms);
        SerialMon.printf("  ПАУЗЫ-РЕЖИМ: %s, мощность %d дБм (строк %lu), вкл от %d, выкл до %d, "
                         "переключений %lu, с паузами %lu с, без %lu с\n",
                         gate_on ? "ВКЛ" : "выкл", (int)mod_pwr_dbm,
                         (unsigned long)mod_pwr_seen, (int)GATE_PWR_ON, (int)GATE_PWR_OFF,
                         (unsigned long)gate_switches,
                         (unsigned long)(gate_on_ms / 1000), (unsigned long)(gate_off_ms / 1000));
#endif
#if AUTO_Q
        SerialMon.printf("  АВТОКАЧЕСТВО: %s, Q=%u, RTT %lu мс, к/с %lu.%lu, окно закрыто %lu мс из 1000, "
                         "вверх %lu, вниз %lu | вниз из-за: RTT>%d %lu, нет квит %lu, "
                         "RTT>%d %lu, окно %lu, списания %lu, мало к/с %lu | запоздалых квит %lu\n",
                         synth_on || !autoq_on ? "выкл" : autoq_on == 4 ? "вкл4"
                                               : autoq_on == 3 ? "вкл3"
                                               : autoq_on == 2 ? "вкл2" : "вкл",
                         (unsigned)jpeg_q_rt,
                         (unsigned long)aq_last_rtt,
                         (unsigned long)(aq_last_fps10 / 10), (unsigned long)(aq_last_fps10 % 10),
                         (unsigned long)aq_last_blk,
                         (unsigned long)aq_ups, (unsigned long)aq_downs,
                         (int)AUTOQ_RTT_BAD, (unsigned long)aq_why[0], (unsigned long)aq_why[1],
                         (int)AUTOQ_RTT_HI, (unsigned long)aq_why[2], (unsigned long)aq_why[3],
                         (unsigned long)aq_why[4], (unsigned long)aq_why[5], (unsigned long)aq_late);
#endif
#if AIR_LOG
        SerialMon.printf("  ЛОГ ПО ВОЗДУХУ: пакетов %lu, байт %lu, в кольце %lu, пропущено %lu\n",
                         (unsigned long)airlog_pkts, (unsigned long)airlog_bytes,
                         (unsigned long)(airlog_head - airlog_tail),
                         (unsigned long)airlog_lost_total);
#endif
        if (++lat_hist_print % 10 == 0) {
            SerialMon.printf("  ЗАДЕРЖКА-ГИСТ (съёмка->подтверждение, шаг %u мс):",
                             (unsigned)LAT_HIST_MS);
            for (int i = 0; i < LAT_HIST_BINS; i++) {
                SerialMon.printf(" %lu", (unsigned long)lat_hist[i]);
            }
            SerialMon.printf("\n");
        }

        if (stage_frames) {
            /* Съёмка и передача идут с разной частотой: при конвейере снимается
             * больше кадров, чем успевает уехать. Поэтому средние по камере и
             * сжатию считаем по снятым, а по UART — по отправленным. */
            uint32_t cam_avg = cap_frames ? cam_ms_acc / cap_frames : 0;
            uint32_t copy_avg = cap_frames ? copy_ms_acc / cap_frames : 0;
            uint32_t jpeg_avg = cap_frames ? jpeg_ms_acc / cap_frames : 0;
            uint32_t send_avg = send_ms_acc / stage_frames;
            uint32_t frame_period = dt / stage_frames;
            uint32_t busy = cam_avg + copy_avg + jpeg_avg + send_avg;
            uint32_t gaps_avg = frame_period > busy ? frame_period - busy : 0;
            /* Столбец «копия» — цена развязки по памяти. «JPEG» после неё должен
             * стать меньше, чем был при сжатии прямо из PSRAM. */
            SerialMon.printf("  STAGE камера %ums | копия %ums | JPEG %ums | UART %ums | "
                             "паузы+прочее %ums | итого на кадр %ums\n",
                             (unsigned)cam_avg, (unsigned)copy_avg, (unsigned)jpeg_avg,
                             (unsigned)send_avg, (unsigned)gaps_avg,
                             (unsigned)frame_period);
        }

#if CHECK_FB
        if (fb_checked) {
            SerialMon.printf("  БУФЕР КАДРА: проверено %lu, изменился во время сжатия %lu\n",
                             (unsigned long)fb_checked, (unsigned long)fb_torn);
        }
#endif
#if CHECK_ENCODER
        if (enc_checked) {
            SerialMon.printf("  КОДИРОВЩИК: сжато дважды %lu, результаты разошлись %lu\n",
                             (unsigned long)enc_checked, (unsigned long)enc_diff);
        }
#endif
#if CHECK_COPY
        if (copy_checked) {
            SerialMon.printf("  КОПИЯ В SRAM: проверено %lu, оригинал менялся во время "
                             "копирования %lu\n",
                             (unsigned long)copy_checked, (unsigned long)copy_torn);
        }
#endif
#if ENCODE_FROM_SRAM
        if (enc_from_psram) {
            SerialMon.printf("  ВНИМАНИЕ: кадров сжато прямо из PSRAM %lu\n",
                             (unsigned long)enc_from_psram);
        }
#endif

#if PIPELINE
        SerialMon.printf("  КОНВЕЙЕР: выброшено кадров %lu (передача не успевала), "
                         "кодировщиков %u, сжатых позже нового %lu\n",
                         (unsigned long)pipe_dropped, (unsigned)ENC_WORKERS,
                         (unsigned long)enc_reordered);
#endif

        frames_sent = 0;
        bytes_sent = 0;
        cam_ms_acc = copy_ms_acc = jpeg_ms_acc = send_ms_acc = 0;
        stage_frames = cap_frames = 0;

        // Раз в две секунды дождаться, пока напечатанное уйдёт в USB. На фоне
        // периода в 2 с это ничего не стоит, а лог перестаёт теряться, когда
        // конвейер занимает ядро (см. пояснение к flush в setup).
        halow_mon_settle();
    }

    if (!camera_ok) {
        delay(10);
        return;
    }

#if TEST_PATTERN
    // Камеру больше не трогаем: шлём один и тот же буфер. Если полосы на
    // приёмнике окажутся каждый раз новыми — портит передача, а не камера.
    if (tp_jpg) {
        uint32_t t0 = millis();
        sendFrame(tp_jpg, tp_len);
        send_ms_acc += (millis() - t0);
        stage_frames++;
        if (frame_gap_ms) {
            delay(frame_gap_ms);
        }
    }
    return;
#endif

#if SHUTTER_TEST
    if (tx_enabled) {
        shutter_tick();
    }
#endif
#if PIPELINE
    /* Передача. Захват и сжатие идут параллельно в camera_task на другом ядре.
     * Если задача не поднялась (не хватило внутреннего буфера или не создалась
     * очередь), jpg_q == NULL — тогда проваливаемся в последовательный путь
     * ниже, он остаётся рабочим. */
    if (jpg_q) {
#if GATED_CAPTURE
        gate_mode_update(millis());
        if (gate_on) {
            uint32_t now = millis();
            /* fc_can_send списывает кадр без подтверждения, только когда окно
             * полно, а здесь тишина ждёт, пока в пути станет 0. Потерянная
             * квитанция на одиночный кадр останавливала передачу навсегда
             * (29.09, стоп на 4-м кадре) — просроченные списываем и так. */
            while (frame_id != fc_last_ack_id) {
                uint32_t oldest = fc_last_ack_id + 1;
                lat_slot_t *s = &lat_ring[oldest % LAT_RING];
                if (s->id == oldest && s->sent_ms &&
                    millis() - s->sent_ms <= GATE_ACK_TIMEOUT_MS) {
                    break;
                }
                fc_last_ack_id = oldest;
                fc_timeouts++;
            }
            bool can = fc_can_send();
            bool in_flight = (frame_id != fc_last_ack_id);
            bool have = uxQueueMessagesWaiting(jpg_q) > 0;
            if (gate_quiet) {
                bool enough = gate_clean_cur >= GATE_FRAMES;
                bool too_long = now - gate_quiet_t0 > GATE_QUIET_MAX_MS;
                if (!have || !(enough || too_long)) {
                    delay(1);
                    return;                        /* молчим, камера снимает */
                }
                if (!enough) {
                    gate_forced++;
                }
                gate_end_quiet(now);
                gate_sent_busy = 0;
            } else if (gate_sent_busy >= GATE_FRAMES || !have || !can) {
                if (!in_flight && (gate_sent_busy >= GATE_FRAMES || !have)) {
                    gate_begin_quiet(now);         /* всё подтверждено, модуль пуст */
                }
                delay(1);
                return;
            }
        } else
#endif
        {
#if FC_WINDOW
        if (!fc_can_send()) {
            /* Окно закрыто. Полную очередь не держим: старший кадр в сброс,
             * камера тут же снимет свежий. */
            if (uxQueueMessagesWaiting(jpg_q) >= 2) {
                jpg_item_t old;
                if (xQueueReceive(jpg_q, &old, 0) == pdTRUE) {
                    free(old.buf);
                    fc_skipped++;
                }
            }
            if (uxQueueMessagesWaiting(jpg_q) > 0) {
                fc_blocked_ms++;        /* кадр готов, а окно закрыто; ~1 мс на проход */
            }
            delay(1);
            return;
        }
        /* Окно открыто: уходит самый свежий кадр, старшие — в сброс. */
        while (uxQueueMessagesWaiting(jpg_q) > 1) {
            jpg_item_t old;
            if (xQueueReceive(jpg_q, &old, 0) != pdTRUE) {
                break;
            }
            free(old.buf);
            fc_skipped++;
        }
#endif
        }
        jpg_item_t it;
        if (xQueueReceive(jpg_q, &it, 0) == pdTRUE) {
#if SHUTTER_TEST
            /* Тишина: кадр снят, сжат и измерен, но в модуль не идёт.
             * Очередь при этом разгребаем, иначе захват встанет. */
            if (sh_state >= SH_OFF_SETTLE) {
                free(it.buf);
                return;
            }
#endif
            /* Сжался позже более нового, который уже ушёл, — не показываем
             * приёмнику прошлое. См. ENC_WORKERS. */
            if (it.seq && it.seq <= last_sent_seq) {
                free(it.buf);
                enc_reordered++;
                return;
            }
            last_sent_seq = it.seq;
            uint32_t t_send0 = millis();
            lat_next_cap_ms = it.cap_ms;
            sendFrame(it.buf, it.len);
            send_ms_acc += (millis() - t_send0);
            free(it.buf);
            stage_frames++;
#if GATED_CAPTURE
            gate_sent_busy++;
#endif
            if (frame_gap_ms) {
                delay(frame_gap_ms);
            }
        } else {
            delay(2);           // кадра пока нет, отдаём время другим задачам
        }
        return;
    }
#endif
    uint8_t *jpg = NULL;
    size_t   jpg_len = 0;
    uint32_t t_send0 = millis();

    if (!captureFrame(&jpg, &jpg_len, &lat_next_cap_ms)) {
        delay(10);
        return;
    }
    t_send0 = millis();
    sendFrame(jpg, jpg_len);
    send_ms_acc += (millis() - t_send0);
    free(jpg);
    stage_frames++;

    if (frame_gap_ms) {
        delay(frame_gap_ms);
    }
}
